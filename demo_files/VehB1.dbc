VERSION ""

NS_ :

BS_ :

BU_ : CAB FED HAD JDL OBT OBT_FA PDU POD VTV XCP DC1 MTU

BO_ 2298477147 Mx_FFFA_P2_0x5B: 8 POD
 SG_ CmdBytePGN65530_POD M : 0|16@1+ (1,0) [0|0] ""  JDL
 SG_ CoolingFanAdjDesiredSpeed m8448 : 16|16@1+ (0.125,0) [0|8031.88] ""  JDL
 SG_ CoolingFanSpeedRPM m8448 : 32|16@1+ (0.125,0) [0|8031.88] ""  JDL
 SG_ MaxControllableCoolingFanSpeed m8448 : 48|16@1+ (0.125,0) [0|8031.88] ""  JDL
 SG_ CoolingFanSystemRequestor m8704 : 16|8@1+ (1,0) [0|255] ""  JDL
 SG_ CoolingFanControlModeState m8704 : 24|4@1+ (1,0) [0|15] ""  JDL
 SG_ CoolingFanSolenoidDutyCycle m8704 : 32|8@1+ (0.4,0) [0|100] ""  JDL
 SG_ CoolingFanSolenoidFrequency m8704 : 40|8@1+ (1,0) [0|250] ""  JDL
 SG_ CoolingFanFaultedRequestor m8704 : 48|8@1+ (1,0) [0|255] ""  JDL

BO_ 2565823486 EngineDerateStatus_TX_Vector__XXX_RX_POD: 8 Vector__XXX
 SG_ CmdBytePGN61184_Vector_XXX M : 0|16@1+ (1,0) [0|0] ""  POD
 SG_ EngTorqueDerateSetpnt m9060 : 24|8@1+ (0.4,0) [0|100] ""  POD

BO_ 2499803739 Mx_FFFA_P5_0x5B: 8 POD
 SG_ CmdBytePGN65530_POD M : 0|16@1+ (1,0) [0|0] ""  PDU,VTV,HAD
 SG_ EngFuelTankCap m6 : 16|16@1+ (0.5,0) [0|0] "L"  PDU,VTV
 SG_ HydrCharPresSensStat m8192 : 16|4@1+ (1,0) [0|15] ""  Vector__XXX
 SG_ MainGearcaseOilTemp m8192 : 24|8@1+ (1,-40) [-40|210] ""  HAD
 SG_ MaxEngineSpeedRequest m11528 : 16|16@1+ (0.125,0) [0|8031.875] ""  Vector__XXX
 SG_ MinEngineSpeedRequest m11528 : 32|16@1+ (0.125,0) [0|8031.875] ""  Vector__XXX
 SG_ EngineSpeedManagementActive m11528 : 48|2@1+ (1,0) [0|3] ""  Vector__XXX
 SG_ SPRAnchorThreshold m11776 : 16|16@1+ (0.125,0) [0|4000] ""  Vector__XXX
 SG_ SPRTorqueOffset m11776 : 32|16@1+ (1,-32000) [-32000|32255] "NewtonMeter"  Vector__XXX
 SG_ TotalTorqueOffset m11776 : 48|16@1+ (1,-32000) [-32000|32255] "NewtonMeter"  Vector__XXX
 SG_ CoolantTempPercent m21248 : 16|8@1+ (0.4,0) [0|100] ""  PDU
 SG_ VehicleTrailerStatus m21248 : 24|2@1+ (1,0) [0|3] ""  PDU
 SG_ FourWDStatus m21248 : 28|4@1+ (1,0) [0|15] ""  PDU
 SG_ DiffLockState m21248 : 32|4@1+ (1,0) [0|15] ""  PDU

BO_ 2499803995 Mx_FFFB_P5_0x5B: 8 POD
 SG_ CmdBytePGN65531_POD M : 0|16@1+ (1,0) [0|0] ""  PDU,CAB
 SG_ ParkBrakeManuallyEngagedSts m33 : 16|2@1+ (1,0) [0|3] ""  Vector__XXX
 SG_ DisplayedEnginePowerHighRes m5377 : 16|16@1+ (0.002,0) [0|129.022] ""  PDU
 SG_ ACClutchInhibit m19456 : 16|2@1+ (1,0) [0|3] ""  CAB

BO_ 2298477290 FEDPressureRequestCommands_FED: 8 FED
 SG_ CmdBytePGN65530_FED M : 0|16@1+ (1,0) [0|0] ""  HAD
 SG_ DomainPcompRequestFED m12800 : 16|4@1+ (1,0) [0|15] ""  HAD
 SG_ DomainPcompRequest2FED m12800 : 20|4@1+ (1,0) [0|15] ""  HAD
 SG_ DomainSpecificPressureRequestFED m12800 : 24|16@1+ (1,0) [0|64255] ""  HAD
 SG_ DomaSpecPresRequ2FED m12800 : 40|16@1+ (1,0) [0|64255] ""  HAD

BO_ 2566913002 Mx_FFFB_P6_0xEA: 8 FED
 SG_ CmdBytePGN65531_FED M : 0|16@1+ (1,0) [0|0] ""  HAD,JDL,VTV
 SG_ HeaderRaiseMechanicalDelay m865 : 16|8@1+ (0.05,0) [0|12.8] ""  JDL,VTV
 SG_ HeaderLowerMechanicalDelay m865 : 24|8@1+ (0.05,0) [0|12.8] ""  JDL,VTV
 SG_ HeaderLeadingEdge m865 : 32|16@1+ (1,0) [0|65535] ""  JDL,VTV
 SG_ HeaderTrailingEdge m865 : 48|16@1+ (1,0) [0|65535] ""  JDL,VTV
 SG_ DustFanSpd m2811 : 16|16@1+ (1,0) [0|64255] ""  HAD
 SG_ DustFanSpdSnsrSts m2811 : 32|4@1+ (1,0) [0|15] ""  HAD
 SG_ HdrTransptModState m3835 : 16|4@1+ (1,0) [0|15] ""  HAD
 SG_ LateralTiltSensorStatus m3835 : 20|4@1+ (1,0) [0|15] ""  Vector__XXX

BO_ 2566913022 Mx_FFFB_P6_0xFE: 8 Vector__XXX
 SG_ CmdBytePGN65531_Vector_XXX M : 0|16@1+ (1,0) [0|0] ""  JDL,VTV,POD
 SG_ LiftPumpMeasuredSpeed m48 : 16|8@1+ (0.4,0) [0|100] ""  JDL
 SG_ LiftPumpCommandedSpeed m48 : 24|8@1+ (0.4,0) [0|100] ""  JDL
 SG_ LiftPumpCurrent m48 : 32|8@1+ (0.144,0) [0|36] ""  JDL
 SG_ DEFPumpSpeedCommand m48 : 40|8@1+ (0.4,0) [0|1] ""  JDL
 SG_ DEFSupplyModulePressure m48 : 48|16@1+ (0.03125,0) [0|2000] ""  JDL
 SG_ RightFlasherHdrLightFaultState m1531 : 16|2@1+ (1,0) [0|3] ""  POD
 SG_ LeftFlasherHdrLightFaultState m1531 : 18|2@1+ (1,0) [0|3] ""  POD
 SG_ GSAMaxVehSpdLim m3067 : 16|16@1+ (0.00390625,0) [0|250.996] "KiloMtrPerHr"  VTV
 SG_ GSATransmissionPower m3067 : 32|16@1+ (0.1,-3000) [-3000|0] ""  VTV
 SG_ ReelRaisLowrPosnFb m3323 : 16|16@1+ (0.1,0) [0|0] ""  JDL
 SG_ ReelForeAftPosnFb m3323 : 32|16@1+ (0.1,0) [0|0] ""  JDL
 SG_ HdrFlexWingDraperVrnt m3323 : 48|4@1+ (1,0) [0|15] ""  JDL,VTV
 SG_ DraperBltProtnInstldOptn m3323 : 52|2@1+ (1,0) [0|3] ""  JDL

BO_ 2499803882 Mx_FFFA_P5_0xEA: 8 FED
 SG_ CmdBytePGN65530_FED M : 0|16@1+ (1,0) [0|0] ""  HAD,POD
 SG_ ClearBlockageEngagementState m13056 : 16|4@1+ (1,0) [0|15] ""  HAD
 SG_ EngThrottleOverrideRequestFED m14850 : 16|4@1+ (1,0) [0|15] ""  HAD,POD
 SG_ SepDisengageOverrideRequestFED m14850 : 20|2@1+ (1,0) [0|3] ""  HAD

BO_ 2499804138 Mx_FFFB_P5_0xEA: 8 FED
 SG_ CmdBytePGN65531_FED M : 0|16@1+ (1,0) [0|0] ""  HAD,JDL,OBT,VTV
 SG_ ForeAftTiltPosn m1275 : 16|16@1+ (0.001,-30) [-30|34] ""  HAD
 SG_ BackshaftSpeedSnsrSts m1275 : 32|4@1+ (1,0) [0|15] ""  HAD
 SG_ HeadRaisLoweEngaContStat m1377 : 16|4@1+ (1,0) [0|15] ""  JDL,VTV
 SG_ HeadRaisLoweResuSetpInte m1377 : 20|2@1+ (1,0) [0|3] ""  JDL,VTV
 SG_ WingPosnStToMainBus m1787 : 16|4@1+ (1,0) [0|15] ""  JDL
 SG_ WingLvlgMstOptnToMainBus m1787 : 24|4@1+ (1,0) [0|15] ""  JDL
 SG_ TopAugTypInstldDispToMainBus m1787 : 28|4@1+ (1,0) [0|15] ""  JDL
 SG_ GaugeWhlOptnDispToMainBus m1787 : 32|2@1+ (1,0) [0|3] ""  JDL
 SG_ InteTranInstDispToMainBus m1787 : 34|2@1+ (1,0) [0|3] ""  JDL
 SG_ SideKnivesInstldDispToMainBus m1787 : 36|2@1+ (1,0) [0|3] ""  JDL
 SG_ CropLifterInstldDispToMainBus m1787 : 38|2@1+ (1,0) [0|3] ""  JDL
 SG_ HdrHrsTotal m6898 : 16|32@1+ (0.05,0) [0|210554060.75] ""  OBT
 SG_ OdometerStyleHdrHrCntrEna m6898 : 48|2@1+ (1,0) [0|3] ""  OBT

BO_ 2566912746 Mx_FFFA_P6_0xEA: 8 FED
 SG_ CmdBytePGN65530_FED M : 0|16@1+ (1,0) [0|0] ""  OBT,HAD,CAB,VTV
 SG_ LeftGaugeWheelPositionSensor1 m1543 : 16|8@1+ (0.4,0) [0|100] ""  OBT
 SG_ LeftGaugeWheelPositionSensor2 m1543 : 24|8@1+ (0.4,0) [0|100] ""  OBT
 SG_ RightGaugeWheelPositionSensor1 m1543 : 40|8@1+ (0.4,0) [0|100] ""  OBT
 SG_ RightGaugeWheelPositionSensor2 m1543 : 48|8@1+ (0.4,0) [0|100] ""  OBT
 SG_ HeaderGaugeWhlOptnEnbld m7168 : 16|2@1+ (1,0) [0|3] ""  HAD
 SG_ HeaderFoldOptnEnbld m7168 : 20|4@1+ (1,0) [0|15] ""  HAD
 SG_ ReelInstalledOptEnbld m7168 : 24|2@1+ (1,0) [0|3] ""  HAD
 SG_ DraperBltInstalledOptEnbld m7168 : 26|2@1+ (1,0) [0|3] ""  HAD
 SG_ CutrbarPosnCtrlEnbld m7168 : 28|2@1+ (1,0) [0|3] ""  HAD
 SG_ WingLvlgMstOptnToVehBus m7168 : 36|4@1+ (1,0) [0|15] ""  HAD
 SG_ WorkLight21RightStatus m29441 : 56|2@1+ (1,0) [0|3] ""  CAB
 SG_ HarvestSetpointInfoRequestB1 m35330 : 16|48@1+ (1,0) [0|0] ""  VTV

BO_ 2499803174 Mx_FFF8_P5_0x26: 8 VTV
 SG_ CmdBytePGN65528_VTV M : 0|8@1+ (1,0) [0|0] ""  JDL
 SG_ GraiBypaPercDamaGraiFilt1 m194 : 24|16@1+ (0.002,0) [0|100] "%"  JDL
 SG_ GraiBypaPercDamaGraiFilt2 m194 : 40|16@1+ (0.002,0) [0|100] "%"  JDL
 SG_ GraiBypaPercLighMOGFilt1 m195 : 24|16@1+ (0.002,0) [0|100] "%"  JDL
 SG_ GraiBypaPercLighMOGFilt2 m195 : 40|16@1+ (0.002,0) [0|100] "%"  JDL
 SG_ GraiBypaPercHeavMOGFilt1 m196 : 24|16@1+ (0.002,0) [0|100] "%"  JDL
 SG_ GraiBypaPercHeavMOGFilt2 m196 : 40|16@1+ (0.002,0) [0|100] "%"  JDL
 SG_ GraiBypaPercUnthGraiFilt1 m197 : 24|16@1+ (0.002,0) [0|100] "%"  JDL
 SG_ GraiBypaPercUnthGraiFilt2 m197 : 40|16@1+ (0.002,0) [0|100] "%"  JDL

BO_ 2499803883 Mx_FFFA_P5_0xEB: 8 HAD
 SG_ CmdBytePGN65530_HAD M : 0|16@1+ (1,0) [0|0] ""  VTV,CAB,FED,POD
 SG_ UnloadingAugerLength m49 : 16|8@1+ (0.1,0) [0|25.5] ""  VTV
 SG_ UnloadingAugerFold m49 : 24|4@1+ (1,0) [0|15] ""  VTV
 SG_ RotationalAlarmCommand m10752 : 16|4@1+ (1,0) [0|15] ""  CAB,FED,POD
 SG_ RotationalAlarmFlashRate m10752 : 24|8@1+ (1,0) [0|250] ""  CAB,FED,POD
 SG_ EngThrottleOverrideRequestHAD m15106 : 16|4@1+ (1,0) [0|15] ""  FED,POD
 SG_ HdrDisengageOverrideRequestHAD m15106 : 20|2@1+ (1,0) [0|3] ""  FED

BO_ 2566911014 Mx_FFF4_P6_0x26: 8 VTV
 SG_ CmdBytePGN65524_VTV M : 0|8@1+ (1,0) [0|0] ""  JDL
 SG_ SeparatorGrainLossFilter1 m2 : 8|16@1+ (0.0004,0) [0|25.7] "%"  JDL
 SG_ SeparatorGrainLossFilter2 m2 : 24|16@1+ (0.0004,0) [0|25.7] "%"  JDL
 SG_ CleanShoeGrainLossFilter1 m3 : 8|16@1+ (0.0004,0) [0|25.7] "%"  JDL
 SG_ CleanShoeGrainLossFilter2 m3 : 24|16@1+ (0.0004,0) [0|25.7] "%"  JDL
 SG_ IC2SteadyState m41 : 16|4@1+ (1,0) [0|15] ""  JDL
 SG_ IC2Enabled m41 : 20|4@1+ (1,0) [0|15] ""  JDL
 SG_ IC2ShortTermStatusSepLoss m41 : 24|4@1+ (1,0) [0|15] ""  JDL
 SG_ IC2LongTermStatusSepLoss m41 : 28|4@1+ (1,0) [0|15] ""  JDL
 SG_ IC2ShortTermStatusShLoss m41 : 32|4@1+ (1,0) [0|15] ""  JDL
 SG_ IC2LongTermStatusShLoss m41 : 36|4@1+ (1,0) [0|15] ""  JDL
 SG_ IC2DiagHighestActiveFault m41 : 40|8@1+ (1,0) [0|255] ""  JDL
 SG_ IC2DiagFaultState m41 : 48|4@1+ (1,0) [0|15] ""  JDL
 SG_ IC2ShortTermStatusCropGap m41 : 52|4@1+ (1,0) [0|15] ""  JDL
 SG_ IC2DiagNumActiveFaults m41 : 56|8@1+ (1,0) [0|250] "Count"  JDL
 SG_ SteeringResponseRate m100 : 8|5@1+ (5,-50) [-50|100] "gain"  Vector__XXX
 SG_ GPSMsgRate m100 : 13|3@1+ (1,0) [0|7] ""  Vector__XXX
 SG_ AutoTracWheelbase_GSCJDE m100 : 16|8@1+ (0.05,0) [0|12.5] "m"  Vector__XXX
 SG_ InnerLoopGain m100 : 24|16@1+ (1,0) [0|65535] "gain"  Vector__XXX
 SG_ AT2ExitCode_GSCJDE m100 : 40|8@1+ (1,0) [0|255] ""  Vector__XXX
 SG_ CrvtrCntrlATState_GSCJDE m100 : 48|4@1+ (1,0) [0|15] ""  Vector__XXX
 SG_ Heartbeat m100 : 52|4@1+ (1,0) [0|0] ""  Vector__XXX
 SG_ SensorType_LESC m102 : 8|4@1+ (1,0) [0|15] ""  Vector__XXX
 SG_ CalibrationRequest_LESC m102 : 12|4@1+ (1,0) [0|15] ""  Vector__XXX
 SG_ SensorBias_LESC m102 : 16|10@1+ (1,-511) [-511|510] "mm"  Vector__XXX
 SG_ NewImageCountSteadyState m107 : 16|8@1+ (1,0) [0|250] ""  JDL
 SG_ ImageCountRateWithoutSteadyState m107 : 24|16@1+ (1,0) [0|65535] ""  JDL
 SG_ NewImageCountWithoutSteadyState m107 : 40|8@1+ (1,0) [0|250] ""  JDL
 SG_ HdrWidthInUse m145 : 8|16@1+ (0.001,0) [0|64.255] ""  JDL

BO_ 2432695787 Mx_FFFD_P4_0xEB: 8 HAD
 SG_ CmdBytePGN65533_HAD M : 0|16@1+ (1,0) [0|0] ""  VTV
 SG_ GlmController2Input1Error m1280 : 16|4@1+ (1,0) [0|15] ""  VTV
 SG_ GlmController2Input2Error m1280 : 20|4@1+ (1,0) [0|15] ""  VTV
 SG_ GlmController2Input3Error m1280 : 24|4@1+ (1,0) [0|15] ""  VTV
 SG_ GlmController2Input4Error m1280 : 28|4@1+ (1,0) [0|15] ""  VTV
 SG_ GlmController1Input1Error m1280 : 32|4@1+ (1,0) [0|15] ""  VTV
 SG_ GlmController1Input2Error m1280 : 36|4@1+ (1,0) [0|15] ""  VTV
 SG_ GlmController1Input3Error m1280 : 40|4@1+ (1,0) [0|15] ""  VTV
 SG_ GlmController1Input4Error m1280 : 44|4@1+ (1,0) [0|15] ""  VTV
 SG_ GlmController2Error m1280 : 48|4@1+ (1,0) [0|15] ""  VTV
 SG_ GlmController1Error m1280 : 52|4@1+ (1,0) [0|15] ""  VTV
 SG_ GlmController1Input1Type m1536 : 16|4@1+ (1,0) [0|15] ""  VTV
 SG_ GlmController1Input2Type m1536 : 20|4@1+ (1,0) [0|15] ""  VTV
 SG_ GlmController1Input3Type m1536 : 24|4@1+ (1,0) [0|15] ""  VTV
 SG_ GlmController1Input4Type m1536 : 28|4@1+ (1,0) [0|15] ""  VTV
 SG_ GlmController2Input1Type m1536 : 32|4@1+ (1,0) [0|15] ""  VTV
 SG_ GlmController2Input2Type m1536 : 36|4@1+ (1,0) [0|15] ""  VTV
 SG_ GlmController2Input3Type m1536 : 40|4@1+ (1,0) [0|15] ""  VTV
 SG_ GlmController2Input4Type m1536 : 44|4@1+ (1,0) [0|15] ""  VTV

BO_ 2566912806 GrainLossNGPDDisplayData_VTV: 8 VTV
 SG_ CmdBytePGN65531_VTV M : 0|16@1+ (1,0) [0|0] ""  PDU
 SG_ ShoeLossValue m15104 : 16|16@1+ (0.01,0) [0|100] ""  PDU
 SG_ SeparatorLossValue m15104 : 32|16@1+ (0.01,0) [0|100] ""  PDU
 SG_ GrainLossLimit m15104 : 48|16@1+ (0.1,0) [0|100] ""  PDU

BO_ 2566912254 Mx_FFF8_P6_0xFE: 8 Vector__XXX
 SG_ CmdBytePGN65528_Vector_XXX M : 0|8@1+ (1,0) [0|0] ""  VTV,JDL
 SG_ TimeRemaPresAftrSCRInduLvl m115 : 16|16@1+ (1,0) [0|64255] ""  JDL
 SG_ LatErr m155 : 8|16@1+ (0.005,-160) [-160|161.275] "m"  VTV
 SG_ HeadErr m155 : 24|16@1+ (0.0078125,-200) [-200|301.99] "deg"  VTV
 SG_ Curv m155 : 40|8@1+ (0.125,-16) [-16|15.25] "deg/m"  VTV
 SG_ Confidence m155 : 48|4@1+ (1,0) [0|15] "count"  VTV
 SG_ SensorType_LESD m155 : 52|4@1+ (1,0) [0|15] ""  VTV
 SG_ LatErrAugBits m155 : 56|4@1+ (0.00034,0) [0|0.00476] "m"  VTV
 SG_ CurvAugBits m155 : 60|4@1+ (0.0084,0) [0|0.1176] "deg/m"  VTV
 SG_ GrainBypassMotorStatus m192 : 8|4@1+ (1,0) [0|15] ""  VTV

BO_ 2298477350 GSACommand_VTV: 8 VTV
 SG_ CmdBytePGN65531_VTV M : 0|16@1+ (1,0) [0|0] ""  FED
 SG_ GSACommandStatus m505 : 16|8@1+ (1,0) [0|255] ""  Vector__XXX
 SG_ GSACommandSpeed m505 : 24|16@1+ (0.00390625,0) [0|250.996] "KiloMtrPerHr"  FED

BO_ 2565865451 Mx_EFFF_P6_0xEB: 8 HAD
 SG_ CmdBytePGN61184_HAD M : 0|16@1+ (1,0) [0|0] ""  JDL,VTV,OBT,CAB,FED,POD,DC1
 SG_ PGNRqstProp m219 : 16|24@1+ (1,0) [0|0] ""  CAB,FED,POD,DC1
 SG_ REQPGNCMDBYTE1 m219 : 40|8@1+ (1,0) [0|0] ""  CAB,FED,POD,DC1
 SG_ PGNRqstProp m241 : 16|24@1+ (1,0) [0|0] ""  CAB,FED,POD,DC1
 SG_ REQPGNCMDBYTE1 m241 : 40|8@1+ (1,0) [0|0] ""  CAB,FED,POD,DC1
 SG_ REQPGNCMDBYTE2 m241 : 48|8@1+ (1,0) [0|0] ""  CAB,FED,POD,DC1
 SG_ OpCtrlB2RspByte5BitQuad14 m2544 : 32|4@1+ (1,0) [0|15] ""  CAB
 SG_ OpCtrlB2RspByte8BitQuad14 m2544 : 56|4@1+ (1,0) [0|15] ""  CAB
 SG_ Capability_1_JD_CAN_2016 m2553 : 16|2@1+ (1,0) [0|0] ""  Vector__XXX
 SG_ Capa2JDExteMultLega m2553 : 18|2@1+ (1,0) [0|0] ""  Vector__XXX
 SG_ Capa3J193973DiagMess m2553 : 20|2@1+ (1,0) [0|0] ""  Vector__XXX
 SG_ Capability4UDSDiagnosticMessages m2553 : 22|2@1+ (1,0) [0|0] ""  Vector__XXX
 SG_ Capa5JDNetwHealMess m2553 : 24|2@1+ (1,0) [0|0] ""  Vector__XXX
 SG_ Capa6J193974JDConfMess m2553 : 26|2@1+ (1,0) [0|0] ""  Vector__XXX
 SG_ Capa7J193974SAEConfMess m2553 : 28|2@1+ (1,0) [0|0] ""  Vector__XXX
 SG_ Capability8J193974ShortResponse m2553 : 30|2@1+ (1,0) [0|0] ""  Vector__XXX
 SG_ Capability9J193974LongResponse m2553 : 32|2@1+ (1,0) [0|0] ""  Vector__XXX
 SG_ Capability_10 m2553 : 34|2@1+ (1,0) [0|0] ""  Vector__XXX
 SG_ Capability_11 m2553 : 36|2@1+ (1,0) [0|0] ""  Vector__XXX
 SG_ Capability_12 m2553 : 38|2@1+ (1,0) [0|0] ""  Vector__XXX
 SG_ Capability_13 m2553 : 40|2@1+ (1,0) [0|0] ""  Vector__XXX
 SG_ Capability_14 m2553 : 42|2@1+ (1,0) [0|0] ""  Vector__XXX
 SG_ Capability_15 m2553 : 44|2@1+ (1,0) [0|0] ""  Vector__XXX
 SG_ Capability_16 m2553 : 46|2@1+ (1,0) [0|0] ""  Vector__XXX
 SG_ Capability_17 m2553 : 48|2@1+ (1,0) [0|0] ""  Vector__XXX
 SG_ Capability_18 m2553 : 50|2@1+ (1,0) [0|0] ""  Vector__XXX
 SG_ Capability_19 m2553 : 52|2@1+ (1,0) [0|0] ""  Vector__XXX
 SG_ Capability_20 m2553 : 54|2@1+ (1,0) [0|0] ""  Vector__XXX
 SG_ Capability_21 m2553 : 56|2@1+ (1,0) [0|0] ""  Vector__XXX
 SG_ Capability_22 m2553 : 58|2@1+ (1,0) [0|0] ""  Vector__XXX
 SG_ Capability_23 m2553 : 60|2@1+ (1,0) [0|0] ""  Vector__XXX
 SG_ Capability_24 m2553 : 62|2@1+ (1,0) [0|0] ""  Vector__XXX
 SG_ OpCtrlB3RspByte6BitQuad58 m3568 : 44|4@1+ (1,0) [0|15] ""  CAB
 SG_ OpCtrlB5RspByte6BitQuad58 m13556 : 44|4@1+ (1,0) [0|15] ""  CAB
 SG_ OpCtrlB6RspByte3BitQuad14 m14580 : 16|4@1+ (1,0) [0|15] ""  CAB
 SG_ RespHarvSetpAdjuB1 m15858 : 16|48@1+ (1,0) [0|0] ""  VTV
 SG_ KnifeBnkPosn m17508 : 32|8@1+ (0.4,0) [0|100] ""  OBT
 SG_ ChopWindrowState m17508 : 40|4@1+ (1,0) [0|15] ""  OBT
 SG_ ChopperState m17508 : 44|4@1+ (1,0) [0|15] ""  OBT
 SG_ GLM1StrikeRate4 m36964 : 16|16@1+ (1,0) [0|0] ""  VTV
 SG_ GLM2StrikeRate4 m36964 : 32|16@1+ (1,0) [0|0] ""  VTV
 SG_ GLM1StrikeRate1 m37220 : 16|16@1+ (1,0) [0|0] ""  VTV
 SG_ GLM1StrikeRate2 m37220 : 32|16@1+ (1,0) [0|0] ""  VTV
 SG_ GLM1StrikeRate3 m37220 : 48|16@1+ (1,0) [0|0] ""  VTV
 SG_ GLM2StrikeRate1 m37476 : 16|16@1+ (1,0) [0|0] ""  VTV
 SG_ GLM2StrikeRate2 m37476 : 32|16@1+ (1,0) [0|0] ""  VTV
 SG_ GLM2StrikeRate3 m37476 : 48|16@1+ (1,0) [0|0] ""  VTV
 SG_ CANTailingsElevatorType m38500 : 16|8@1+ (1,0) [0|255] ""  JDL,VTV
 SG_ ShoeChafferElmntType m38500 : 24|8@1+ (1,0) [0|255] ""  VTV
 SG_ ShoeSieveElmntType m38500 : 32|8@1+ (1,0) [0|255] ""  VTV
 SG_ GrainTankUnldngRate m38500 : 40|8@1+ (0.1,0) [0|25] ""  OBT
 SG_ GrainTankUnldngRateOffset m38500 : 48|8@1+ (0.1,-10) [-10|15] ""  OBT
 SG_ ChopWindrowEnaSt m38500 : 56|4@1+ (1,0) [0|15] ""  JDL
 SG_ CANVehSpcFrontLight1FaultState m41828 : 16|4@1+ (1,0) [0|15] ""  CAB
 SG_ CANVehSpcSideLight1FaultState m41828 : 28|4@1+ (1,0) [0|15] ""  CAB

BO_ 2566913003 Mx_FFFB_P6_0xEB: 8 HAD
 SG_ CmdBytePGN65531_HAD M : 0|16@1+ (1,0) [0|0] ""  VTV,FED,OBT
 SG_ AmbientAirTemp m8689 : 16|8@1+ (0.5,-25) [-25|100] "deg C"  VTV
 SG_ FeedAccelSnsrSts m8689 : 24|4@1+ (1,0) [0|15] ""  FED,OBT
 SG_ ChassisForeAftTiltCalDone m8689 : 28|2@1+ (1,0) [0|3] ""  VTV
 SG_ ChassisForeAftTiltPstn m8689 : 32|16@1+ (0.0078125,-200) [-200|301.99] "deg/b"  VTV
 SG_ ChassisForeAftTiltSnsrSts m8689 : 48|4@1+ (1,0) [0|15] ""  VTV
 SG_ GrainTankAccumulatedMass m8945 : 16|16@1+ (0.5,0) [0|1400] "kg"  VTV
 SG_ HillmasterSystemMode m60928 : 16|4@1+ (1,0) [0|15] ""  Vector__XXX
 SG_ HillMasterTiltRequest m60928 : 20|2@1+ (1,0) [0|3] ""  Vector__XXX

BO_ 2297429995 Mx_EFFF_P2_0xEB: 8 HAD
 SG_ CmdBytePGN61184_HAD M : 0|16@1+ (1,0) [0|0] ""  FED,VTV,JDL,OBT,POD,PDU
 SG_ ThreshingSpeed m3064 : 16|16@1+ (1,0) [0|64255] ""  FED,VTV
 SG_ ThreshingClearance m3064 : 32|8@1+ (1,-125) [-125|125] ""  JDL,VTV
 SG_ RotorGear m3064 : 40|8@1+ (1,0) [0|255] ""  OBT
 SG_ SeparatorDrive m3064 : 48|4@1+ (1,0) [0|15] ""  FED,POD,VTV
 SG_ TlngsVol m3064 : 56|8@1+ (0.4,0) [0|100] ""  PDU,VTV
 SG_ SystemPressureAchievable m18532 : 40|2@1+ (1,0) [0|3] ""  FED,POD,VTV
 SG_ SystemPressure2Achievable m18532 : 42|2@1+ (1,0) [0|3] ""  FED
 SG_ RotorDrvT m18532 : 48|8@1+ (1,-40) [-40|210] "DegCgrd"  FED,POD,VTV

BO_ 2365585457 HarvesterOperatorData_CAB: 8 CAB
 SG_ CmdBytePGN65528_CAB M : 0|8@1+ (1,0) [0|0] ""  FED,HAD,POD
 SG_ HarvEngageCmds m40 : 8|4@1+ (1,0) [0|15] ""  FED,HAD,POD
 SG_ HarvEngageCmds2 m40 : 12|4@1+ (1,0) [0|15] ""  FED,HAD,POD

BO_ 2566911211 HarvestingAutomationOptions_HAD: 8 HAD
 SG_ CmdBytePGN65524_HAD M : 0|8@1+ (1,0) [0|0] ""  VTV
 SG_ HarvestSmartEnable m110 : 8|4@1+ (1,0) [0|15] ""  VTV
 SG_ ActiveTerrainAdjustEnable m110 : 12|4@1+ (1,0) [0|15] ""  VTV
 SG_ IntelligentCombineAdjustOption m110 : 16|4@1+ (1,0) [0|15] ""  VTV
 SG_ MoistureSensorType m110 : 20|4@1+ (1,0) [0|15] ""  VTV
 SG_ ForwardLookingPerceptionOption m110 : 24|4@1+ (1,0) [0|15] ""  VTV
 SG_ AutomationUXOption m110 : 28|4@1+ (1,0) [0|15] ""  VTV
 SG_ HillmasterInstalledOption m110 : 32|4@1+ (1,0) [0|15] ""  VTV
 SG_ ChassisForeAftSensorInstalled m110 : 36|4@1+ (1,0) [0|15] ""  VTV
 SG_ GrainBypassOption m110 : 40|4@1+ (1,0) [0|15] ""  VTV

BO_ 2499804906 Mx_FFFE_P5_0xEA: 8 FED
 SG_ CmdBytePGN65534_FED M : 0|8@1+ (1,0) [0|0] ""  HAD,OBT,PDU,CAB,VTV
 SG_ HdrBkshaftSpd m67 : 8|16@1+ (1,0) [0|64255] "RPM"  HAD,OBT
 SG_ ReelSpd m67 : 24|16@1+ (1,0) [0|64255] ""  OBT,PDU
 SG_ FdrhseHeight m71 : 8|16@1+ (1,0) [0|64255] "Millimeter"  PDU
 SG_ HdrPltfrmHeight m71 : 24|16@1+ (1,0) [0|64255] ""  PDU
 SG_ FdrhseHeightPrcnt m71 : 40|8@1+ (0.4,0) [0|100] ""  HAD,PDU
 SG_ HdrRecrdStopHeight m71 : 48|8@1+ (0.4,0) [0|100] ""  CAB,HAD,PDU,VTV

BO_ 2365585969 HarvOperSwitRawData_CAB: 8 CAB
 SG_ CmdBytePGN65530_CAB M : 0|16@1+ (1,0) [0|0] ""  HAD
 SG_ HarvEngageCmdOnSignalInput m12032 : 16|4@1+ (1,0) [0|15] ""  HAD
 SG_ HarvEngageCmd2OnSignalInput m12032 : 20|4@1+ (1,0) [0|15] ""  HAD

BO_ 2498756606 HeadAuxiFuncHead1_Vector__XXX: 8 Vector__XXX
 SG_ CmdBytePGN61184_Vector_XXX M : 0|16@1+ (1,0) [0|0] ""  VTV
 SG_ HdrAuxResumeTogReq m31076 : 28|2@1+ (1,0) [0|3] ""  VTV

BO_ 2566913534 HeadConfDataToFronEndDoma1_Vector__XXX: 8 Vector__XXX
 SG_ CmdBytePGN65533_Vector_XXX M : 0|16@1+ (1,0) [0|0] ""  JDL
 SG_ HdrWidthFromHeader m2560 : 16|16@1+ (0.001,0) [0|64.255] ""  JDL
 SG_ NmbrRowsFromHeader m2560 : 32|8@1+ (1,0) [0|250] ""  JDL
 SG_ MaxHeaderAuxFlowRateFromHeader m2560 : 40|8@1+ (0.1,0) [0|250] ""  JDL

BO_ 2499805182 Mx_FFFF_P5_0xFE: 8 Vector__XXX
 SG_ CmdBytePGN65535_Vector_XXX M : 0|8@1+ (1,0) [0|0] ""  PDU,CAB,FED,HAD,POD,DC1
 SG_ ReelPositionActive m17 : 28|2@1+ (1,0) [0|3] ""  PDU
 SG_ AutoClearDTCTime m34 : 24|8@1+ (1,0) [0|0] ""  CAB,FED,HAD,POD,DC1

BO_ 2499805162 Mx_FFFF_P5_0xEA: 8 FED
 SG_ CmdBytePGN65535_FED M : 0|8@1+ (1,0) [0|0] ""  JDL,VTV,PDU
 SG_ HdrHeightActResumeNmbr m18 : 8|8@1+ (1,0) [0|255] ""  PDU
 SG_ SelctdDigDisp m18 : 16|8@1+ (1,0) [0|255] ""  PDU
 SG_ DialSpdRatio m18 : 32|8@1+ (1,1) [1|251] ""  PDU
 SG_ HdrPstnMaxPrcnt m22 : 16|8@1+ (0.4,0) [0|100] ""  PDU
 SG_ HdrPstnPrcnt m22 : 24|8@1+ (0.4,0) [0|100] ""  PDU
 SG_ PltfrmFlexPressSnsr m22 : 32|16@1+ (1,0) [0|64255] ""  PDU
 SG_ HdrLiftCylPressHiRes m22 : 48|16@1+ (1,0) [0|64255] "kPa"  PDU
 SG_ HdrWidth m24 : 24|16@1+ (0.001,0) [0|64.255] ""  JDL,VTV
 SG_ NmbrRows m24 : 48|8@1+ (1,0) [0|250] ""  JDL,VTV

BO_ 2499802366 ICA2DataMessage2_Vector__XXX: 8 Vector__XXX
 SG_ CmdBytePGN65524_Vector_XXX M : 0|8@1+ (1,0) [0|0] ""  JDL
 SG_ IC2ShortTermStatusDmgdGrain m48 : 16|4@1+ (1,0) [0|15] ""  JDL
 SG_ IC2LongTermStatusDmgdGrain m48 : 20|4@1+ (1,0) [0|15] ""  JDL
 SG_ IC2ShortTermStatusMOGL m48 : 24|4@1+ (1,0) [0|15] ""  JDL
 SG_ IC2LongTermStatusMOGL m48 : 28|4@1+ (1,0) [0|15] ""  JDL
 SG_ IC2ShortTermStatusMOGH m48 : 32|4@1+ (1,0) [0|15] ""  JDL
 SG_ IC2LongTermStatusMOGH m48 : 36|4@1+ (1,0) [0|15] ""  JDL
 SG_ IC2ShortTermStatusUnthrGrain m48 : 40|4@1+ (1,0) [0|15] ""  JDL
 SG_ IC2LongTermStatusUnthrGrain m48 : 44|4@1+ (1,0) [0|15] ""  JDL
 SG_ IC2ShortTermStatusTlngsVol m48 : 48|4@1+ (1,0) [0|15] ""  JDL

BO_ 2566914026 InteCaliECUtoTool_FED: 8 FED
 SG_ CmdBytePGN65535_FED M : 0|8@1+ (1,0) [0|0] ""  VTV
 SG_ ActVehicleCal m247 : 16|8@1+ (1,0) [0|255] ""  VTV
 SG_ CalStep m247 : 24|8@1+ (1,0) [0|255] ""  VTV

BO_ 2566913830 Mx_FFFF_P6_0x26: 8 VTV
 SG_ CmdBytePGN65535_VTV M : 0|8@1+ (1,0) [0|0] ""  JDL
 SG_ ActiveTerrainAdjustEnable m38 : 20|2@1+ (1,0) [0|3] ""  JDL
 SG_ ReqVehicleCal m246 : 16|8@1+ (1,0) [0|0] ""  Vector__XXX
 SG_ CalMode m246 : 24|8@1+ (1,0) [0|0] ""  Vector__XXX

BO_ 2565865307 Mx_EFFF_P6_0x5B: 8 POD
 SG_ CmdBytePGN61184_POD M : 0|16@1+ (1,0) [0|0] ""  CAB,VTV,HAD,PDU,FED,DC1
 SG_ PGNRqstProp m219 : 16|24@1+ (1,0) [0|0] ""  CAB,FED,HAD,DC1
 SG_ REQPGNCMDBYTE1 m219 : 40|8@1+ (1,0) [0|0] ""  CAB,FED,HAD,DC1
 SG_ PGNRqstProp m241 : 16|24@1+ (1,0) [0|0] ""  CAB,FED,HAD,DC1
 SG_ REQPGNCMDBYTE1 m241 : 40|8@1+ (1,0) [0|0] ""  CAB,FED,HAD,DC1
 SG_ REQPGNCMDBYTE2 m241 : 48|8@1+ (1,0) [0|0] ""  CAB,FED,HAD,DC1
 SG_ Capability_1_JD_CAN_2016 m2553 : 16|2@1+ (1,0) [0|0] ""  Vector__XXX
 SG_ Capa2JDExteMultLega m2553 : 18|2@1+ (1,0) [0|0] ""  Vector__XXX
 SG_ Capa3J193973DiagMess m2553 : 20|2@1+ (1,0) [0|0] ""  Vector__XXX
 SG_ Capability4UDSDiagnosticMessages m2553 : 22|2@1+ (1,0) [0|0] ""  Vector__XXX
 SG_ Capa5JDNetwHealMess m2553 : 24|2@1+ (1,0) [0|0] ""  Vector__XXX
 SG_ Capa6J193974JDConfMess m2553 : 26|2@1+ (1,0) [0|0] ""  Vector__XXX
 SG_ Capa7J193974SAEConfMess m2553 : 28|2@1+ (1,0) [0|0] ""  Vector__XXX
 SG_ Capability8J193974ShortResponse m2553 : 30|2@1+ (1,0) [0|0] ""  Vector__XXX
 SG_ Capability9J193974LongResponse m2553 : 32|2@1+ (1,0) [0|0] ""  Vector__XXX
 SG_ Capability_10 m2553 : 34|2@1+ (1,0) [0|0] ""  Vector__XXX
 SG_ Capability_11 m2553 : 36|2@1+ (1,0) [0|0] ""  Vector__XXX
 SG_ Capability_12 m2553 : 38|2@1+ (1,0) [0|0] ""  Vector__XXX
 SG_ Capability_13 m2553 : 40|2@1+ (1,0) [0|0] ""  Vector__XXX
 SG_ Capability_14 m2553 : 42|2@1+ (1,0) [0|0] ""  Vector__XXX
 SG_ Capability_15 m2553 : 44|2@1+ (1,0) [0|0] ""  Vector__XXX
 SG_ Capability_16 m2553 : 46|2@1+ (1,0) [0|0] ""  Vector__XXX
 SG_ Capability_17 m2553 : 48|2@1+ (1,0) [0|0] ""  Vector__XXX
 SG_ Capability_18 m2553 : 50|2@1+ (1,0) [0|0] ""  Vector__XXX
 SG_ Capability_19 m2553 : 52|2@1+ (1,0) [0|0] ""  Vector__XXX
 SG_ Capability_20 m2553 : 54|2@1+ (1,0) [0|0] ""  Vector__XXX
 SG_ Capability_21 m2553 : 56|2@1+ (1,0) [0|0] ""  Vector__XXX
 SG_ Capability_22 m2553 : 58|2@1+ (1,0) [0|0] ""  Vector__XXX
 SG_ Capability_23 m2553 : 60|2@1+ (1,0) [0|0] ""  Vector__XXX
 SG_ Capability_24 m2553 : 62|2@1+ (1,0) [0|0] ""  Vector__XXX
 SG_ IOExpOutputPinState3DutyCycle m2556 : 16|16@1+ (0.1,0) [0|100] ""  CAB
 SG_ IOExpOutputPinState3Frequency m2556 : 32|16@1+ (0.1,0) [0|1000] ""  CAB
 SG_ IOExpOutputPinState3CurrentFbk m2556 : 48|8@1+ (0.1,0) [0|25] "Ampere"  CAB
 SG_ IOExpOutputPinState3Status m2556 : 56|8@1+ (1,0) [0|255] ""  CAB
 SG_ OpCtrlB3RspByte3BitQuad14 m3568 : 16|4@1+ (1,0) [0|15] ""  CAB
 SG_ OpCtrlB3RspByte3BitQuad58 m3568 : 20|4@1+ (1,0) [0|15] ""  CAB
 SG_ OpCtrlB3RspByte4BitQuad14 m3568 : 24|4@1+ (1,0) [0|15] ""  CAB
 SG_ OpCtrlB3RspByte4BitQuad58 m3568 : 28|4@1+ (1,0) [0|15] ""  CAB
 SG_ OpCtrlB3RspByte5BitQuad14 m3568 : 32|4@1+ (1,0) [0|15] ""  CAB
 SG_ OpCtrlB3RspByte6BitQuad14 m3568 : 40|4@1+ (1,0) [0|15] ""  CAB
 SG_ OpCtrlB3RspByte7BitQuad14 m3568 : 48|4@1+ (1,0) [0|15] ""  CAB
 SG_ OpCtrlB3RspByte7BitQuad58 m3568 : 52|4@1+ (1,0) [0|15] ""  CAB
 SG_ OpCtrlB3RspByte8BitQuad14 m3568 : 56|4@1+ (1,0) [0|15] ""  CAB
 SG_ OpCtrlB3RspByte8BitQuad58 m3568 : 60|4@1+ (1,0) [0|15] ""  CAB
 SG_ ActvtnCount m10226 : 16|5@1+ (1,0) [0|31] ""  VTV
 SG_ SeqNumber m10226 : 21|3@1+ (1,0) [0|7] ""  VTV
 SG_ ScanCodeElm0 m10226 : 24|8@1+ (1,0) [0|255] ""  VTV
 SG_ ScanCodeElm1 m10226 : 32|8@1+ (1,0) [0|255] ""  VTV
 SG_ ScanCodeElm2 m10226 : 40|8@1+ (1,0) [0|255] ""  VTV
 SG_ ScanCodeElm3 m10226 : 48|8@1+ (1,0) [0|255] ""  VTV
 SG_ ScanCodeElm4 m10226 : 56|8@1+ (1,0) [0|255] ""  VTV
 SG_ OpCtrlB5RspByte5BitQuad14 m13556 : 32|4@1+ (1,0) [0|15] ""  CAB
 SG_ OpCtrlB5RspByte6BitQuad14 m13556 : 40|4@1+ (1,0) [0|15] ""  CAB
 SG_ OpCtrlB5RspByte7BitQuad14 m13556 : 48|4@1+ (1,0) [0|15] ""  CAB
 SG_ CurrentGearRange m21604 : 24|8@1+ (1,0) [0|255] ""  HAD,PDU
 SG_ ProDriveTransMode m21604 : 32|8@1+ (1,0) [0|255] ""  PDU
 SG_ ParkBrakeStateAutomatic m21604 : 40|2@1+ (1,0) [0|3] ""  FED,PDU
 SG_ ParkLock m21604 : 42|2@1+ (1,0) [0|3] ""  FED,HAD,PDU
 SG_ LowFuelLevelAlarm m21604 : 52|2@1+ (1,0) [0|3] ""  PDU,VTV
 SG_ TireSizeFrntOnly m24676 : 32|16@1+ (1,0) [0|64255] "MilliMtr"  HAD
 SG_ CANVehSpcRearLight1FaultState m41828 : 40|4@1+ (1,0) [0|15] ""  CAB
 SG_ LeftFlasherLightFaultState m42084 : 16|2@1+ (1,0) [0|3] ""  CAB
 SG_ RightFlasherLightFaultState m42084 : 18|2@1+ (1,0) [0|3] ""  CAB

BO_ 2565865416 Mx_EFFF_P6_0xC8: 8 DC1
 SG_ CmdBytePGN61184_DC1 M : 0|16@1+ (1,0) [0|0] ""  CAB,FED,HAD,POD
 SG_ PGNRqstProp m219 : 16|24@1+ (1,0) [0|0] ""  CAB,FED,HAD,POD
 SG_ REQPGNCMDBYTE1 m219 : 40|8@1+ (1,0) [0|0] ""  CAB,FED,HAD,POD
 SG_ PGNRqstProp m241 : 16|24@1+ (1,0) [0|0] ""  CAB,FED,HAD,POD
 SG_ REQPGNCMDBYTE1 m241 : 40|8@1+ (1,0) [0|0] ""  CAB,FED,HAD,POD
 SG_ REQPGNCMDBYTE2 m241 : 48|8@1+ (1,0) [0|0] ""  CAB,FED,HAD,POD

BO_ 2565865450 Mx_EFFF_P6_0xEA: 8 FED
 SG_ CmdBytePGN61184_FED M : 0|16@1+ (1,0) [0|0] ""  CAB,HAD,POD,DC1,VTV
 SG_ PGNRqstProp m219 : 16|24@1+ (1,0) [0|0] ""  CAB,HAD,POD,DC1
 SG_ REQPGNCMDBYTE1 m219 : 40|8@1+ (1,0) [0|0] ""  CAB,HAD,POD,DC1
 SG_ PGNRqstProp m241 : 16|24@1+ (1,0) [0|0] ""  CAB,HAD,POD,DC1
 SG_ REQPGNCMDBYTE1 m241 : 40|8@1+ (1,0) [0|0] ""  CAB,HAD,POD,DC1
 SG_ REQPGNCMDBYTE2 m241 : 48|8@1+ (1,0) [0|0] ""  CAB,HAD,POD,DC1
 SG_ Capability_1_JD_CAN_2016 m2553 : 16|2@1+ (1,0) [0|0] ""  Vector__XXX
 SG_ Capa2JDExteMultLega m2553 : 18|2@1+ (1,0) [0|0] ""  Vector__XXX
 SG_ Capa3J193973DiagMess m2553 : 20|2@1+ (1,0) [0|0] ""  Vector__XXX
 SG_ Capability4UDSDiagnosticMessages m2553 : 22|2@1+ (1,0) [0|0] ""  Vector__XXX
 SG_ Capa5JDNetwHealMess m2553 : 24|2@1+ (1,0) [0|0] ""  Vector__XXX
 SG_ Capa6J193974JDConfMess m2553 : 26|2@1+ (1,0) [0|0] ""  Vector__XXX
 SG_ Capa7J193974SAEConfMess m2553 : 28|2@1+ (1,0) [0|0] ""  Vector__XXX
 SG_ Capability8J193974ShortResponse m2553 : 30|2@1+ (1,0) [0|0] ""  Vector__XXX
 SG_ Capability9J193974LongResponse m2553 : 32|2@1+ (1,0) [0|0] ""  Vector__XXX
 SG_ Capability_10 m2553 : 34|2@1+ (1,0) [0|0] ""  Vector__XXX
 SG_ Capability_11 m2553 : 36|2@1+ (1,0) [0|0] ""  Vector__XXX
 SG_ Capability_12 m2553 : 38|2@1+ (1,0) [0|0] ""  Vector__XXX
 SG_ Capability_13 m2553 : 40|2@1+ (1,0) [0|0] ""  Vector__XXX
 SG_ Capability_14 m2553 : 42|2@1+ (1,0) [0|0] ""  Vector__XXX
 SG_ Capability_15 m2553 : 44|2@1+ (1,0) [0|0] ""  Vector__XXX
 SG_ Capability_16 m2553 : 46|2@1+ (1,0) [0|0] ""  Vector__XXX
 SG_ Capability_17 m2553 : 48|2@1+ (1,0) [0|0] ""  Vector__XXX
 SG_ Capability_18 m2553 : 50|2@1+ (1,0) [0|0] ""  Vector__XXX
 SG_ Capability_19 m2553 : 52|2@1+ (1,0) [0|0] ""  Vector__XXX
 SG_ Capability_20 m2553 : 54|2@1+ (1,0) [0|0] ""  Vector__XXX
 SG_ Capability_21 m2553 : 56|2@1+ (1,0) [0|0] ""  Vector__XXX
 SG_ Capability_22 m2553 : 58|2@1+ (1,0) [0|0] ""  Vector__XXX
 SG_ Capability_23 m2553 : 60|2@1+ (1,0) [0|0] ""  Vector__XXX
 SG_ Capability_24 m2553 : 62|2@1+ (1,0) [0|0] ""  Vector__XXX
 SG_ RespHarvSetpAdjuB1 m15858 : 16|48@1+ (1,0) [0|0] ""  VTV

BO_ 2565851185 JD_ACKnowledgement_TX_CAB_RX_DC1: 8 CAB
 SG_ CmdBytePGN61184_CAB M : 0|16@1+ (1,0) [0|0] ""  Vector__XXX

BO_ 2565859889 JD_ACKnowledgement_TX_CAB_RX_FED: 8 CAB
 SG_ CmdBytePGN61184_CAB M : 0|16@1+ (1,0) [0|0] ""  Vector__XXX

BO_ 2565860145 JD_ACKnowledgement_TX_CAB_RX_HAD: 8 CAB
 SG_ CmdBytePGN61184_CAB M : 0|16@1+ (1,0) [0|0] ""  Vector__XXX

BO_ 2565823281 JD_ACKnowledgement_TX_CAB_RX_POD: 8 CAB
 SG_ CmdBytePGN61184_CAB M : 0|16@1+ (1,0) [0|0] ""  Vector__XXX

BO_ 2565812680 JD_ACKnowledgement_TX_DC1_RX_CAB: 8 DC1
 SG_ CmdBytePGN61184_DC1 M : 0|16@1+ (1,0) [0|0] ""  Vector__XXX

BO_ 2565860040 JD_ACKnowledgement_TX_DC1_RX_FED: 8 DC1
 SG_ CmdBytePGN61184_DC1 M : 0|16@1+ (1,0) [0|0] ""  Vector__XXX

BO_ 2565860296 JD_ACKnowledgement_TX_DC1_RX_HAD: 8 DC1
 SG_ CmdBytePGN61184_DC1 M : 0|16@1+ (1,0) [0|0] ""  Vector__XXX

BO_ 2565823432 JD_ACKnowledgement_TX_DC1_RX_POD: 8 DC1
 SG_ CmdBytePGN61184_DC1 M : 0|16@1+ (1,0) [0|0] ""  Vector__XXX

BO_ 2565812714 JD_ACKnowledgement_TX_FED_RX_CAB: 8 FED
 SG_ CmdBytePGN61184_FED M : 0|16@1+ (1,0) [0|0] ""  Vector__XXX

BO_ 2565851370 JD_ACKnowledgement_TX_FED_RX_DC1: 8 FED
 SG_ CmdBytePGN61184_FED M : 0|16@1+ (1,0) [0|0] ""  Vector__XXX

BO_ 2565860330 JD_ACKnowledgement_TX_FED_RX_HAD: 8 FED
 SG_ CmdBytePGN61184_FED M : 0|16@1+ (1,0) [0|0] ""  Vector__XXX

BO_ 2565823466 JD_ACKnowledgement_TX_FED_RX_POD: 8 FED
 SG_ CmdBytePGN61184_FED M : 0|16@1+ (1,0) [0|0] ""  Vector__XXX

BO_ 2565812715 JD_ACKnowledgement_TX_HAD_RX_CAB: 8 HAD
 SG_ CmdBytePGN61184_HAD M : 0|16@1+ (1,0) [0|0] ""  Vector__XXX

BO_ 2565851371 JD_ACKnowledgement_TX_HAD_RX_DC1: 8 HAD
 SG_ CmdBytePGN61184_HAD M : 0|16@1+ (1,0) [0|0] ""  Vector__XXX

BO_ 2565860075 JD_ACKnowledgement_TX_HAD_RX_FED: 8 HAD
 SG_ CmdBytePGN61184_HAD M : 0|16@1+ (1,0) [0|0] ""  Vector__XXX

BO_ 2565823467 JD_ACKnowledgement_TX_HAD_RX_POD: 8 HAD
 SG_ CmdBytePGN61184_HAD M : 0|16@1+ (1,0) [0|0] ""  Vector__XXX

BO_ 2565812571 JD_ACKnowledgement_TX_POD_RX_CAB: 8 POD
 SG_ CmdBytePGN61184_POD M : 0|16@1+ (1,0) [0|0] ""  Vector__XXX

BO_ 2565851227 JD_ACKnowledgement_TX_POD_RX_DC1: 8 POD
 SG_ CmdBytePGN61184_POD M : 0|16@1+ (1,0) [0|0] ""  Vector__XXX

BO_ 2565859931 JD_ACKnowledgement_TX_POD_RX_FED: 8 POD
 SG_ CmdBytePGN61184_POD M : 0|16@1+ (1,0) [0|0] ""  Vector__XXX

BO_ 2565860187 JD_ACKnowledgement_TX_POD_RX_HAD: 8 POD
 SG_ CmdBytePGN61184_POD M : 0|16@1+ (1,0) [0|0] ""  Vector__XXX

BO_ 2566912859 Mx_FFFB_P6_0x5B: 8 POD
 SG_ CmdBytePGN65531_POD M : 0|16@1+ (1,0) [0|0] ""  PDU,CAB
 SG_ PercentDisplayedEnginePower m1280 : 16|8@1+ (1,-125) [-125|125] ""  PDU
 SG_ DisplayedEnginePowerMode m1280 : 24|3@1+ (1,0) [0|7] ""  Vector__XXX
 SG_ PowerMeterStartLightGreenA m4865 : 16|8@1+ (0.5,0) [0|125.5] ""  PDU
 SG_ PowerMeterStartDarkGreenB m4865 : 24|8@1+ (0.5,0) [1|125.5] ""  PDU
 SG_ PowerMeterStartYellowC m4865 : 32|8@1+ (0.5,0) [2|125.5] ""  PDU
 SG_ PowerMeterStartRedD m4865 : 40|8@1+ (0.5,0) [3|125.5] ""  PDU
 SG_ PowerMeterEndRedE m4865 : 48|8@1+ (0.5,0) [4|125.5] ""  PDU
 SG_ PowerMeterAutoBarStart m5121 : 16|8@1+ (0.5,0) [0|125.5] ""  PDU
 SG_ PowerMeterAutoBarEnd m5121 : 24|8@1+ (0.5,0) [0|125.5] ""  PDU
 SG_ MissionPowerStatus m33024 : 16|4@1+ (1,0) [0|15] ""  CAB

BO_ 2498756602 Mx_EFFF_P5_0xFA: 8 OBT_FA
 SG_ CmdBytePGN61184_OBT_FA M : 0|16@1+ (1,0) [0|0] ""  Vector__XXX
 SG_ JDEngineTestMode m2916 : 16|8@1+ (1,0) [0|255] ""  Vector__XXX
 SG_ JDEngineTestState m2916 : 24|8@1+ (1,0) [0|255] ""  Vector__XXX
 SG_ JDEngineTestActiveType m2916 : 32|8@1+ (1,0) [0|255] ""  Vector__XXX
 SG_ JDEngineTestComponentID m2916 : 40|8@1+ (1,0) [0|255] ""  Vector__XXX
 SG_ JDEngineTestPercentProgress m2916 : 56|8@1+ (1,0) [0|0] ""  Vector__XXX
 SG_ HydrocarbonInjectorPurge m8292 : 16|2@1+ (1,0) [0|3] ""  Vector__XXX
 SG_ DiesOxidCataServReplComp m8292 : 24|2@1+ (1,0) [0|3] ""  Vector__XXX
 SG_ DiesPartFiltUninHydrDiagClea m8292 : 26|2@1+ (1,0) [0|3] ""  Vector__XXX
 SG_ DiesOxidCataOutlTempDiagClea m8292 : 28|2@1+ (1,0) [0|3] ""  Vector__XXX
 SG_ DiesOxidCataUninHydrDiagClea m8292 : 30|2@1+ (1,0) [0|3] ""  Vector__XXX
 SG_ DiesPartFiltServReplComp m8292 : 32|2@1+ (1,0) [0|3] ""  Vector__XXX
 SG_ DiesPartFiltUninHydrDiagClea m8292 : 34|2@1+ (1,0) [0|3] ""  Vector__XXX
 SG_ AfteDiesPartFiltRegeCleaFreqFaul m8292 : 36|2@1+ (1,0) [0|3] ""  Vector__XXX
 SG_ ServcRegenReq m8292 : 40|2@1+ (1,0) [0|3] ""  Vector__XXX
 SG_ AfteDiesExhaFluiPresContRequ m8292 : 42|2@1+ (1,0) [0|3] ""  Vector__XXX
 SG_ AfteSCRReplRese m8292 : 48|2@1+ (1,0) [0|3] ""  Vector__XXX
 SG_ AfteDiesPartFiltOutlGasHighTempStatComm m8292 : 50|2@1+ (1,0) [0|3] ""  Vector__XXX
 SG_ AfteDiesExhaFluiTankHeatCoolValvTest m8292 : 56|2@1+ (1,0) [0|3] ""  Vector__XXX
 SG_ AfteDiesExhaFluiSystShutTest m8292 : 58|2@1+ (1,0) [0|3] ""  Vector__XXX
 SG_ AfteDiesExhaFluiInjeDiagTest m8292 : 60|2@1+ (1,0) [0|3] ""  Vector__XXX
 SG_ AfteDiesExhaFluiInjeQuanTest m8292 : 62|2@1+ (1,0) [0|3] ""  Vector__XXX

BO_ 2566912747 Mx_FFFA_P6_0xEB: 8 HAD
 SG_ CmdBytePGN65530_HAD M : 0|16@1+ (1,0) [0|0] ""  CAB,VTV
 SG_ WorkLight4LeftStatus m29185 : 22|2@1+ (1,0) [0|3] ""  CAB
 SG_ WorkLight10LeftStatus m29185 : 34|2@1+ (1,0) [0|3] ""  CAB
 SG_ WorkLight22LeftStatus m29185 : 56|2@1+ (1,0) [0|3] ""  CAB
 SG_ WorkLight4RightStatus m29441 : 22|2@1+ (1,0) [0|3] ""  CAB
 SG_ WorkLight10RightStatus m29441 : 34|2@1+ (1,0) [0|3] ""  CAB
 SG_ WorkLight19RightStatus m29441 : 52|2@1+ (1,0) [0|3] ""  CAB
 SG_ WorkLight20RightStatus m29441 : 54|2@1+ (1,0) [0|3] ""  CAB
 SG_ WorkLight22RightStatus m29441 : 58|2@1+ (1,0) [0|3] ""  CAB
 SG_ HarvestSetpointInfoRequestB1 m35330 : 16|48@1+ (1,0) [0|0] ""  VTV

BO_ 2565864190 JDEngiFuncTest_TX_Vector__XXX_RX_OBT_FA: 8 Vector__XXX
 SG_ CmdBytePGN61184_Vector_XXX M : 0|16@1+ (1,0) [0|0] ""  OBT_FA
 SG_ CompressionTest m356 : 16|1@1+ (1,0) [0|1] ""  OBT_FA
 SG_ CylinderDiagnostics m356 : 17|1@1+ (1,0) [0|1] ""  OBT_FA
 SG_ CylinderCutoutTest m356 : 18|1@1+ (1,0) [0|1] ""  OBT_FA
 SG_ CylinderDiagnosticsTrigger m356 : 19|1@1+ (1,0) [0|1] ""  OBT_FA
 SG_ ActuatorDriverTest m356 : 20|1@1+ (1,0) [0|1] ""  OBT_FA
 SG_ EngiOverShutTestEnab m356 : 22|2@1+ (1,0) [0|3] ""  OBT_FA
 SG_ CompressionTestState m356 : 24|8@1+ (1,0) [0|255] ""  OBT_FA
 SG_ CylinderDiagnosticsState m356 : 32|8@1+ (1,0) [0|255] ""  OBT_FA
 SG_ CylinderCutoutCylinderNumber m356 : 40|8@1+ (1,0) [0|12] ""  OBT_FA
 SG_ ActuatorTestIndex m356 : 48|5@1+ (1,0) [0|0] ""  OBT_FA
 SG_ ActuatorTestType m356 : 53|2@1+ (1,0) [0|0] ""  OBT_FA
 SG_ ActuatorOutputValue m356 : 56|8@1+ (1,0) [0|250] ""  OBT_FA

BO_ 2364538878 JDEngineControlMessage1_Vector__XXX: 8 Vector__XXX
 SG_ CmdBytePGN61184_Vector_XXX M : 0|16@1+ (1,0) [0|0] ""  POD
 SG_ EngineBrakeTorque m1636 : 16|16@1+ (1,-32000) [-32000|32255] "Nm"  POD

BO_ 2566912049 JDLightingCommand3_CAB: 8 CAB
 SG_ CmdBytePGN65528_CAB M : 0|8@1+ (1,0) [0|0] ""  FED,HAD,POD
 SG_ MacExtrIllmnOpertTrig m69 : 24|4@1+ (1,0) [0|15] ""  FED,HAD
 SG_ LtgModReq m69 : 32|4@1+ (1,0) [0|15] ""  HAD,POD

BO_ 2364538859 LightingLightbarStateControl_HAD: 8 HAD
 SG_ CmdBytePGN61184_HAD M : 0|16@1+ (1,0) [0|0] ""  CAB
 SG_ JDIlluminationBrightnessPercent m9714 : 16|8@1+ (0.4,0) [0|100] ""  CAB

BO_ 2566912216 MachContGPSCellStarInhi_MTU: 8 MTU
 SG_ CmdBytePGN65528_MTU M : 0|8@1+ (1,0) [0|0] ""  Vector__XXX
 SG_ EngStartPrevent m84 : 20|4@1+ (1,0) [0|15] ""  Vector__XXX

BO_ 2565865465 MachNetwHealDataComm_OBT: 8 OBT
 SG_ CmdBytePGN61184_OBT M : 0|16@1+ (1,0) [0|0] ""  Vector__XXX

BO_ 2565865466 MachNetwHealDataComm_OBT_FA: 8 OBT_FA
 SG_ CmdBytePGN61184_OBT_FA M : 0|16@1+ (1,0) [0|0] ""  Vector__XXX

BO_ 2565860090 MachNetwHealDataComm_TX_OBT_FA_RX_FED: 8 OBT_FA
 SG_ CmdBytePGN61184_OBT_FA M : 0|16@1+ (1,0) [0|0] ""  Vector__XXX

BO_ 2565860346 MachNetwHealDataComm_TX_OBT_FA_RX_HAD: 8 OBT_FA
 SG_ CmdBytePGN61184_OBT_FA M : 0|16@1+ (1,0) [0|0] ""  Vector__XXX

BO_ 2565823482 MachNetwHealDataComm_TX_OBT_FA_RX_POD: 8 OBT_FA
 SG_ CmdBytePGN61184_OBT_FA M : 0|16@1+ (1,0) [0|0] ""  Vector__XXX

BO_ 2565860089 MachNetwHealDataComm_TX_OBT_RX_FED: 8 OBT
 SG_ CmdBytePGN61184_OBT M : 0|16@1+ (1,0) [0|0] ""  Vector__XXX

BO_ 2565860345 MachNetwHealDataComm_TX_OBT_RX_HAD: 8 OBT
 SG_ CmdBytePGN61184_OBT M : 0|16@1+ (1,0) [0|0] ""  Vector__XXX

BO_ 2565823481 MachNetwHealDataComm_TX_OBT_RX_POD: 8 OBT
 SG_ CmdBytePGN61184_OBT M : 0|16@1+ (1,0) [0|0] ""  Vector__XXX

BO_ 2431647526 MassflowMoisture_PGN_VTV: 8 VTV
 SG_ CmdBytePGN61184_VTV M : 0|16@1+ (1,0) [0|0] ""  HAD
 SG_ AutoSendFlowRate m2383 : 16|16@1+ (1,0) [0|250] "KiloGrPerSec"  HAD
 SG_ AutoSendMoisture m2383 : 32|16@1+ (1,0) [0|0] "Percent"  Vector__XXX
 SG_ AutoSendMassUnit m2383 : 56|8@1+ (1,0) [0|255] ""  HAD

BO_ 2364538662 MoisSensGraiBypaRequ_VTV: 8 VTV
 SG_ CmdBytePGN61184_VTV M : 0|16@1+ (1,0) [0|0] ""  Vector__XXX
 SG_ CleanGrainBypActivationRequest m16996 : 18|4@1+ (1,0) [0|15] ""  Vector__XXX
 SG_ ProdMoistSnsrFillSnsState m16996 : 16|2@1+ (1,0) [0|3] ""  Vector__XXX

BO_ 2565865254 Mx_EFFF_P6_0x26: 8 VTV
 SG_ CmdBytePGN61184_VTV M : 0|16@1+ (1,0) [0|0] ""  HAD,FED
 SG_ CalibrationStatus m15346 : 16|8@1+ (1,0) [0|255] ""  HAD
 SG_ RequestHarvesterSetpointAdjustB1 m15602 : 16|48@1+ (1,0) [0|0] ""  FED,HAD

BO_ 2566911192 MTU_Proprietary_Message_1_MTU: 8 MTU
 SG_ CmdBytePGN65524_MTU M : 0|8@1+ (1,0) [0|0] ""  Vector__XXX
 SG_ CntlrHeartbeat_MTUPROP1 m53 : 8|2@1+ (1,0) [0|3] ""  Vector__XXX

BO_ 2297429809 OperatorControlsD1Command_CAB: 8 CAB
 SG_ CmdBytePGN61184_CAB M : 0|16@1+ (1,0) [0|0] ""  FED,POD,VTV,HAD
 SG_ OpCtrlD1CmdByte3BitPair12 m2033 : 16|2@1+ (1,0) [0|3] ""  FED,POD,VTV
 SG_ OpCtrlD1CmdByte3BitPair56 m2033 : 20|2@1+ (1,0) [0|3] ""  FED,POD,VTV
 SG_ OpCtrlD1CmdByte4BitPair12 m2033 : 24|2@1+ (1,0) [0|3] ""  FED,VTV
 SG_ OpCtrlD1CmdByte4BitPair56 m2033 : 28|2@1+ (1,0) [0|3] ""  HAD
 SG_ OpCtrlD1CmdByte5BitPair12 m2033 : 32|2@1+ (1,0) [0|3] ""  HAD
 SG_ OpCtrlD1CmdByte5BitPair34 m2033 : 34|2@1+ (1,0) [0|3] ""  HAD
 SG_ OpCtrlD1CmdByte5BitPair56 m2033 : 36|2@1+ (1,0) [0|3] ""  HAD
 SG_ OpCtrlD1CmdByte5BitPair78 m2033 : 38|2@1+ (1,0) [0|3] ""  HAD
 SG_ OpCtrlD1CmdByte6BitPair12 m2033 : 40|2@1+ (1,0) [0|3] ""  FED
 SG_ OpCtrlD1CmdByte6BitPair34 m2033 : 42|2@1+ (1,0) [0|3] ""  FED
 SG_ OpCtrlD1CmdByte6BitPair56 m2033 : 44|2@1+ (1,0) [0|3] ""  FED
 SG_ OpCtrlD1CmdByte6BitPair78 m2033 : 46|2@1+ (1,0) [0|3] ""  FED
 SG_ OpCtrlD1CmdByte7BitPair12 m2033 : 48|2@1+ (1,0) [0|3] ""  FED
 SG_ OpCtrlD1CmdByte7BitPair56 m2033 : 52|2@1+ (1,0) [0|3] ""  FED
 SG_ OpCtrlD1CmdByte8BitPair12 m2033 : 56|2@1+ (1,0) [0|3] ""  FED
 SG_ OpCtrlD1CmdByte8BitPair56 m2033 : 60|2@1+ (1,0) [0|3] ""  FED

BO_ 2298476593 OperatorControlsEncoders2_CAB: 8 CAB
 SG_ CmdBytePGN65528_CAB M : 0|8@1+ (1,0) [0|0] ""  FED,HAD,POD
 SG_ OptrCtrlEncdr4Inc m133 : 8|8@1+ (1,0) [0|250] ""  FED,HAD,POD
 SG_ OptrCtrlEncdr4Dec m133 : 16|8@1+ (1,0) [0|250] ""  FED,HAD,POD
 SG_ OperCtrlEncdr4Btn m133 : 56|2@1+ (1,0) [0|3] ""  FED,HAD,POD

BO_ 2566912817 Mx_FFFB_P6_0x31: 8 CAB
 SG_ CmdBytePGN65531_CAB M : 0|16@1+ (1,0) [0|0] ""  FED,HAD,POD,VTV,DC1
 SG_ KeySwitchStart m9970 : 20|2@1+ (1,0) [0|3] ""  FED,HAD,POD,VTV
 SG_ KeySwitchRun m9970 : 22|2@1+ (1,0) [0|3] ""  FED,HAD,POD,VTV,DC1
 SG_ VehiclePowerState m32768 : 16|4@1+ (1,0) [0|15] ""  FED,HAD,POD

BO_ 2297429851 PODPressureRequestCommands_POD: 8 POD
 SG_ CmdBytePGN61184_POD M : 0|16@1+ (1,0) [0|0] ""  HAD
 SG_ DomainPcompRequestPOD m22372 : 20|4@1+ (1,0) [0|15] ""  HAD
 SG_ DomainSpecificPressureRequestPOD m22372 : 40|16@1+ (1,0) [0|64255] ""  HAD

BO_ 2298478058 SettSystDetaHarvSetpAdjuPrio2_FED: 8 FED
 SG_ CmdBytePGN65533_FED M : 0|16@1+ (1,0) [0|0] ""  VTV
 SG_ SettSystDetaHarvSetpAdjuPrio2 m256 : 16|48@1+ (1,0) [0|0] ""  VTV

BO_ 2298478059 SettSystDetaHarvSetpAdjuPrio2_HAD: 8 HAD
 SG_ CmdBytePGN65533_HAD M : 0|16@1+ (1,0) [0|0] ""  VTV
 SG_ SettSystDetaHarvSetpAdjuPrio2 m256 : 16|48@1+ (1,0) [0|0] ""  VTV

BO_ 2298477546 SettSystDetaHiRateHarvSetpAdjuPrio2_FED: 8 FED
 SG_ CmdBytePGN65531_FED M : 0|16@1+ (1,0) [0|0] ""  VTV
 SG_ SettSystDetaHiRateHarvSetpAdjuPrio2 m763 : 16|48@1+ (1,0) [0|0] ""  VTV

BO_ 2298477547 SettSystDetaHiRateHarvSetpAdjuPrio2_HAD: 8 HAD
 SG_ CmdBytePGN65531_HAD M : 0|16@1+ (1,0) [0|0] ""  VTV
 SG_ SettSystDetaHiRateHarvSetpAdjuPrio2 m763 : 16|48@1+ (1,0) [0|0] ""  VTV

BO_ 2432695038 Mx_FFFA_P4_0xFE: 8 Vector__XXX
 SG_ CmdBytePGN65530_Vector_XXX M : 0|16@1+ (1,0) [0|0] ""  VTV,OBT
 SG_ LeftWingPosition m4103 : 16|8@1+ (0.4,0) [0|102] ""  OBT
 SG_ RightWingPosition m4103 : 24|8@1+ (0.4,0) [0|102] ""  OBT
 SG_ SlipClutchState m11008 : 16|8@1+ (1,0) [0|255] ""  VTV

BO_ 2298477094 TailingsSystemStatus_VTV: 8 VTV
 SG_ CmdBytePGN65530_VTV M : 0|16@1+ (1,0) [0|0] ""  HAD,PDU
 SG_ TailingsVolumeFromSubnet m12544 : 16|8@1+ (0.4,0) [0|100] ""  HAD
 SG_ TlngsOpt m12544 : 24|2@1+ (1,0) [0|3] ""  PDU

BO_ 2634021414 TCM_Calibration_Status_VTV: 8 VTV
 SG_ CmdBytePGN65530_VTV M : 0|16@1+ (1,0) [0|0] ""  Vector__XXX
 SG_ TCMPitchCal m58 : 16|16@1+ (1,-30000) [-30000|34000] ""  Vector__XXX
 SG_ TCMRollCal m58 : 32|16@1+ (1,-30000) [-30000|34000] ""  Vector__XXX
 SG_ TCMCalStatus m58 : 60|4@1+ (1,0) [0|15] ""  Vector__XXX

BO_ 2365587238 Vehicle_RollYaw_Rate_VTV: 8 VTV
 SG_ CmdBytePGN65535_VTV M : 0|8@1+ (1,0) [0|0] ""  Vector__XXX
 SG_ VehRollAng m225 : 16|16@1+ (0.0078125,-200) [-200|301.99] "deg"  Vector__XXX
 SG_ VehYawRate m225 : 32|16@1+ (0.0078125,-200) [-200|301.99] "deg"  Vector__XXX

BO_ 2566912968 VehiConfManaResp_DC1: 8 DC1
 SG_ CmdBytePGN65531_DC1 M : 0|16@1+ (1,0) [0|0] ""  Vector__XXX

BO_ 2566913318 VirtTermToFronEndDomaComm1_VTV: 8 VTV
 SG_ CmdBytePGN65533_VTV M : 0|16@1+ (1,0) [0|0] ""  FED,JDL
 SG_ FeedModuForwComm m1792 : 16|2@1+ (1,0) [0|3] ""  FED,JDL
 SG_ FeedModuReveComm m1792 : 18|2@1+ (1,0) [0|3] ""  FED,JDL

CM_ BO_ 2298477147 "EngineCoolingFanSpeeds; EngineCoolingFanSystem";
CM_ BO_ 2565823486 "Engine_Derate_Status";
CM_ BO_ 2499803739 "EngineManagementSpeedStatus; PowertrainDomainMiscellaneousLowPriority2; PowerTrainConfiguration; PowerTrainHydraulics1; Scheduled_Power_Reduction_Application_and_Torque_Offset; VehicleOverrideRequestsPOD";
CM_ BO_ 2499803995 "EnginePowerParameters2; HVACMiscCommands; PowertrainDomainMiscellaneousHighPriority2";
CM_ BO_ 2298477290 "FEDPressureRequestCommands";
CM_ BO_ 2566913002 "FeederHouseDustFanConfigurationData0xFB0A; FrontEndDomainMiscellaneousStatus2; HeaderAutomationCharacteristics; Vehicle_Configuration_Management_Response";
CM_ BO_ 2566913022 "FEEHeaderTelematics; GSAData2; HeaderLightingFaultStatus; JDMachineHealthFilterMonitoring";
CM_ BO_ 2499803882 "FrontEndDomainMiscellaneousStatus3; VehicleOverrideRequestsFED";
CM_ BO_ 2499804138 "FrontEndDomainToHeaderStatus2; FrontEndDomainInformation; HarvesterVehicleHours2; HeaderEngagementAutomationStatus";
CM_ BO_ 2566912746 "GaugeWheelPositionSensors; HeaderOptions; JD_Configurable_Lighting_Status_Right_Hand_Work_Lights; SetpointInfoRequestHarvesterSetpointAdjust";
CM_ BO_ 2499803174 "Grain_Bypass_Damaged_Grain_Information_1; Grain_Bypass_Heavy_Material_Other_Than_Grain_Information_1; Grain_Bypass_Light_Material_Other_Than_Grain_Information_1; Grain_Bypass_Unthreshed_Grain_Information_1";
CM_ BO_ 2499803883 "GrainHandlingProfile; RotationalAlarmCommandRequest; VehicleOverrideRequestsHAD";
CM_ BO_ 2566911014 "GrainLossData5; GrainLossData6; GrainQualityImageCountInfo; Guidance_System_Command_JD_Extended; HeaderWidthDisplayData2; ICA2DataMessage1; Local_Error_Sensor_Commands";
CM_ BO_ 2432695787 "GrainLossErrorStates; GrainLossInputConfiguration";
CM_ BO_ 2566912806 "GrainLossNGPDDisplayData";
CM_ BO_ 2566912254 "Grain_Quality_System_Bypass_Motor_Control; JDAftertreatmentSCRSystemState; Local_Error_Sensor_Data";
CM_ BO_ 2298477350 "GSACommand";
CM_ BO_ 2565865451 "HarvestingDomainConfiguration; HarvestingDomainResidueStatus; HarvestSeparatorGrainLossAnalysisData; HarvestShoeGrainLossAnalysisData1; HarvestShoeGrainLossAnalysisData2; JD_ACKnowledgement; JD_Network_Capabilities; OperatorControlsB2Response; OperatorControlsB3Response; OperatorControlsB5Response; OperatorControlsB6Response; Prop_Request_PGN_Dual_Cmd_Byte; Prop_Request_PGN_Single_Cmd_Byte; ResponseHarvesterSetpointAdjust; VehicleLightingFaultStatus";
CM_ BO_ 2566913003 "Harvesting_Domain_Grain_Tank_Status_2; Harvesting_Domain_System_Information; HillmasterSystemInformation; Vehicle_Configuration_Management_Response";
CM_ BO_ 2297429995 "HarvestingDomainThreshingStatus; HarvestingDomainHydraulics1";
CM_ BO_ 2365585457 "HarvesterOperatorData";
CM_ BO_ 2566911211 "HarvestingAutomationOptions";
CM_ BO_ 2499804906 "HarvesterFrontEndShaftSpeedsandPositions; HeaderHeightDisplayData2";
CM_ BO_ 2365585969 "HarvesterOperatorSwitchRawData";
CM_ BO_ 2498756606 "HeaderAuxiliaryFunctionstoHeader1";
CM_ BO_ 2566913534 "HeaderConfigurationDataToFrontEndDomain1";
CM_ BO_ 2499805182 "HeaderHeightControlModeState; Tractor_Setup_1";
CM_ BO_ 2499805162 "HeaderWidthDisplayData; HeaderHeightActiveDisplayData; HeaderHeightPercentDisplayData";
CM_ BO_ 2499802366 "ICA2DataMessage2";
CM_ BO_ 2566914026 "InteractiveCalibrationECUtoTool";
CM_ BO_ 2566913830 "InteractiveCalibrationTooltoECU; IntelligentCombineAdjustCommunication";
CM_ BO_ 2565865307 "IOExpanderOutputPinStateMessage3; JD_ACKnowledgement; JD_Network_Capabilities; OperatorControlsB3Response; OperatorControlsB5Response; PCKeyboardScanCodeMessage2; PowertrainDomaintoDriveTrainCharacteristics; PowertrainDomainMiscellaneousLowPriority; Prop_Request_PGN_Dual_Cmd_Byte; Prop_Request_PGN_Single_Cmd_Byte; VehicleLightingFaultStatus; VehicleLightingFaultStatus1";
CM_ BO_ 2565865416 "JD_ACKnowledgement; Prop_Request_PGN_Dual_Cmd_Byte; Prop_Request_PGN_Single_Cmd_Byte";
CM_ BO_ 2565865450 "JD_ACKnowledgement; JD_Network_Capabilities; Prop_Request_PGN_Dual_Cmd_Byte; Prop_Request_PGN_Single_Cmd_Byte; ResponseHarvesterSetpointAdjust";
CM_ BO_ 2565851185 "JD_ACKnowledgement";
CM_ BO_ 2565859889 "JD_ACKnowledgement";
CM_ BO_ 2565860145 "JD_ACKnowledgement";
CM_ BO_ 2565823281 "JD_ACKnowledgement";
CM_ BO_ 2565812680 "JD_ACKnowledgement";
CM_ BO_ 2565860040 "JD_ACKnowledgement";
CM_ BO_ 2565860296 "JD_ACKnowledgement";
CM_ BO_ 2565823432 "JD_ACKnowledgement";
CM_ BO_ 2565812714 "JD_ACKnowledgement";
CM_ BO_ 2565851370 "JD_ACKnowledgement";
CM_ BO_ 2565860330 "JD_ACKnowledgement";
CM_ BO_ 2565823466 "JD_ACKnowledgement";
CM_ BO_ 2565812715 "JD_ACKnowledgement";
CM_ BO_ 2565851371 "JD_ACKnowledgement";
CM_ BO_ 2565860075 "JD_ACKnowledgement";
CM_ BO_ 2565823467 "JD_ACKnowledgement";
CM_ BO_ 2565812571 "JD_ACKnowledgement";
CM_ BO_ 2565851227 "JD_ACKnowledgement";
CM_ BO_ 2565859931 "JD_ACKnowledgement";
CM_ BO_ 2565860187 "JD_ACKnowledgement";
CM_ BO_ 2566912859 "JD_Displayed_Engine_Power; Mission_Power_Information; PowerMeterAutomation; PowerMeterThresholds; Vehicle_Configuration_Management_Response";
CM_ BO_ 2498756602 "JDAftertreatmentServiceInterface; JDEngineTestMessage";
CM_ BO_ 2566912747 "JD_Configurable_Lighting_Status_Left_Hand_Work_Lights; JD_Configurable_Lighting_Status_Right_Hand_Work_Lights; SetpointInfoRequestHarvesterSetpointAdjust";
CM_ BO_ 2565864190 "JDEngineFunctionalTest";
CM_ BO_ 2364538878 "JDEngineControlMessage1";
CM_ BO_ 2566912049 "JDLightingCommand3";
CM_ BO_ 2364538859 "LightingLightbarStateControl";
CM_ BO_ 2566912216 "Machine_Control_GPSCell_Start_Inhibit";
CM_ BO_ 2565865465 "Machine_Network_Health_Data_Command";
CM_ BO_ 2565865466 "Machine_Network_Health_Data_Command";
CM_ BO_ 2565860090 "Machine_Network_Health_Data_Command";
CM_ BO_ 2565860346 "Machine_Network_Health_Data_Command";
CM_ BO_ 2565823482 "Machine_Network_Health_Data_Command";
CM_ BO_ 2565860089 "Machine_Network_Health_Data_Command";
CM_ BO_ 2565860345 "Machine_Network_Health_Data_Command";
CM_ BO_ 2565823481 "Machine_Network_Health_Data_Command";
CM_ BO_ 2431647526 "MassflowMoisture_PGN";
CM_ BO_ 2364538662 "Moisture_Sensor_Grain_Bypass_Request";
CM_ BO_ 2565865254 "MSCCalibrationStatus; RequestHarvesterSetpointAdjust";
CM_ BO_ 2566911192 "MTU_Proprietary_Message_1";
CM_ BO_ 2297429809 "OperatorControlsD1Command";
CM_ BO_ 2298476593 "OperatorControlsEncoders2";
CM_ BO_ 2566912817 "OperatorSwitchControls4; Vehicle_State_Management; Vehicle_Configuration_Management_Response";
CM_ BO_ 2297429851 "PODPressureRequestCommands";
CM_ BO_ 2298478058 "SettingSystemDetailsHarvesterSetpointAdjust_Priority2";
CM_ BO_ 2298478059 "SettingSystemDetailsHarvesterSetpointAdjust_Priority2";
CM_ BO_ 2298477546 "SettingSystemDetailsHiRateHarvesterSetpointAdjust_Priority2";
CM_ BO_ 2298477547 "SettingSystemDetailsHiRateHarvesterSetpointAdjust_Priority2";
CM_ BO_ 2432695038 "SlipClutchDisplayData; WingPositions";
CM_ BO_ 2298477094 "TailingsSystemStatus";
CM_ BO_ 2634021414 "TCM_Calibration_Status";
CM_ BO_ 2365587238 "Vehicle_RollYaw_Rate";
CM_ BO_ 2566912968 "Vehicle_Configuration_Management_Response";
CM_ BO_ 2566913318 "VirtualTerminalToFrontEndDomainCommands1";
BA_DEF_ SG_ "SigType" ENUM "Default", "Range", "RangeSigned", "ASCII", "Discrete", "Control", "ReferencePGN", "DTC", "StringDelimiter", "StringLength", "StringLengthControl", "MessageCounter", "MessageChecksum";
BA_DEF_ SG_ "GenSigSendType" ENUM "Cyclic", "OnWrite", "OnWriteWithRepetition", "OnChange", "OnChangeWithRepetition", "IfActive", "IfActiveWithRepetition", "NoSigSendType";
BA_DEF_ SG_ "GenSigTimeoutTime_ECU" INT 0 3600000;
BA_DEF_ SG_ "GenSigILSupport" ENUM "Yes", "No";
BA_DEF_ SG_ "GenSigEVName" STRING ;
BA_DEF_ BO_ "GenMsgILSupport" ENUM "Yes", "No";
BA_DEF_ BO_ "GenMsgSendType" ENUM "cyclic", "reserved", "cyclicIfActive", "reserved", "reserved", "reserved", "reserved", "reserved", "NoMsgSendType";
BA_DEF_ BO_ "VFrameFormat" ENUM "StandardCAN", "ExtendedCAN", "reserved", "J1939PG";
BA_DEF_ BO_ "SingleFrame" INT 0 1;
BA_DEF_ BO_ "GenMsgCycleTime" INT 0 3600000;
BA_DEF_ BO_ "GenMsgCycleTimeFast" INT 0 3600000;
BA_DEF_DEF_ "SigType" "Default";
BA_DEF_DEF_ "GenSigSendType" "NoSigSendType";
BA_DEF_DEF_ "GenSigTimeoutTime_ECU" 0;
BA_DEF_DEF_ "GenSigILSupport" "Yes";
BA_DEF_DEF_ "GenSigEVName" "Env@Nodename_@Signame";
BA_DEF_DEF_ "GenMsgILSupport" "Yes";
BA_DEF_DEF_ "GenMsgSendType" "NoMsgSendType";
BA_DEF_DEF_ "VFrameFormat" "J1939PG";
BA_DEF_DEF_ "SingleFrame" 0;
BA_DEF_DEF_ "GenMsgCycleTime" 0;
BA_DEF_DEF_ "GenMsgCycleTimeFast" 0;
BA_ "GenSigTimeoutTime_ECU" SG_ 2298477147 CmdBytePGN65530_POD 500;
BA_ "GenSigTimeoutTime_ECU" SG_ 2298477147 CoolingFanAdjDesiredSpeed 500;
BA_ "GenSigSendType" SG_ 2298477147 CoolingFanAdjDesiredSpeed 0;
BA_ "GenSigTimeoutTime_ECU" SG_ 2298477147 CoolingFanSpeedRPM 500;
BA_ "GenSigSendType" SG_ 2298477147 CoolingFanSpeedRPM 0;
BA_ "GenSigTimeoutTime_ECU" SG_ 2298477147 MaxControllableCoolingFanSpeed 500;
BA_ "GenSigSendType" SG_ 2298477147 MaxControllableCoolingFanSpeed 0;
BA_ "GenSigTimeoutTime_ECU" SG_ 2298477147 CoolingFanSystemRequestor 500;
BA_ "GenSigSendType" SG_ 2298477147 CoolingFanSystemRequestor 0;
BA_ "GenSigTimeoutTime_ECU" SG_ 2298477147 CoolingFanControlModeState 500;
BA_ "GenSigSendType" SG_ 2298477147 CoolingFanControlModeState 0;
BA_ "GenSigTimeoutTime_ECU" SG_ 2298477147 CoolingFanSolenoidDutyCycle 500;
BA_ "GenSigSendType" SG_ 2298477147 CoolingFanSolenoidDutyCycle 0;
BA_ "GenSigTimeoutTime_ECU" SG_ 2298477147 CoolingFanSolenoidFrequency 500;
BA_ "GenSigSendType" SG_ 2298477147 CoolingFanSolenoidFrequency 0;
BA_ "GenSigTimeoutTime_ECU" SG_ 2298477147 CoolingFanFaultedRequestor 500;
BA_ "GenSigSendType" SG_ 2298477147 CoolingFanFaultedRequestor 0;
BA_ "GenSigTimeoutTime_ECU" SG_ 2565823486 CmdBytePGN61184_Vector_XXX 5000;
BA_ "GenSigTimeoutTime_ECU" SG_ 2565823486 EngTorqueDerateSetpnt 5000;
BA_ "GenSigSendType" SG_ 2565823486 EngTorqueDerateSetpnt 0;
BA_ "GenSigTimeoutTime_ECU" SG_ 2499803739 CmdBytePGN65530_POD 5000;
BA_ "GenSigTimeoutTime_ECU" SG_ 2499803739 EngFuelTankCap 5000;
BA_ "GenSigSendType" SG_ 2499803739 EngFuelTankCap 0;
BA_ "GenSigTimeoutTime_ECU" SG_ 2499803739 HydrCharPresSensStat 5000;
BA_ "GenSigSendType" SG_ 2499803739 HydrCharPresSensStat 0;
BA_ "GenSigTimeoutTime_ECU" SG_ 2499803739 MainGearcaseOilTemp 5000;
BA_ "GenSigSendType" SG_ 2499803739 MainGearcaseOilTemp 0;
BA_ "GenSigTimeoutTime_ECU" SG_ 2499803739 MaxEngineSpeedRequest 5000;
BA_ "GenSigSendType" SG_ 2499803739 MaxEngineSpeedRequest 0;
BA_ "GenSigTimeoutTime_ECU" SG_ 2499803739 MinEngineSpeedRequest 5000;
BA_ "GenSigSendType" SG_ 2499803739 MinEngineSpeedRequest 0;
BA_ "GenSigTimeoutTime_ECU" SG_ 2499803739 EngineSpeedManagementActive 5000;
BA_ "GenSigSendType" SG_ 2499803739 EngineSpeedManagementActive 0;
BA_ "GenSigTimeoutTime_ECU" SG_ 2499803739 SPRAnchorThreshold 5000;
BA_ "GenSigSendType" SG_ 2499803739 SPRAnchorThreshold 0;
BA_ "GenSigTimeoutTime_ECU" SG_ 2499803739 SPRTorqueOffset 5000;
BA_ "GenSigSendType" SG_ 2499803739 SPRTorqueOffset 0;
BA_ "GenSigTimeoutTime_ECU" SG_ 2499803739 TotalTorqueOffset 5000;
BA_ "GenSigSendType" SG_ 2499803739 TotalTorqueOffset 0;
BA_ "GenSigTimeoutTime_ECU" SG_ 2499803739 CoolantTempPercent 5000;
BA_ "GenSigSendType" SG_ 2499803739 CoolantTempPercent 0;
BA_ "GenSigTimeoutTime_ECU" SG_ 2499803739 VehicleTrailerStatus 5000;
BA_ "GenSigSendType" SG_ 2499803739 VehicleTrailerStatus 0;
BA_ "GenSigTimeoutTime_ECU" SG_ 2499803739 FourWDStatus 5000;
BA_ "GenSigSendType" SG_ 2499803739 FourWDStatus 0;
BA_ "GenSigTimeoutTime_ECU" SG_ 2499803739 DiffLockState 5000;
BA_ "GenSigSendType" SG_ 2499803739 DiffLockState 0;
BA_ "GenSigTimeoutTime_ECU" SG_ 2499803995 CmdBytePGN65531_POD 5000;
BA_ "GenSigTimeoutTime_ECU" SG_ 2499803995 ParkBrakeManuallyEngagedSts 5000;
BA_ "GenSigSendType" SG_ 2499803995 ParkBrakeManuallyEngagedSts 0;
BA_ "GenSigTimeoutTime_ECU" SG_ 2499803995 DisplayedEnginePowerHighRes 5000;
BA_ "GenSigSendType" SG_ 2499803995 DisplayedEnginePowerHighRes 0;
BA_ "GenSigTimeoutTime_ECU" SG_ 2499803995 ACClutchInhibit 5000;
BA_ "GenSigSendType" SG_ 2499803995 ACClutchInhibit 0;
BA_ "GenSigTimeoutTime_ECU" SG_ 2298477290 CmdBytePGN65530_FED 500;
BA_ "GenSigTimeoutTime_ECU" SG_ 2298477290 DomainPcompRequestFED 500;
BA_ "GenSigSendType" SG_ 2298477290 DomainPcompRequestFED 0;
BA_ "GenSigTimeoutTime_ECU" SG_ 2298477290 DomainPcompRequest2FED 500;
BA_ "GenSigSendType" SG_ 2298477290 DomainPcompRequest2FED 0;
BA_ "GenSigTimeoutTime_ECU" SG_ 2298477290 DomainSpecificPressureRequestFED 500;
BA_ "GenSigSendType" SG_ 2298477290 DomainSpecificPressureRequestFED 0;
BA_ "GenSigTimeoutTime_ECU" SG_ 2298477290 DomaSpecPresRequ2FED 500;
BA_ "GenSigSendType" SG_ 2298477290 DomaSpecPresRequ2FED 0;
BA_ "GenSigTimeoutTime_ECU" SG_ 2566913002 CmdBytePGN65531_FED 5000;
BA_ "GenSigTimeoutTime_ECU" SG_ 2566913002 HeaderRaiseMechanicalDelay 5000;
BA_ "GenSigSendType" SG_ 2566913002 HeaderRaiseMechanicalDelay 0;
BA_ "GenSigTimeoutTime_ECU" SG_ 2566913002 HeaderLowerMechanicalDelay 5000;
BA_ "GenSigSendType" SG_ 2566913002 HeaderLowerMechanicalDelay 0;
BA_ "GenSigTimeoutTime_ECU" SG_ 2566913002 HeaderLeadingEdge 5000;
BA_ "GenSigSendType" SG_ 2566913002 HeaderLeadingEdge 0;
BA_ "GenSigTimeoutTime_ECU" SG_ 2566913002 HeaderTrailingEdge 5000;
BA_ "GenSigSendType" SG_ 2566913002 HeaderTrailingEdge 0;
BA_ "GenSigTimeoutTime_ECU" SG_ 2566913002 DustFanSpd 5000;
BA_ "GenSigSendType" SG_ 2566913002 DustFanSpd 0;
BA_ "GenSigTimeoutTime_ECU" SG_ 2566913002 DustFanSpdSnsrSts 5000;
BA_ "GenSigSendType" SG_ 2566913002 DustFanSpdSnsrSts 0;
BA_ "GenSigTimeoutTime_ECU" SG_ 2566913002 HdrTransptModState 5000;
BA_ "GenSigSendType" SG_ 2566913002 HdrTransptModState 0;
BA_ "GenSigTimeoutTime_ECU" SG_ 2566913002 LateralTiltSensorStatus 5000;
BA_ "GenSigSendType" SG_ 2566913002 LateralTiltSensorStatus 0;
BA_ "GenSigTimeoutTime_ECU" SG_ 2566913022 CmdBytePGN65531_Vector_XXX 5000;
BA_ "GenSigTimeoutTime_ECU" SG_ 2566913022 LiftPumpMeasuredSpeed 5000;
BA_ "GenSigSendType" SG_ 2566913022 LiftPumpMeasuredSpeed 0;
BA_ "GenSigTimeoutTime_ECU" SG_ 2566913022 LiftPumpCommandedSpeed 5000;
BA_ "GenSigSendType" SG_ 2566913022 LiftPumpCommandedSpeed 0;
BA_ "GenSigTimeoutTime_ECU" SG_ 2566913022 LiftPumpCurrent 5000;
BA_ "GenSigSendType" SG_ 2566913022 LiftPumpCurrent 0;
BA_ "GenSigTimeoutTime_ECU" SG_ 2566913022 DEFPumpSpeedCommand 5000;
BA_ "GenSigSendType" SG_ 2566913022 DEFPumpSpeedCommand 0;
BA_ "GenSigTimeoutTime_ECU" SG_ 2566913022 DEFSupplyModulePressure 5000;
BA_ "GenSigSendType" SG_ 2566913022 DEFSupplyModulePressure 0;
BA_ "GenSigTimeoutTime_ECU" SG_ 2566913022 RightFlasherHdrLightFaultState 5000;
BA_ "GenSigSendType" SG_ 2566913022 RightFlasherHdrLightFaultState 0;
BA_ "GenSigTimeoutTime_ECU" SG_ 2566913022 LeftFlasherHdrLightFaultState 5000;
BA_ "GenSigSendType" SG_ 2566913022 LeftFlasherHdrLightFaultState 0;
BA_ "GenSigTimeoutTime_ECU" SG_ 2566913022 GSAMaxVehSpdLim 5000;
BA_ "GenSigSendType" SG_ 2566913022 GSAMaxVehSpdLim 0;
BA_ "GenSigTimeoutTime_ECU" SG_ 2566913022 GSATransmissionPower 5000;
BA_ "GenSigSendType" SG_ 2566913022 GSATransmissionPower 0;
BA_ "GenSigTimeoutTime_ECU" SG_ 2566913022 ReelRaisLowrPosnFb 5000;
BA_ "GenSigSendType" SG_ 2566913022 ReelRaisLowrPosnFb 0;
BA_ "GenSigTimeoutTime_ECU" SG_ 2566913022 ReelForeAftPosnFb 5000;
BA_ "GenSigSendType" SG_ 2566913022 ReelForeAftPosnFb 0;
BA_ "GenSigTimeoutTime_ECU" SG_ 2566913022 HdrFlexWingDraperVrnt 5000;
BA_ "GenSigSendType" SG_ 2566913022 HdrFlexWingDraperVrnt 0;
BA_ "GenSigTimeoutTime_ECU" SG_ 2566913022 DraperBltProtnInstldOptn 5000;
BA_ "GenSigSendType" SG_ 2566913022 DraperBltProtnInstldOptn 0;
BA_ "GenSigTimeoutTime_ECU" SG_ 2499803882 CmdBytePGN65530_FED 5000;
BA_ "GenSigTimeoutTime_ECU" SG_ 2499803882 ClearBlockageEngagementState 5000;
BA_ "GenSigSendType" SG_ 2499803882 ClearBlockageEngagementState 0;
BA_ "GenSigTimeoutTime_ECU" SG_ 2499803882 EngThrottleOverrideRequestFED 5000;
BA_ "GenSigSendType" SG_ 2499803882 EngThrottleOverrideRequestFED 0;
BA_ "GenSigTimeoutTime_ECU" SG_ 2499803882 SepDisengageOverrideRequestFED 5000;
BA_ "GenSigSendType" SG_ 2499803882 SepDisengageOverrideRequestFED 0;
BA_ "GenSigTimeoutTime_ECU" SG_ 2499804138 CmdBytePGN65531_FED 5000;
BA_ "GenSigTimeoutTime_ECU" SG_ 2499804138 ForeAftTiltPosn 5000;
BA_ "GenSigSendType" SG_ 2499804138 ForeAftTiltPosn 0;
BA_ "GenSigTimeoutTime_ECU" SG_ 2499804138 BackshaftSpeedSnsrSts 5000;
BA_ "GenSigSendType" SG_ 2499804138 BackshaftSpeedSnsrSts 0;
BA_ "GenSigTimeoutTime_ECU" SG_ 2499804138 HeadRaisLoweEngaContStat 5000;
BA_ "GenSigSendType" SG_ 2499804138 HeadRaisLoweEngaContStat 0;
BA_ "GenSigTimeoutTime_ECU" SG_ 2499804138 HeadRaisLoweResuSetpInte 5000;
BA_ "GenSigSendType" SG_ 2499804138 HeadRaisLoweResuSetpInte 0;
BA_ "GenSigTimeoutTime_ECU" SG_ 2499804138 WingPosnStToMainBus 5000;
BA_ "GenSigSendType" SG_ 2499804138 WingPosnStToMainBus 0;
BA_ "GenSigTimeoutTime_ECU" SG_ 2499804138 WingLvlgMstOptnToMainBus 5000;
BA_ "GenSigSendType" SG_ 2499804138 WingLvlgMstOptnToMainBus 0;
BA_ "GenSigTimeoutTime_ECU" SG_ 2499804138 TopAugTypInstldDispToMainBus 5000;
BA_ "GenSigSendType" SG_ 2499804138 TopAugTypInstldDispToMainBus 0;
BA_ "GenSigTimeoutTime_ECU" SG_ 2499804138 GaugeWhlOptnDispToMainBus 5000;
BA_ "GenSigSendType" SG_ 2499804138 GaugeWhlOptnDispToMainBus 0;
BA_ "GenSigTimeoutTime_ECU" SG_ 2499804138 InteTranInstDispToMainBus 5000;
BA_ "GenSigSendType" SG_ 2499804138 InteTranInstDispToMainBus 0;
BA_ "GenSigTimeoutTime_ECU" SG_ 2499804138 SideKnivesInstldDispToMainBus 5000;
BA_ "GenSigSendType" SG_ 2499804138 SideKnivesInstldDispToMainBus 0;
BA_ "GenSigTimeoutTime_ECU" SG_ 2499804138 CropLifterInstldDispToMainBus 5000;
BA_ "GenSigSendType" SG_ 2499804138 CropLifterInstldDispToMainBus 0;
BA_ "GenSigTimeoutTime_ECU" SG_ 2499804138 HdrHrsTotal 5000;
BA_ "GenSigSendType" SG_ 2499804138 HdrHrsTotal 0;
BA_ "GenSigTimeoutTime_ECU" SG_ 2499804138 OdometerStyleHdrHrCntrEna 5000;
BA_ "GenSigSendType" SG_ 2499804138 OdometerStyleHdrHrCntrEna 0;
BA_ "GenSigTimeoutTime_ECU" SG_ 2566912746 CmdBytePGN65530_FED 5000;
BA_ "GenSigTimeoutTime_ECU" SG_ 2566912746 LeftGaugeWheelPositionSensor1 5000;
BA_ "GenSigSendType" SG_ 2566912746 LeftGaugeWheelPositionSensor1 0;
BA_ "GenSigTimeoutTime_ECU" SG_ 2566912746 LeftGaugeWheelPositionSensor2 5000;
BA_ "GenSigSendType" SG_ 2566912746 LeftGaugeWheelPositionSensor2 0;
BA_ "GenSigTimeoutTime_ECU" SG_ 2566912746 RightGaugeWheelPositionSensor1 5000;
BA_ "GenSigSendType" SG_ 2566912746 RightGaugeWheelPositionSensor1 0;
BA_ "GenSigTimeoutTime_ECU" SG_ 2566912746 RightGaugeWheelPositionSensor2 5000;
BA_ "GenSigSendType" SG_ 2566912746 RightGaugeWheelPositionSensor2 0;
BA_ "GenSigTimeoutTime_ECU" SG_ 2566912746 HeaderGaugeWhlOptnEnbld 5000;
BA_ "GenSigSendType" SG_ 2566912746 HeaderGaugeWhlOptnEnbld 0;
BA_ "GenSigTimeoutTime_ECU" SG_ 2566912746 HeaderFoldOptnEnbld 5000;
BA_ "GenSigSendType" SG_ 2566912746 HeaderFoldOptnEnbld 0;
BA_ "GenSigTimeoutTime_ECU" SG_ 2566912746 ReelInstalledOptEnbld 5000;
BA_ "GenSigSendType" SG_ 2566912746 ReelInstalledOptEnbld 0;
BA_ "GenSigTimeoutTime_ECU" SG_ 2566912746 DraperBltInstalledOptEnbld 5000;
BA_ "GenSigSendType" SG_ 2566912746 DraperBltInstalledOptEnbld 0;
BA_ "GenSigTimeoutTime_ECU" SG_ 2566912746 CutrbarPosnCtrlEnbld 5000;
BA_ "GenSigSendType" SG_ 2566912746 CutrbarPosnCtrlEnbld 0;
BA_ "GenSigTimeoutTime_ECU" SG_ 2566912746 WingLvlgMstOptnToVehBus 5000;
BA_ "GenSigSendType" SG_ 2566912746 WingLvlgMstOptnToVehBus 0;
BA_ "GenSigTimeoutTime_ECU" SG_ 2566912746 WorkLight21RightStatus 5000;
BA_ "GenSigSendType" SG_ 2566912746 WorkLight21RightStatus 0;
BA_ "GenSigTimeoutTime_ECU" SG_ 2566912746 HarvestSetpointInfoRequestB1 5000;
BA_ "GenSigTimeoutTime_ECU" SG_ 2499803174 CmdBytePGN65528_VTV 5000;
BA_ "GenSigTimeoutTime_ECU" SG_ 2499803174 GraiBypaPercDamaGraiFilt1 5000;
BA_ "GenSigSendType" SG_ 2499803174 GraiBypaPercDamaGraiFilt1 0;
BA_ "GenSigTimeoutTime_ECU" SG_ 2499803174 GraiBypaPercDamaGraiFilt2 5000;
BA_ "GenSigSendType" SG_ 2499803174 GraiBypaPercDamaGraiFilt2 0;
BA_ "GenSigTimeoutTime_ECU" SG_ 2499803174 GraiBypaPercLighMOGFilt1 5000;
BA_ "GenSigSendType" SG_ 2499803174 GraiBypaPercLighMOGFilt1 0;
BA_ "GenSigTimeoutTime_ECU" SG_ 2499803174 GraiBypaPercLighMOGFilt2 5000;
BA_ "GenSigSendType" SG_ 2499803174 GraiBypaPercLighMOGFilt2 0;
BA_ "GenSigTimeoutTime_ECU" SG_ 2499803174 GraiBypaPercHeavMOGFilt1 5000;
BA_ "GenSigSendType" SG_ 2499803174 GraiBypaPercHeavMOGFilt1 0;
BA_ "GenSigTimeoutTime_ECU" SG_ 2499803174 GraiBypaPercHeavMOGFilt2 5000;
BA_ "GenSigSendType" SG_ 2499803174 GraiBypaPercHeavMOGFilt2 0;
BA_ "GenSigTimeoutTime_ECU" SG_ 2499803174 GraiBypaPercUnthGraiFilt1 5000;
BA_ "GenSigSendType" SG_ 2499803174 GraiBypaPercUnthGraiFilt1 0;
BA_ "GenSigTimeoutTime_ECU" SG_ 2499803174 GraiBypaPercUnthGraiFilt2 5000;
BA_ "GenSigSendType" SG_ 2499803174 GraiBypaPercUnthGraiFilt2 0;
BA_ "GenSigTimeoutTime_ECU" SG_ 2499803883 CmdBytePGN65530_HAD 5000;
BA_ "GenSigTimeoutTime_ECU" SG_ 2499803883 UnloadingAugerLength 5000;
BA_ "GenSigSendType" SG_ 2499803883 UnloadingAugerLength 0;
BA_ "GenSigTimeoutTime_ECU" SG_ 2499803883 UnloadingAugerFold 5000;
BA_ "GenSigSendType" SG_ 2499803883 UnloadingAugerFold 0;
BA_ "GenSigTimeoutTime_ECU" SG_ 2499803883 RotationalAlarmCommand 5000;
BA_ "GenSigSendType" SG_ 2499803883 RotationalAlarmCommand 0;
BA_ "GenSigTimeoutTime_ECU" SG_ 2499803883 RotationalAlarmFlashRate 5000;
BA_ "GenSigSendType" SG_ 2499803883 RotationalAlarmFlashRate 0;
BA_ "GenSigTimeoutTime_ECU" SG_ 2499803883 EngThrottleOverrideRequestHAD 5000;
BA_ "GenSigSendType" SG_ 2499803883 EngThrottleOverrideRequestHAD 0;
BA_ "GenSigTimeoutTime_ECU" SG_ 2499803883 HdrDisengageOverrideRequestHAD 5000;
BA_ "GenSigSendType" SG_ 2499803883 HdrDisengageOverrideRequestHAD 0;
BA_ "GenSigTimeoutTime_ECU" SG_ 2566911014 CmdBytePGN65524_VTV 5000;
BA_ "GenSigTimeoutTime_ECU" SG_ 2566911014 SeparatorGrainLossFilter1 5000;
BA_ "GenSigSendType" SG_ 2566911014 SeparatorGrainLossFilter1 0;
BA_ "GenSigTimeoutTime_ECU" SG_ 2566911014 SeparatorGrainLossFilter2 5000;
BA_ "GenSigSendType" SG_ 2566911014 SeparatorGrainLossFilter2 0;
BA_ "GenSigTimeoutTime_ECU" SG_ 2566911014 CleanShoeGrainLossFilter1 5000;
BA_ "GenSigSendType" SG_ 2566911014 CleanShoeGrainLossFilter1 0;
BA_ "GenSigTimeoutTime_ECU" SG_ 2566911014 CleanShoeGrainLossFilter2 5000;
BA_ "GenSigSendType" SG_ 2566911014 CleanShoeGrainLossFilter2 0;
BA_ "GenSigTimeoutTime_ECU" SG_ 2566911014 IC2SteadyState 5000;
BA_ "GenSigSendType" SG_ 2566911014 IC2SteadyState 0;
BA_ "GenSigTimeoutTime_ECU" SG_ 2566911014 IC2Enabled 5000;
BA_ "GenSigSendType" SG_ 2566911014 IC2Enabled 0;
BA_ "GenSigTimeoutTime_ECU" SG_ 2566911014 IC2ShortTermStatusSepLoss 5000;
BA_ "GenSigSendType" SG_ 2566911014 IC2ShortTermStatusSepLoss 0;
BA_ "GenSigTimeoutTime_ECU" SG_ 2566911014 IC2LongTermStatusSepLoss 5000;
BA_ "GenSigSendType" SG_ 2566911014 IC2LongTermStatusSepLoss 0;
BA_ "GenSigTimeoutTime_ECU" SG_ 2566911014 IC2ShortTermStatusShLoss 5000;
BA_ "GenSigSendType" SG_ 2566911014 IC2ShortTermStatusShLoss 0;
BA_ "GenSigTimeoutTime_ECU" SG_ 2566911014 IC2LongTermStatusShLoss 5000;
BA_ "GenSigSendType" SG_ 2566911014 IC2LongTermStatusShLoss 0;
BA_ "GenSigTimeoutTime_ECU" SG_ 2566911014 IC2DiagHighestActiveFault 5000;
BA_ "GenSigSendType" SG_ 2566911014 IC2DiagHighestActiveFault 0;
BA_ "GenSigTimeoutTime_ECU" SG_ 2566911014 IC2DiagFaultState 5000;
BA_ "GenSigSendType" SG_ 2566911014 IC2DiagFaultState 0;
BA_ "GenSigTimeoutTime_ECU" SG_ 2566911014 IC2ShortTermStatusCropGap 5000;
BA_ "GenSigSendType" SG_ 2566911014 IC2ShortTermStatusCropGap 0;
BA_ "GenSigTimeoutTime_ECU" SG_ 2566911014 IC2DiagNumActiveFaults 5000;
BA_ "GenSigSendType" SG_ 2566911014 IC2DiagNumActiveFaults 0;
BA_ "GenSigTimeoutTime_ECU" SG_ 2566911014 SteeringResponseRate 5000;
BA_ "GenSigSendType" SG_ 2566911014 SteeringResponseRate 0;
BA_ "GenSigTimeoutTime_ECU" SG_ 2566911014 GPSMsgRate 5000;
BA_ "GenSigSendType" SG_ 2566911014 GPSMsgRate 0;
BA_ "GenSigTimeoutTime_ECU" SG_ 2566911014 AutoTracWheelbase_GSCJDE 5000;
BA_ "GenSigSendType" SG_ 2566911014 AutoTracWheelbase_GSCJDE 0;
BA_ "GenSigTimeoutTime_ECU" SG_ 2566911014 InnerLoopGain 5000;
BA_ "GenSigSendType" SG_ 2566911014 InnerLoopGain 0;
BA_ "GenSigTimeoutTime_ECU" SG_ 2566911014 AT2ExitCode_GSCJDE 5000;
BA_ "GenSigSendType" SG_ 2566911014 AT2ExitCode_GSCJDE 0;
BA_ "GenSigTimeoutTime_ECU" SG_ 2566911014 CrvtrCntrlATState_GSCJDE 5000;
BA_ "GenSigSendType" SG_ 2566911014 CrvtrCntrlATState_GSCJDE 0;
BA_ "GenSigTimeoutTime_ECU" SG_ 2566911014 Heartbeat 5000;
BA_ "GenSigSendType" SG_ 2566911014 Heartbeat 0;
BA_ "GenSigTimeoutTime_ECU" SG_ 2566911014 SensorType_LESC 5000;
BA_ "GenSigSendType" SG_ 2566911014 SensorType_LESC 0;
BA_ "GenSigTimeoutTime_ECU" SG_ 2566911014 CalibrationRequest_LESC 5000;
BA_ "GenSigSendType" SG_ 2566911014 CalibrationRequest_LESC 0;
BA_ "GenSigTimeoutTime_ECU" SG_ 2566911014 SensorBias_LESC 5000;
BA_ "GenSigSendType" SG_ 2566911014 SensorBias_LESC 0;
BA_ "GenSigTimeoutTime_ECU" SG_ 2566911014 NewImageCountSteadyState 5000;
BA_ "GenSigSendType" SG_ 2566911014 NewImageCountSteadyState 0;
BA_ "GenSigTimeoutTime_ECU" SG_ 2566911014 ImageCountRateWithoutSteadyState 5000;
BA_ "GenSigSendType" SG_ 2566911014 ImageCountRateWithoutSteadyState 0;
BA_ "GenSigTimeoutTime_ECU" SG_ 2566911014 NewImageCountWithoutSteadyState 5000;
BA_ "GenSigSendType" SG_ 2566911014 NewImageCountWithoutSteadyState 0;
BA_ "GenSigTimeoutTime_ECU" SG_ 2566911014 HdrWidthInUse 5000;
BA_ "GenSigSendType" SG_ 2566911014 HdrWidthInUse 0;
BA_ "GenSigTimeoutTime_ECU" SG_ 2432695787 CmdBytePGN65533_HAD 2500;
BA_ "GenSigTimeoutTime_ECU" SG_ 2432695787 GlmController2Input1Error 2500;
BA_ "GenSigSendType" SG_ 2432695787 GlmController2Input1Error 0;
BA_ "GenSigTimeoutTime_ECU" SG_ 2432695787 GlmController2Input2Error 2500;
BA_ "GenSigSendType" SG_ 2432695787 GlmController2Input2Error 0;
BA_ "GenSigTimeoutTime_ECU" SG_ 2432695787 GlmController2Input3Error 2500;
BA_ "GenSigSendType" SG_ 2432695787 GlmController2Input3Error 0;
BA_ "GenSigTimeoutTime_ECU" SG_ 2432695787 GlmController2Input4Error 2500;
BA_ "GenSigSendType" SG_ 2432695787 GlmController2Input4Error 0;
BA_ "GenSigTimeoutTime_ECU" SG_ 2432695787 GlmController1Input1Error 2500;
BA_ "GenSigSendType" SG_ 2432695787 GlmController1Input1Error 0;
BA_ "GenSigTimeoutTime_ECU" SG_ 2432695787 GlmController1Input2Error 2500;
BA_ "GenSigSendType" SG_ 2432695787 GlmController1Input2Error 0;
BA_ "GenSigTimeoutTime_ECU" SG_ 2432695787 GlmController1Input3Error 2500;
BA_ "GenSigSendType" SG_ 2432695787 GlmController1Input3Error 0;
BA_ "GenSigTimeoutTime_ECU" SG_ 2432695787 GlmController1Input4Error 2500;
BA_ "GenSigSendType" SG_ 2432695787 GlmController1Input4Error 0;
BA_ "GenSigTimeoutTime_ECU" SG_ 2432695787 GlmController2Error 2500;
BA_ "GenSigSendType" SG_ 2432695787 GlmController2Error 0;
BA_ "GenSigTimeoutTime_ECU" SG_ 2432695787 GlmController1Error 2500;
BA_ "GenSigSendType" SG_ 2432695787 GlmController1Error 0;
BA_ "GenSigTimeoutTime_ECU" SG_ 2432695787 GlmController1Input1Type 2500;
BA_ "GenSigSendType" SG_ 2432695787 GlmController1Input1Type 0;
BA_ "GenSigTimeoutTime_ECU" SG_ 2432695787 GlmController1Input2Type 2500;
BA_ "GenSigSendType" SG_ 2432695787 GlmController1Input2Type 0;
BA_ "GenSigTimeoutTime_ECU" SG_ 2432695787 GlmController1Input3Type 2500;
BA_ "GenSigSendType" SG_ 2432695787 GlmController1Input3Type 0;
BA_ "GenSigTimeoutTime_ECU" SG_ 2432695787 GlmController1Input4Type 2500;
BA_ "GenSigSendType" SG_ 2432695787 GlmController1Input4Type 0;
BA_ "GenSigTimeoutTime_ECU" SG_ 2432695787 GlmController2Input1Type 2500;
BA_ "GenSigSendType" SG_ 2432695787 GlmController2Input1Type 0;
BA_ "GenSigTimeoutTime_ECU" SG_ 2432695787 GlmController2Input2Type 2500;
BA_ "GenSigSendType" SG_ 2432695787 GlmController2Input2Type 0;
BA_ "GenSigTimeoutTime_ECU" SG_ 2432695787 GlmController2Input3Type 2500;
BA_ "GenSigSendType" SG_ 2432695787 GlmController2Input3Type 0;
BA_ "GenSigTimeoutTime_ECU" SG_ 2432695787 GlmController2Input4Type 2500;
BA_ "GenSigSendType" SG_ 2432695787 GlmController2Input4Type 0;
BA_ "GenSigTimeoutTime_ECU" SG_ 2566912806 CmdBytePGN65531_VTV 5000;
BA_ "GenSigTimeoutTime_ECU" SG_ 2566912806 ShoeLossValue 5000;
BA_ "GenSigSendType" SG_ 2566912806 ShoeLossValue 0;
BA_ "GenSigTimeoutTime_ECU" SG_ 2566912806 SeparatorLossValue 5000;
BA_ "GenSigSendType" SG_ 2566912806 SeparatorLossValue 0;
BA_ "GenSigTimeoutTime_ECU" SG_ 2566912806 GrainLossLimit 5000;
BA_ "GenSigSendType" SG_ 2566912806 GrainLossLimit 0;
BA_ "GenSigTimeoutTime_ECU" SG_ 2566912254 CmdBytePGN65528_Vector_XXX 8000;
BA_ "GenSigTimeoutTime_ECU" SG_ 2566912254 TimeRemaPresAftrSCRInduLvl 8000;
BA_ "GenSigSendType" SG_ 2566912254 TimeRemaPresAftrSCRInduLvl 0;
BA_ "GenSigTimeoutTime_ECU" SG_ 2566912254 LatErr 8000;
BA_ "GenSigSendType" SG_ 2566912254 LatErr 0;
BA_ "GenSigTimeoutTime_ECU" SG_ 2566912254 HeadErr 8000;
BA_ "GenSigSendType" SG_ 2566912254 HeadErr 0;
BA_ "GenSigTimeoutTime_ECU" SG_ 2566912254 Curv 8000;
BA_ "GenSigSendType" SG_ 2566912254 Curv 0;
BA_ "GenSigTimeoutTime_ECU" SG_ 2566912254 Confidence 8000;
BA_ "GenSigSendType" SG_ 2566912254 Confidence 0;
BA_ "GenSigTimeoutTime_ECU" SG_ 2566912254 SensorType_LESD 8000;
BA_ "GenSigSendType" SG_ 2566912254 SensorType_LESD 0;
BA_ "GenSigTimeoutTime_ECU" SG_ 2566912254 LatErrAugBits 8000;
BA_ "GenSigSendType" SG_ 2566912254 LatErrAugBits 0;
BA_ "GenSigTimeoutTime_ECU" SG_ 2566912254 CurvAugBits 8000;
BA_ "GenSigSendType" SG_ 2566912254 CurvAugBits 0;
BA_ "GenSigTimeoutTime_ECU" SG_ 2566912254 GrainBypassMotorStatus 8000;
BA_ "GenSigSendType" SG_ 2566912254 GrainBypassMotorStatus 0;
BA_ "GenSigTimeoutTime_ECU" SG_ 2298477350 CmdBytePGN65531_VTV 400;
BA_ "GenSigTimeoutTime_ECU" SG_ 2298477350 GSACommandStatus 400;
BA_ "GenSigSendType" SG_ 2298477350 GSACommandStatus 0;
BA_ "GenSigTimeoutTime_ECU" SG_ 2298477350 GSACommandSpeed 400;
BA_ "GenSigSendType" SG_ 2298477350 GSACommandSpeed 0;
BA_ "GenSigTimeoutTime_ECU" SG_ 2565865451 CmdBytePGN61184_HAD 5000;
BA_ "GenSigTimeoutTime_ECU" SG_ 2565865451 PGNRqstProp 5000;
BA_ "GenSigTimeoutTime_ECU" SG_ 2565865451 REQPGNCMDBYTE1 5000;
BA_ "GenSigTimeoutTime_ECU" SG_ 2565865451 PGNRqstProp 5000;
BA_ "GenSigTimeoutTime_ECU" SG_ 2565865451 REQPGNCMDBYTE1 5000;
BA_ "GenSigTimeoutTime_ECU" SG_ 2565865451 REQPGNCMDBYTE2 5000;
BA_ "GenSigTimeoutTime_ECU" SG_ 2565865451 OpCtrlB2RspByte5BitQuad14 5000;
BA_ "GenSigSendType" SG_ 2565865451 OpCtrlB2RspByte5BitQuad14 0;
BA_ "GenSigTimeoutTime_ECU" SG_ 2565865451 OpCtrlB2RspByte8BitQuad14 5000;
BA_ "GenSigSendType" SG_ 2565865451 OpCtrlB2RspByte8BitQuad14 0;
BA_ "GenSigTimeoutTime_ECU" SG_ 2565865451 Capability_1_JD_CAN_2016 5000;
BA_ "GenSigTimeoutTime_ECU" SG_ 2565865451 Capa2JDExteMultLega 5000;
BA_ "GenSigTimeoutTime_ECU" SG_ 2565865451 Capa3J193973DiagMess 5000;
BA_ "GenSigTimeoutTime_ECU" SG_ 2565865451 Capability4UDSDiagnosticMessages 5000;
BA_ "GenSigTimeoutTime_ECU" SG_ 2565865451 Capa5JDNetwHealMess 5000;
BA_ "GenSigTimeoutTime_ECU" SG_ 2565865451 Capa6J193974JDConfMess 5000;
BA_ "GenSigTimeoutTime_ECU" SG_ 2565865451 Capa7J193974SAEConfMess 5000;
BA_ "GenSigTimeoutTime_ECU" SG_ 2565865451 Capability8J193974ShortResponse 5000;
BA_ "GenSigTimeoutTime_ECU" SG_ 2565865451 Capability9J193974LongResponse 5000;
BA_ "GenSigTimeoutTime_ECU" SG_ 2565865451 Capability_10 5000;
BA_ "GenSigTimeoutTime_ECU" SG_ 2565865451 Capability_11 5000;
BA_ "GenSigTimeoutTime_ECU" SG_ 2565865451 Capability_12 5000;
BA_ "GenSigTimeoutTime_ECU" SG_ 2565865451 Capability_13 5000;
BA_ "GenSigTimeoutTime_ECU" SG_ 2565865451 Capability_14 5000;
BA_ "GenSigTimeoutTime_ECU" SG_ 2565865451 Capability_15 5000;
BA_ "GenSigTimeoutTime_ECU" SG_ 2565865451 Capability_16 5000;
BA_ "GenSigTimeoutTime_ECU" SG_ 2565865451 Capability_17 5000;
BA_ "GenSigTimeoutTime_ECU" SG_ 2565865451 Capability_18 5000;
BA_ "GenSigTimeoutTime_ECU" SG_ 2565865451 Capability_19 5000;
BA_ "GenSigTimeoutTime_ECU" SG_ 2565865451 Capability_20 5000;
BA_ "GenSigTimeoutTime_ECU" SG_ 2565865451 Capability_21 5000;
BA_ "GenSigTimeoutTime_ECU" SG_ 2565865451 Capability_22 5000;
BA_ "GenSigTimeoutTime_ECU" SG_ 2565865451 Capability_23 5000;
BA_ "GenSigTimeoutTime_ECU" SG_ 2565865451 Capability_24 5000;
BA_ "GenSigTimeoutTime_ECU" SG_ 2565865451 OpCtrlB3RspByte6BitQuad58 5000;
BA_ "GenSigSendType" SG_ 2565865451 OpCtrlB3RspByte6BitQuad58 0;
BA_ "GenSigTimeoutTime_ECU" SG_ 2565865451 OpCtrlB5RspByte6BitQuad58 5000;
BA_ "GenSigSendType" SG_ 2565865451 OpCtrlB5RspByte6BitQuad58 0;
BA_ "GenSigTimeoutTime_ECU" SG_ 2565865451 OpCtrlB6RspByte3BitQuad14 5000;
BA_ "GenSigSendType" SG_ 2565865451 OpCtrlB6RspByte3BitQuad14 0;
BA_ "GenSigTimeoutTime_ECU" SG_ 2565865451 RespHarvSetpAdjuB1 5000;
BA_ "GenSigTimeoutTime_ECU" SG_ 2565865451 KnifeBnkPosn 5000;
BA_ "GenSigSendType" SG_ 2565865451 KnifeBnkPosn 0;
BA_ "GenSigTimeoutTime_ECU" SG_ 2565865451 ChopWindrowState 5000;
BA_ "GenSigSendType" SG_ 2565865451 ChopWindrowState 0;
BA_ "GenSigTimeoutTime_ECU" SG_ 2565865451 ChopperState 5000;
BA_ "GenSigSendType" SG_ 2565865451 ChopperState 0;
BA_ "GenSigTimeoutTime_ECU" SG_ 2565865451 GLM1StrikeRate4 5000;
BA_ "GenSigSendType" SG_ 2565865451 GLM1StrikeRate4 0;
BA_ "GenSigTimeoutTime_ECU" SG_ 2565865451 GLM2StrikeRate4 5000;
BA_ "GenSigSendType" SG_ 2565865451 GLM2StrikeRate4 0;
BA_ "GenSigTimeoutTime_ECU" SG_ 2565865451 GLM1StrikeRate1 5000;
BA_ "GenSigSendType" SG_ 2565865451 GLM1StrikeRate1 0;
BA_ "GenSigTimeoutTime_ECU" SG_ 2565865451 GLM1StrikeRate2 5000;
BA_ "GenSigSendType" SG_ 2565865451 GLM1StrikeRate2 0;
BA_ "GenSigTimeoutTime_ECU" SG_ 2565865451 GLM1StrikeRate3 5000;
BA_ "GenSigSendType" SG_ 2565865451 GLM1StrikeRate3 0;
BA_ "GenSigTimeoutTime_ECU" SG_ 2565865451 GLM2StrikeRate1 5000;
BA_ "GenSigSendType" SG_ 2565865451 GLM2StrikeRate1 0;
BA_ "GenSigTimeoutTime_ECU" SG_ 2565865451 GLM2StrikeRate2 5000;
BA_ "GenSigSendType" SG_ 2565865451 GLM2StrikeRate2 0;
BA_ "GenSigTimeoutTime_ECU" SG_ 2565865451 GLM2StrikeRate3 5000;
BA_ "GenSigSendType" SG_ 2565865451 GLM2StrikeRate3 0;
BA_ "GenSigTimeoutTime_ECU" SG_ 2565865451 CANTailingsElevatorType 5000;
BA_ "GenSigSendType" SG_ 2565865451 CANTailingsElevatorType 0;
BA_ "GenSigTimeoutTime_ECU" SG_ 2565865451 ShoeChafferElmntType 5000;
BA_ "GenSigSendType" SG_ 2565865451 ShoeChafferElmntType 0;
BA_ "GenSigTimeoutTime_ECU" SG_ 2565865451 ShoeSieveElmntType 5000;
BA_ "GenSigSendType" SG_ 2565865451 ShoeSieveElmntType 0;
BA_ "GenSigTimeoutTime_ECU" SG_ 2565865451 GrainTankUnldngRate 5000;
BA_ "GenSigSendType" SG_ 2565865451 GrainTankUnldngRate 0;
BA_ "GenSigTimeoutTime_ECU" SG_ 2565865451 GrainTankUnldngRateOffset 5000;
BA_ "GenSigSendType" SG_ 2565865451 GrainTankUnldngRateOffset 0;
BA_ "GenSigTimeoutTime_ECU" SG_ 2565865451 ChopWindrowEnaSt 5000;
BA_ "GenSigSendType" SG_ 2565865451 ChopWindrowEnaSt 0;
BA_ "GenSigTimeoutTime_ECU" SG_ 2565865451 CANVehSpcFrontLight1FaultState 5000;
BA_ "GenSigSendType" SG_ 2565865451 CANVehSpcFrontLight1FaultState 0;
BA_ "GenSigTimeoutTime_ECU" SG_ 2565865451 CANVehSpcSideLight1FaultState 5000;
BA_ "GenSigSendType" SG_ 2565865451 CANVehSpcSideLight1FaultState 0;
BA_ "GenSigTimeoutTime_ECU" SG_ 2566913003 CmdBytePGN65531_HAD 5000;
BA_ "GenSigTimeoutTime_ECU" SG_ 2566913003 AmbientAirTemp 5000;
BA_ "GenSigSendType" SG_ 2566913003 AmbientAirTemp 0;
BA_ "GenSigTimeoutTime_ECU" SG_ 2566913003 FeedAccelSnsrSts 5000;
BA_ "GenSigSendType" SG_ 2566913003 FeedAccelSnsrSts 0;
BA_ "GenSigTimeoutTime_ECU" SG_ 2566913003 ChassisForeAftTiltCalDone 5000;
BA_ "GenSigSendType" SG_ 2566913003 ChassisForeAftTiltCalDone 0;
BA_ "GenSigTimeoutTime_ECU" SG_ 2566913003 ChassisForeAftTiltPstn 5000;
BA_ "GenSigSendType" SG_ 2566913003 ChassisForeAftTiltPstn 0;
BA_ "GenSigTimeoutTime_ECU" SG_ 2566913003 ChassisForeAftTiltSnsrSts 5000;
BA_ "GenSigSendType" SG_ 2566913003 ChassisForeAftTiltSnsrSts 0;
BA_ "GenSigTimeoutTime_ECU" SG_ 2566913003 GrainTankAccumulatedMass 5000;
BA_ "GenSigSendType" SG_ 2566913003 GrainTankAccumulatedMass 0;
BA_ "GenSigTimeoutTime_ECU" SG_ 2566913003 HillmasterSystemMode 5000;
BA_ "GenSigSendType" SG_ 2566913003 HillmasterSystemMode 0;
BA_ "GenSigTimeoutTime_ECU" SG_ 2566913003 HillMasterTiltRequest 5000;
BA_ "GenSigSendType" SG_ 2566913003 HillMasterTiltRequest 0;
BA_ "GenSigTimeoutTime_ECU" SG_ 2297429995 CmdBytePGN61184_HAD 500;
BA_ "GenSigTimeoutTime_ECU" SG_ 2297429995 ThreshingSpeed 500;
BA_ "GenSigSendType" SG_ 2297429995 ThreshingSpeed 0;
BA_ "GenSigTimeoutTime_ECU" SG_ 2297429995 ThreshingClearance 500;
BA_ "GenSigSendType" SG_ 2297429995 ThreshingClearance 0;
BA_ "GenSigTimeoutTime_ECU" SG_ 2297429995 RotorGear 500;
BA_ "GenSigSendType" SG_ 2297429995 RotorGear 0;
BA_ "GenSigTimeoutTime_ECU" SG_ 2297429995 SeparatorDrive 500;
BA_ "GenSigSendType" SG_ 2297429995 SeparatorDrive 0;
BA_ "GenSigTimeoutTime_ECU" SG_ 2297429995 TlngsVol 500;
BA_ "GenSigSendType" SG_ 2297429995 TlngsVol 0;
BA_ "GenSigTimeoutTime_ECU" SG_ 2297429995 SystemPressureAchievable 500;
BA_ "GenSigSendType" SG_ 2297429995 SystemPressureAchievable 0;
BA_ "GenSigTimeoutTime_ECU" SG_ 2297429995 SystemPressure2Achievable 500;
BA_ "GenSigSendType" SG_ 2297429995 SystemPressure2Achievable 0;
BA_ "GenSigTimeoutTime_ECU" SG_ 2297429995 RotorDrvT 500;
BA_ "GenSigSendType" SG_ 2297429995 RotorDrvT 0;
BA_ "GenSigTimeoutTime_ECU" SG_ 2365585457 CmdBytePGN65528_CAB 1000;
BA_ "GenSigTimeoutTime_ECU" SG_ 2365585457 HarvEngageCmds 1000;
BA_ "GenSigSendType" SG_ 2365585457 HarvEngageCmds 0;
BA_ "GenSigTimeoutTime_ECU" SG_ 2365585457 HarvEngageCmds2 1000;
BA_ "GenSigSendType" SG_ 2365585457 HarvEngageCmds2 0;
BA_ "GenSigTimeoutTime_ECU" SG_ 2566911211 CmdBytePGN65524_HAD 5000;
BA_ "GenSigTimeoutTime_ECU" SG_ 2566911211 HarvestSmartEnable 5000;
BA_ "GenSigSendType" SG_ 2566911211 HarvestSmartEnable 0;
BA_ "GenSigTimeoutTime_ECU" SG_ 2566911211 ActiveTerrainAdjustEnable 5000;
BA_ "GenSigSendType" SG_ 2566911211 ActiveTerrainAdjustEnable 0;
BA_ "GenSigTimeoutTime_ECU" SG_ 2566911211 IntelligentCombineAdjustOption 5000;
BA_ "GenSigSendType" SG_ 2566911211 IntelligentCombineAdjustOption 0;
BA_ "GenSigTimeoutTime_ECU" SG_ 2566911211 MoistureSensorType 5000;
BA_ "GenSigSendType" SG_ 2566911211 MoistureSensorType 0;
BA_ "GenSigTimeoutTime_ECU" SG_ 2566911211 ForwardLookingPerceptionOption 5000;
BA_ "GenSigSendType" SG_ 2566911211 ForwardLookingPerceptionOption 0;
BA_ "GenSigTimeoutTime_ECU" SG_ 2566911211 AutomationUXOption 5000;
BA_ "GenSigSendType" SG_ 2566911211 AutomationUXOption 0;
BA_ "GenSigTimeoutTime_ECU" SG_ 2566911211 HillmasterInstalledOption 5000;
BA_ "GenSigSendType" SG_ 2566911211 HillmasterInstalledOption 0;
BA_ "GenSigTimeoutTime_ECU" SG_ 2566911211 ChassisForeAftSensorInstalled 5000;
BA_ "GenSigSendType" SG_ 2566911211 ChassisForeAftSensorInstalled 0;
BA_ "GenSigTimeoutTime_ECU" SG_ 2566911211 GrainBypassOption 5000;
BA_ "GenSigSendType" SG_ 2566911211 GrainBypassOption 0;
BA_ "GenSigTimeoutTime_ECU" SG_ 2499804906 CmdBytePGN65534_FED 5000;
BA_ "GenSigTimeoutTime_ECU" SG_ 2499804906 HdrBkshaftSpd 5000;
BA_ "GenSigSendType" SG_ 2499804906 HdrBkshaftSpd 0;
BA_ "GenSigTimeoutTime_ECU" SG_ 2499804906 ReelSpd 5000;
BA_ "GenSigSendType" SG_ 2499804906 ReelSpd 0;
BA_ "GenSigTimeoutTime_ECU" SG_ 2499804906 FdrhseHeight 5000;
BA_ "GenSigSendType" SG_ 2499804906 FdrhseHeight 0;
BA_ "GenSigTimeoutTime_ECU" SG_ 2499804906 HdrPltfrmHeight 5000;
BA_ "GenSigSendType" SG_ 2499804906 HdrPltfrmHeight 0;
BA_ "GenSigTimeoutTime_ECU" SG_ 2499804906 FdrhseHeightPrcnt 5000;
BA_ "GenSigSendType" SG_ 2499804906 FdrhseHeightPrcnt 0;
BA_ "GenSigTimeoutTime_ECU" SG_ 2499804906 HdrRecrdStopHeight 5000;
BA_ "GenSigSendType" SG_ 2499804906 HdrRecrdStopHeight 0;
BA_ "GenSigTimeoutTime_ECU" SG_ 2365585969 CmdBytePGN65530_CAB 1000;
BA_ "GenSigTimeoutTime_ECU" SG_ 2365585969 HarvEngageCmdOnSignalInput 1000;
BA_ "GenSigSendType" SG_ 2365585969 HarvEngageCmdOnSignalInput 0;
BA_ "GenSigTimeoutTime_ECU" SG_ 2365585969 HarvEngageCmd2OnSignalInput 1000;
BA_ "GenSigSendType" SG_ 2365585969 HarvEngageCmd2OnSignalInput 0;
BA_ "GenSigTimeoutTime_ECU" SG_ 2498756606 CmdBytePGN61184_Vector_XXX 5000;
BA_ "GenSigTimeoutTime_ECU" SG_ 2498756606 HdrAuxResumeTogReq 5000;
BA_ "GenSigSendType" SG_ 2498756606 HdrAuxResumeTogReq 0;
BA_ "GenSigTimeoutTime_ECU" SG_ 2566913534 CmdBytePGN65533_Vector_XXX 5000;
BA_ "GenSigTimeoutTime_ECU" SG_ 2566913534 HdrWidthFromHeader 5000;
BA_ "GenSigSendType" SG_ 2566913534 HdrWidthFromHeader 0;
BA_ "GenSigTimeoutTime_ECU" SG_ 2566913534 NmbrRowsFromHeader 5000;
BA_ "GenSigSendType" SG_ 2566913534 NmbrRowsFromHeader 0;
BA_ "GenSigTimeoutTime_ECU" SG_ 2566913534 MaxHeaderAuxFlowRateFromHeader 5000;
BA_ "GenSigSendType" SG_ 2566913534 MaxHeaderAuxFlowRateFromHeader 0;
BA_ "GenSigTimeoutTime_ECU" SG_ 2499805182 CmdBytePGN65535_Vector_XXX 5000;
BA_ "GenSigTimeoutTime_ECU" SG_ 2499805182 ReelPositionActive 5000;
BA_ "GenSigSendType" SG_ 2499805182 ReelPositionActive 0;
BA_ "GenSigTimeoutTime_ECU" SG_ 2499805182 AutoClearDTCTime 5000;
BA_ "GenSigSendType" SG_ 2499805182 AutoClearDTCTime 0;
BA_ "GenSigTimeoutTime_ECU" SG_ 2499805162 CmdBytePGN65535_FED 5000;
BA_ "GenSigTimeoutTime_ECU" SG_ 2499805162 HdrHeightActResumeNmbr 5000;
BA_ "GenSigSendType" SG_ 2499805162 HdrHeightActResumeNmbr 0;
BA_ "GenSigTimeoutTime_ECU" SG_ 2499805162 SelctdDigDisp 5000;
BA_ "GenSigSendType" SG_ 2499805162 SelctdDigDisp 0;
BA_ "GenSigTimeoutTime_ECU" SG_ 2499805162 DialSpdRatio 5000;
BA_ "GenSigSendType" SG_ 2499805162 DialSpdRatio 0;
BA_ "GenSigTimeoutTime_ECU" SG_ 2499805162 HdrPstnMaxPrcnt 5000;
BA_ "GenSigSendType" SG_ 2499805162 HdrPstnMaxPrcnt 0;
BA_ "GenSigTimeoutTime_ECU" SG_ 2499805162 HdrPstnPrcnt 5000;
BA_ "GenSigSendType" SG_ 2499805162 HdrPstnPrcnt 0;
BA_ "GenSigTimeoutTime_ECU" SG_ 2499805162 PltfrmFlexPressSnsr 5000;
BA_ "GenSigSendType" SG_ 2499805162 PltfrmFlexPressSnsr 0;
BA_ "GenSigTimeoutTime_ECU" SG_ 2499805162 HdrLiftCylPressHiRes 5000;
BA_ "GenSigSendType" SG_ 2499805162 HdrLiftCylPressHiRes 0;
BA_ "GenSigTimeoutTime_ECU" SG_ 2499805162 HdrWidth 5000;
BA_ "GenSigSendType" SG_ 2499805162 HdrWidth 0;
BA_ "GenSigTimeoutTime_ECU" SG_ 2499805162 NmbrRows 5000;
BA_ "GenSigSendType" SG_ 2499805162 NmbrRows 0;
BA_ "GenSigTimeoutTime_ECU" SG_ 2499802366 CmdBytePGN65524_Vector_XXX 5000;
BA_ "GenSigTimeoutTime_ECU" SG_ 2499802366 IC2ShortTermStatusDmgdGrain 5000;
BA_ "GenSigSendType" SG_ 2499802366 IC2ShortTermStatusDmgdGrain 0;
BA_ "GenSigTimeoutTime_ECU" SG_ 2499802366 IC2LongTermStatusDmgdGrain 5000;
BA_ "GenSigSendType" SG_ 2499802366 IC2LongTermStatusDmgdGrain 0;
BA_ "GenSigTimeoutTime_ECU" SG_ 2499802366 IC2ShortTermStatusMOGL 5000;
BA_ "GenSigSendType" SG_ 2499802366 IC2ShortTermStatusMOGL 0;
BA_ "GenSigTimeoutTime_ECU" SG_ 2499802366 IC2LongTermStatusMOGL 5000;
BA_ "GenSigSendType" SG_ 2499802366 IC2LongTermStatusMOGL 0;
BA_ "GenSigTimeoutTime_ECU" SG_ 2499802366 IC2ShortTermStatusMOGH 5000;
BA_ "GenSigSendType" SG_ 2499802366 IC2ShortTermStatusMOGH 0;
BA_ "GenSigTimeoutTime_ECU" SG_ 2499802366 IC2LongTermStatusMOGH 5000;
BA_ "GenSigSendType" SG_ 2499802366 IC2LongTermStatusMOGH 0;
BA_ "GenSigTimeoutTime_ECU" SG_ 2499802366 IC2ShortTermStatusUnthrGrain 5000;
BA_ "GenSigSendType" SG_ 2499802366 IC2ShortTermStatusUnthrGrain 0;
BA_ "GenSigTimeoutTime_ECU" SG_ 2499802366 IC2LongTermStatusUnthrGrain 5000;
BA_ "GenSigSendType" SG_ 2499802366 IC2LongTermStatusUnthrGrain 0;
BA_ "GenSigTimeoutTime_ECU" SG_ 2499802366 IC2ShortTermStatusTlngsVol 5000;
BA_ "GenSigSendType" SG_ 2499802366 IC2ShortTermStatusTlngsVol 0;
BA_ "GenSigTimeoutTime_ECU" SG_ 2566914026 CmdBytePGN65535_FED 5000;
BA_ "GenSigTimeoutTime_ECU" SG_ 2566914026 ActVehicleCal 5000;
BA_ "GenSigSendType" SG_ 2566914026 ActVehicleCal 0;
BA_ "GenSigTimeoutTime_ECU" SG_ 2566914026 CalStep 5000;
BA_ "GenSigSendType" SG_ 2566914026 CalStep 0;
BA_ "GenSigTimeoutTime_ECU" SG_ 2566913830 CmdBytePGN65535_VTV 5000;
BA_ "GenSigTimeoutTime_ECU" SG_ 2566913830 ActiveTerrainAdjustEnable 5000;
BA_ "GenSigSendType" SG_ 2566913830 ActiveTerrainAdjustEnable 0;
BA_ "GenSigTimeoutTime_ECU" SG_ 2566913830 ReqVehicleCal 5000;
BA_ "GenSigSendType" SG_ 2566913830 ReqVehicleCal 0;
BA_ "GenSigTimeoutTime_ECU" SG_ 2566913830 CalMode 5000;
BA_ "GenSigSendType" SG_ 2566913830 CalMode 0;
BA_ "GenSigTimeoutTime_ECU" SG_ 2565865307 CmdBytePGN61184_POD 5000;
BA_ "GenSigTimeoutTime_ECU" SG_ 2565865307 PGNRqstProp 5000;
BA_ "GenSigTimeoutTime_ECU" SG_ 2565865307 REQPGNCMDBYTE1 5000;
BA_ "GenSigTimeoutTime_ECU" SG_ 2565865307 PGNRqstProp 5000;
BA_ "GenSigTimeoutTime_ECU" SG_ 2565865307 REQPGNCMDBYTE1 5000;
BA_ "GenSigTimeoutTime_ECU" SG_ 2565865307 REQPGNCMDBYTE2 5000;
BA_ "GenSigTimeoutTime_ECU" SG_ 2565865307 Capability_1_JD_CAN_2016 5000;
BA_ "GenSigTimeoutTime_ECU" SG_ 2565865307 Capa2JDExteMultLega 5000;
BA_ "GenSigTimeoutTime_ECU" SG_ 2565865307 Capa3J193973DiagMess 5000;
BA_ "GenSigTimeoutTime_ECU" SG_ 2565865307 Capability4UDSDiagnosticMessages 5000;
BA_ "GenSigTimeoutTime_ECU" SG_ 2565865307 Capa5JDNetwHealMess 5000;
BA_ "GenSigTimeoutTime_ECU" SG_ 2565865307 Capa6J193974JDConfMess 5000;
BA_ "GenSigTimeoutTime_ECU" SG_ 2565865307 Capa7J193974SAEConfMess 5000;
BA_ "GenSigTimeoutTime_ECU" SG_ 2565865307 Capability8J193974ShortResponse 5000;
BA_ "GenSigTimeoutTime_ECU" SG_ 2565865307 Capability9J193974LongResponse 5000;
BA_ "GenSigTimeoutTime_ECU" SG_ 2565865307 Capability_10 5000;
BA_ "GenSigTimeoutTime_ECU" SG_ 2565865307 Capability_11 5000;
BA_ "GenSigTimeoutTime_ECU" SG_ 2565865307 Capability_12 5000;
BA_ "GenSigTimeoutTime_ECU" SG_ 2565865307 Capability_13 5000;
BA_ "GenSigTimeoutTime_ECU" SG_ 2565865307 Capability_14 5000;
BA_ "GenSigTimeoutTime_ECU" SG_ 2565865307 Capability_15 5000;
BA_ "GenSigTimeoutTime_ECU" SG_ 2565865307 Capability_16 5000;
BA_ "GenSigTimeoutTime_ECU" SG_ 2565865307 Capability_17 5000;
BA_ "GenSigTimeoutTime_ECU" SG_ 2565865307 Capability_18 5000;
BA_ "GenSigTimeoutTime_ECU" SG_ 2565865307 Capability_19 5000;
BA_ "GenSigTimeoutTime_ECU" SG_ 2565865307 Capability_20 5000;
BA_ "GenSigTimeoutTime_ECU" SG_ 2565865307 Capability_21 5000;
BA_ "GenSigTimeoutTime_ECU" SG_ 2565865307 Capability_22 5000;
BA_ "GenSigTimeoutTime_ECU" SG_ 2565865307 Capability_23 5000;
BA_ "GenSigTimeoutTime_ECU" SG_ 2565865307 Capability_24 5000;
BA_ "GenSigTimeoutTime_ECU" SG_ 2565865307 IOExpOutputPinState3DutyCycle 5000;
BA_ "GenSigSendType" SG_ 2565865307 IOExpOutputPinState3DutyCycle 0;
BA_ "GenSigTimeoutTime_ECU" SG_ 2565865307 IOExpOutputPinState3Frequency 5000;
BA_ "GenSigSendType" SG_ 2565865307 IOExpOutputPinState3Frequency 0;
BA_ "GenSigTimeoutTime_ECU" SG_ 2565865307 IOExpOutputPinState3CurrentFbk 5000;
BA_ "GenSigSendType" SG_ 2565865307 IOExpOutputPinState3CurrentFbk 0;
BA_ "GenSigTimeoutTime_ECU" SG_ 2565865307 IOExpOutputPinState3Status 5000;
BA_ "GenSigSendType" SG_ 2565865307 IOExpOutputPinState3Status 0;
BA_ "GenSigTimeoutTime_ECU" SG_ 2565865307 OpCtrlB3RspByte3BitQuad14 5000;
BA_ "GenSigSendType" SG_ 2565865307 OpCtrlB3RspByte3BitQuad14 0;
BA_ "GenSigTimeoutTime_ECU" SG_ 2565865307 OpCtrlB3RspByte3BitQuad58 5000;
BA_ "GenSigSendType" SG_ 2565865307 OpCtrlB3RspByte3BitQuad58 0;
BA_ "GenSigTimeoutTime_ECU" SG_ 2565865307 OpCtrlB3RspByte4BitQuad14 5000;
BA_ "GenSigSendType" SG_ 2565865307 OpCtrlB3RspByte4BitQuad14 0;
BA_ "GenSigTimeoutTime_ECU" SG_ 2565865307 OpCtrlB3RspByte4BitQuad58 5000;
BA_ "GenSigSendType" SG_ 2565865307 OpCtrlB3RspByte4BitQuad58 0;
BA_ "GenSigTimeoutTime_ECU" SG_ 2565865307 OpCtrlB3RspByte5BitQuad14 5000;
BA_ "GenSigSendType" SG_ 2565865307 OpCtrlB3RspByte5BitQuad14 0;
BA_ "GenSigTimeoutTime_ECU" SG_ 2565865307 OpCtrlB3RspByte6BitQuad14 5000;
BA_ "GenSigSendType" SG_ 2565865307 OpCtrlB3RspByte6BitQuad14 0;
BA_ "GenSigTimeoutTime_ECU" SG_ 2565865307 OpCtrlB3RspByte7BitQuad14 5000;
BA_ "GenSigSendType" SG_ 2565865307 OpCtrlB3RspByte7BitQuad14 0;
BA_ "GenSigTimeoutTime_ECU" SG_ 2565865307 OpCtrlB3RspByte7BitQuad58 5000;
BA_ "GenSigSendType" SG_ 2565865307 OpCtrlB3RspByte7BitQuad58 0;
BA_ "GenSigTimeoutTime_ECU" SG_ 2565865307 OpCtrlB3RspByte8BitQuad14 5000;
BA_ "GenSigSendType" SG_ 2565865307 OpCtrlB3RspByte8BitQuad14 0;
BA_ "GenSigTimeoutTime_ECU" SG_ 2565865307 OpCtrlB3RspByte8BitQuad58 5000;
BA_ "GenSigSendType" SG_ 2565865307 OpCtrlB3RspByte8BitQuad58 0;
BA_ "GenSigTimeoutTime_ECU" SG_ 2565865307 ActvtnCount 5000;
BA_ "GenSigTimeoutTime_ECU" SG_ 2565865307 SeqNumber 5000;
BA_ "GenSigTimeoutTime_ECU" SG_ 2565865307 ScanCodeElm0 5000;
BA_ "GenSigTimeoutTime_ECU" SG_ 2565865307 ScanCodeElm1 5000;
BA_ "GenSigTimeoutTime_ECU" SG_ 2565865307 ScanCodeElm2 5000;
BA_ "GenSigTimeoutTime_ECU" SG_ 2565865307 ScanCodeElm3 5000;
BA_ "GenSigTimeoutTime_ECU" SG_ 2565865307 ScanCodeElm4 5000;
BA_ "GenSigTimeoutTime_ECU" SG_ 2565865307 OpCtrlB5RspByte5BitQuad14 5000;
BA_ "GenSigSendType" SG_ 2565865307 OpCtrlB5RspByte5BitQuad14 0;
BA_ "GenSigTimeoutTime_ECU" SG_ 2565865307 OpCtrlB5RspByte6BitQuad14 5000;
BA_ "GenSigSendType" SG_ 2565865307 OpCtrlB5RspByte6BitQuad14 0;
BA_ "GenSigTimeoutTime_ECU" SG_ 2565865307 OpCtrlB5RspByte7BitQuad14 5000;
BA_ "GenSigSendType" SG_ 2565865307 OpCtrlB5RspByte7BitQuad14 0;
BA_ "GenSigTimeoutTime_ECU" SG_ 2565865307 CurrentGearRange 5000;
BA_ "GenSigSendType" SG_ 2565865307 CurrentGearRange 0;
BA_ "GenSigTimeoutTime_ECU" SG_ 2565865307 ProDriveTransMode 5000;
BA_ "GenSigSendType" SG_ 2565865307 ProDriveTransMode 0;
BA_ "GenSigTimeoutTime_ECU" SG_ 2565865307 ParkBrakeStateAutomatic 5000;
BA_ "GenSigSendType" SG_ 2565865307 ParkBrakeStateAutomatic 0;
BA_ "GenSigTimeoutTime_ECU" SG_ 2565865307 ParkLock 5000;
BA_ "GenSigSendType" SG_ 2565865307 ParkLock 0;
BA_ "GenSigTimeoutTime_ECU" SG_ 2565865307 LowFuelLevelAlarm 5000;
BA_ "GenSigSendType" SG_ 2565865307 LowFuelLevelAlarm 0;
BA_ "GenSigTimeoutTime_ECU" SG_ 2565865307 TireSizeFrntOnly 5000;
BA_ "GenSigSendType" SG_ 2565865307 TireSizeFrntOnly 0;
BA_ "GenSigTimeoutTime_ECU" SG_ 2565865307 CANVehSpcRearLight1FaultState 5000;
BA_ "GenSigSendType" SG_ 2565865307 CANVehSpcRearLight1FaultState 0;
BA_ "GenSigTimeoutTime_ECU" SG_ 2565865307 LeftFlasherLightFaultState 5000;
BA_ "GenSigSendType" SG_ 2565865307 LeftFlasherLightFaultState 0;
BA_ "GenSigTimeoutTime_ECU" SG_ 2565865307 RightFlasherLightFaultState 5000;
BA_ "GenSigSendType" SG_ 2565865307 RightFlasherLightFaultState 0;
BA_ "GenSigTimeoutTime_ECU" SG_ 2565865416 CmdBytePGN61184_DC1 60000;
BA_ "GenSigTimeoutTime_ECU" SG_ 2565865416 PGNRqstProp 60000;
BA_ "GenSigTimeoutTime_ECU" SG_ 2565865416 REQPGNCMDBYTE1 60000;
BA_ "GenSigTimeoutTime_ECU" SG_ 2565865416 PGNRqstProp 60000;
BA_ "GenSigTimeoutTime_ECU" SG_ 2565865416 REQPGNCMDBYTE1 60000;
BA_ "GenSigTimeoutTime_ECU" SG_ 2565865416 REQPGNCMDBYTE2 60000;
BA_ "GenSigTimeoutTime_ECU" SG_ 2565865450 CmdBytePGN61184_FED 60000;
BA_ "GenSigTimeoutTime_ECU" SG_ 2565865450 PGNRqstProp 60000;
BA_ "GenSigTimeoutTime_ECU" SG_ 2565865450 REQPGNCMDBYTE1 60000;
BA_ "GenSigTimeoutTime_ECU" SG_ 2565865450 PGNRqstProp 60000;
BA_ "GenSigTimeoutTime_ECU" SG_ 2565865450 REQPGNCMDBYTE1 60000;
BA_ "GenSigTimeoutTime_ECU" SG_ 2565865450 REQPGNCMDBYTE2 60000;
BA_ "GenSigTimeoutTime_ECU" SG_ 2565865450 Capability_1_JD_CAN_2016 60000;
BA_ "GenSigTimeoutTime_ECU" SG_ 2565865450 Capa2JDExteMultLega 60000;
BA_ "GenSigTimeoutTime_ECU" SG_ 2565865450 Capa3J193973DiagMess 60000;
BA_ "GenSigTimeoutTime_ECU" SG_ 2565865450 Capability4UDSDiagnosticMessages 60000;
BA_ "GenSigTimeoutTime_ECU" SG_ 2565865450 Capa5JDNetwHealMess 60000;
BA_ "GenSigTimeoutTime_ECU" SG_ 2565865450 Capa6J193974JDConfMess 60000;
BA_ "GenSigTimeoutTime_ECU" SG_ 2565865450 Capa7J193974SAEConfMess 60000;
BA_ "GenSigTimeoutTime_ECU" SG_ 2565865450 Capability8J193974ShortResponse 60000;
BA_ "GenSigTimeoutTime_ECU" SG_ 2565865450 Capability9J193974LongResponse 60000;
BA_ "GenSigTimeoutTime_ECU" SG_ 2565865450 Capability_10 60000;
BA_ "GenSigTimeoutTime_ECU" SG_ 2565865450 Capability_11 60000;
BA_ "GenSigTimeoutTime_ECU" SG_ 2565865450 Capability_12 60000;
BA_ "GenSigTimeoutTime_ECU" SG_ 2565865450 Capability_13 60000;
BA_ "GenSigTimeoutTime_ECU" SG_ 2565865450 Capability_14 60000;
BA_ "GenSigTimeoutTime_ECU" SG_ 2565865450 Capability_15 60000;
BA_ "GenSigTimeoutTime_ECU" SG_ 2565865450 Capability_16 60000;
BA_ "GenSigTimeoutTime_ECU" SG_ 2565865450 Capability_17 60000;
BA_ "GenSigTimeoutTime_ECU" SG_ 2565865450 Capability_18 60000;
BA_ "GenSigTimeoutTime_ECU" SG_ 2565865450 Capability_19 60000;
BA_ "GenSigTimeoutTime_ECU" SG_ 2565865450 Capability_20 60000;
BA_ "GenSigTimeoutTime_ECU" SG_ 2565865450 Capability_21 60000;
BA_ "GenSigTimeoutTime_ECU" SG_ 2565865450 Capability_22 60000;
BA_ "GenSigTimeoutTime_ECU" SG_ 2565865450 Capability_23 60000;
BA_ "GenSigTimeoutTime_ECU" SG_ 2565865450 Capability_24 60000;
BA_ "GenSigTimeoutTime_ECU" SG_ 2565865450 RespHarvSetpAdjuB1 60000;
BA_ "GenSigTimeoutTime_ECU" SG_ 2565851185 CmdBytePGN61184_CAB 60000;
BA_ "GenSigTimeoutTime_ECU" SG_ 2565859889 CmdBytePGN61184_CAB 60000;
BA_ "GenSigTimeoutTime_ECU" SG_ 2565860145 CmdBytePGN61184_CAB 60000;
BA_ "GenSigTimeoutTime_ECU" SG_ 2565823281 CmdBytePGN61184_CAB 60000;
BA_ "GenSigTimeoutTime_ECU" SG_ 2565812680 CmdBytePGN61184_DC1 60000;
BA_ "GenSigTimeoutTime_ECU" SG_ 2565860040 CmdBytePGN61184_DC1 60000;
BA_ "GenSigTimeoutTime_ECU" SG_ 2565860296 CmdBytePGN61184_DC1 60000;
BA_ "GenSigTimeoutTime_ECU" SG_ 2565823432 CmdBytePGN61184_DC1 60000;
BA_ "GenSigTimeoutTime_ECU" SG_ 2565812714 CmdBytePGN61184_FED 60000;
BA_ "GenSigTimeoutTime_ECU" SG_ 2565851370 CmdBytePGN61184_FED 60000;
BA_ "GenSigTimeoutTime_ECU" SG_ 2565860330 CmdBytePGN61184_FED 60000;
BA_ "GenSigTimeoutTime_ECU" SG_ 2565823466 CmdBytePGN61184_FED 60000;
BA_ "GenSigTimeoutTime_ECU" SG_ 2565812715 CmdBytePGN61184_HAD 60000;
BA_ "GenSigTimeoutTime_ECU" SG_ 2565851371 CmdBytePGN61184_HAD 60000;
BA_ "GenSigTimeoutTime_ECU" SG_ 2565860075 CmdBytePGN61184_HAD 60000;
BA_ "GenSigTimeoutTime_ECU" SG_ 2565823467 CmdBytePGN61184_HAD 60000;
BA_ "GenSigTimeoutTime_ECU" SG_ 2565812571 CmdBytePGN61184_POD 60000;
BA_ "GenSigTimeoutTime_ECU" SG_ 2565851227 CmdBytePGN61184_POD 60000;
BA_ "GenSigTimeoutTime_ECU" SG_ 2565859931 CmdBytePGN61184_POD 60000;
BA_ "GenSigTimeoutTime_ECU" SG_ 2565860187 CmdBytePGN61184_POD 60000;
BA_ "GenSigTimeoutTime_ECU" SG_ 2566912859 CmdBytePGN65531_POD 5000;
BA_ "GenSigTimeoutTime_ECU" SG_ 2566912859 PercentDisplayedEnginePower 5000;
BA_ "GenSigSendType" SG_ 2566912859 PercentDisplayedEnginePower 0;
BA_ "GenSigTimeoutTime_ECU" SG_ 2566912859 DisplayedEnginePowerMode 5000;
BA_ "GenSigSendType" SG_ 2566912859 DisplayedEnginePowerMode 0;
BA_ "GenSigTimeoutTime_ECU" SG_ 2566912859 PowerMeterStartLightGreenA 5000;
BA_ "GenSigSendType" SG_ 2566912859 PowerMeterStartLightGreenA 0;
BA_ "GenSigTimeoutTime_ECU" SG_ 2566912859 PowerMeterStartDarkGreenB 5000;
BA_ "GenSigSendType" SG_ 2566912859 PowerMeterStartDarkGreenB 0;
BA_ "GenSigTimeoutTime_ECU" SG_ 2566912859 PowerMeterStartYellowC 5000;
BA_ "GenSigSendType" SG_ 2566912859 PowerMeterStartYellowC 0;
BA_ "GenSigTimeoutTime_ECU" SG_ 2566912859 PowerMeterStartRedD 5000;
BA_ "GenSigSendType" SG_ 2566912859 PowerMeterStartRedD 0;
BA_ "GenSigTimeoutTime_ECU" SG_ 2566912859 PowerMeterEndRedE 5000;
BA_ "GenSigSendType" SG_ 2566912859 PowerMeterEndRedE 0;
BA_ "GenSigTimeoutTime_ECU" SG_ 2566912859 PowerMeterAutoBarStart 5000;
BA_ "GenSigSendType" SG_ 2566912859 PowerMeterAutoBarStart 0;
BA_ "GenSigTimeoutTime_ECU" SG_ 2566912859 PowerMeterAutoBarEnd 5000;
BA_ "GenSigSendType" SG_ 2566912859 PowerMeterAutoBarEnd 0;
BA_ "GenSigTimeoutTime_ECU" SG_ 2566912859 MissionPowerStatus 5000;
BA_ "GenSigSendType" SG_ 2566912859 MissionPowerStatus 0;
BA_ "GenSigTimeoutTime_ECU" SG_ 2498756602 CmdBytePGN61184_OBT_FA 5000;
BA_ "GenSigTimeoutTime_ECU" SG_ 2498756602 JDEngineTestMode 5000;
BA_ "GenSigSendType" SG_ 2498756602 JDEngineTestMode 0;
BA_ "GenSigTimeoutTime_ECU" SG_ 2498756602 JDEngineTestState 5000;
BA_ "GenSigSendType" SG_ 2498756602 JDEngineTestState 0;
BA_ "GenSigTimeoutTime_ECU" SG_ 2498756602 JDEngineTestActiveType 5000;
BA_ "GenSigSendType" SG_ 2498756602 JDEngineTestActiveType 0;
BA_ "GenSigTimeoutTime_ECU" SG_ 2498756602 JDEngineTestComponentID 5000;
BA_ "GenSigSendType" SG_ 2498756602 JDEngineTestComponentID 0;
BA_ "GenSigTimeoutTime_ECU" SG_ 2498756602 JDEngineTestPercentProgress 5000;
BA_ "GenSigSendType" SG_ 2498756602 JDEngineTestPercentProgress 0;
BA_ "GenSigTimeoutTime_ECU" SG_ 2498756602 HydrocarbonInjectorPurge 5000;
BA_ "GenSigSendType" SG_ 2498756602 HydrocarbonInjectorPurge 0;
BA_ "GenSigTimeoutTime_ECU" SG_ 2498756602 DiesOxidCataServReplComp 5000;
BA_ "GenSigSendType" SG_ 2498756602 DiesOxidCataServReplComp 0;
BA_ "GenSigTimeoutTime_ECU" SG_ 2498756602 DiesPartFiltUninHydrDiagClea 5000;
BA_ "GenSigSendType" SG_ 2498756602 DiesPartFiltUninHydrDiagClea 0;
BA_ "GenSigTimeoutTime_ECU" SG_ 2498756602 DiesOxidCataOutlTempDiagClea 5000;
BA_ "GenSigSendType" SG_ 2498756602 DiesOxidCataOutlTempDiagClea 0;
BA_ "GenSigTimeoutTime_ECU" SG_ 2498756602 DiesOxidCataUninHydrDiagClea 5000;
BA_ "GenSigSendType" SG_ 2498756602 DiesOxidCataUninHydrDiagClea 0;
BA_ "GenSigTimeoutTime_ECU" SG_ 2498756602 DiesPartFiltServReplComp 5000;
BA_ "GenSigSendType" SG_ 2498756602 DiesPartFiltServReplComp 0;
BA_ "GenSigTimeoutTime_ECU" SG_ 2498756602 DiesPartFiltUninHydrDiagClea 5000;
BA_ "GenSigSendType" SG_ 2498756602 DiesPartFiltUninHydrDiagClea 0;
BA_ "GenSigTimeoutTime_ECU" SG_ 2498756602 AfteDiesPartFiltRegeCleaFreqFaul 5000;
BA_ "GenSigSendType" SG_ 2498756602 AfteDiesPartFiltRegeCleaFreqFaul 0;
BA_ "GenSigTimeoutTime_ECU" SG_ 2498756602 ServcRegenReq 5000;
BA_ "GenSigSendType" SG_ 2498756602 ServcRegenReq 0;
BA_ "GenSigTimeoutTime_ECU" SG_ 2498756602 AfteDiesExhaFluiPresContRequ 5000;
BA_ "GenSigSendType" SG_ 2498756602 AfteDiesExhaFluiPresContRequ 0;
BA_ "GenSigTimeoutTime_ECU" SG_ 2498756602 AfteSCRReplRese 5000;
BA_ "GenSigSendType" SG_ 2498756602 AfteSCRReplRese 0;
BA_ "GenSigTimeoutTime_ECU" SG_ 2498756602 AfteDiesPartFiltOutlGasHighTempStatComm 5000;
BA_ "GenSigSendType" SG_ 2498756602 AfteDiesPartFiltOutlGasHighTempStatComm 0;
BA_ "GenSigTimeoutTime_ECU" SG_ 2498756602 AfteDiesExhaFluiTankHeatCoolValvTest 5000;
BA_ "GenSigSendType" SG_ 2498756602 AfteDiesExhaFluiTankHeatCoolValvTest 0;
BA_ "GenSigTimeoutTime_ECU" SG_ 2498756602 AfteDiesExhaFluiSystShutTest 5000;
BA_ "GenSigSendType" SG_ 2498756602 AfteDiesExhaFluiSystShutTest 0;
BA_ "GenSigTimeoutTime_ECU" SG_ 2498756602 AfteDiesExhaFluiInjeDiagTest 5000;
BA_ "GenSigSendType" SG_ 2498756602 AfteDiesExhaFluiInjeDiagTest 0;
BA_ "GenSigTimeoutTime_ECU" SG_ 2498756602 AfteDiesExhaFluiInjeQuanTest 5000;
BA_ "GenSigSendType" SG_ 2498756602 AfteDiesExhaFluiInjeQuanTest 0;
BA_ "GenSigTimeoutTime_ECU" SG_ 2566912747 CmdBytePGN65530_HAD 5000;
BA_ "GenSigTimeoutTime_ECU" SG_ 2566912747 WorkLight4LeftStatus 5000;
BA_ "GenSigSendType" SG_ 2566912747 WorkLight4LeftStatus 0;
BA_ "GenSigTimeoutTime_ECU" SG_ 2566912747 WorkLight10LeftStatus 5000;
BA_ "GenSigSendType" SG_ 2566912747 WorkLight10LeftStatus 0;
BA_ "GenSigTimeoutTime_ECU" SG_ 2566912747 WorkLight22LeftStatus 5000;
BA_ "GenSigSendType" SG_ 2566912747 WorkLight22LeftStatus 0;
BA_ "GenSigTimeoutTime_ECU" SG_ 2566912747 WorkLight4RightStatus 5000;
BA_ "GenSigSendType" SG_ 2566912747 WorkLight4RightStatus 0;
BA_ "GenSigTimeoutTime_ECU" SG_ 2566912747 WorkLight10RightStatus 5000;
BA_ "GenSigSendType" SG_ 2566912747 WorkLight10RightStatus 0;
BA_ "GenSigTimeoutTime_ECU" SG_ 2566912747 WorkLight19RightStatus 5000;
BA_ "GenSigSendType" SG_ 2566912747 WorkLight19RightStatus 0;
BA_ "GenSigTimeoutTime_ECU" SG_ 2566912747 WorkLight20RightStatus 5000;
BA_ "GenSigSendType" SG_ 2566912747 WorkLight20RightStatus 0;
BA_ "GenSigTimeoutTime_ECU" SG_ 2566912747 WorkLight22RightStatus 5000;
BA_ "GenSigSendType" SG_ 2566912747 WorkLight22RightStatus 0;
BA_ "GenSigTimeoutTime_ECU" SG_ 2566912747 HarvestSetpointInfoRequestB1 5000;
BA_ "GenSigTimeoutTime_ECU" SG_ 2565864190 CmdBytePGN61184_Vector_XXX 5000;
BA_ "GenSigTimeoutTime_ECU" SG_ 2565864190 CompressionTest 5000;
BA_ "GenSigSendType" SG_ 2565864190 CompressionTest 0;
BA_ "GenSigTimeoutTime_ECU" SG_ 2565864190 CylinderDiagnostics 5000;
BA_ "GenSigSendType" SG_ 2565864190 CylinderDiagnostics 0;
BA_ "GenSigTimeoutTime_ECU" SG_ 2565864190 CylinderCutoutTest 5000;
BA_ "GenSigSendType" SG_ 2565864190 CylinderCutoutTest 0;
BA_ "GenSigTimeoutTime_ECU" SG_ 2565864190 CylinderDiagnosticsTrigger 5000;
BA_ "GenSigSendType" SG_ 2565864190 CylinderDiagnosticsTrigger 0;
BA_ "GenSigTimeoutTime_ECU" SG_ 2565864190 ActuatorDriverTest 5000;
BA_ "GenSigSendType" SG_ 2565864190 ActuatorDriverTest 0;
BA_ "GenSigTimeoutTime_ECU" SG_ 2565864190 EngiOverShutTestEnab 5000;
BA_ "GenSigSendType" SG_ 2565864190 EngiOverShutTestEnab 0;
BA_ "GenSigTimeoutTime_ECU" SG_ 2565864190 CompressionTestState 5000;
BA_ "GenSigSendType" SG_ 2565864190 CompressionTestState 0;
BA_ "GenSigTimeoutTime_ECU" SG_ 2565864190 CylinderDiagnosticsState 5000;
BA_ "GenSigSendType" SG_ 2565864190 CylinderDiagnosticsState 0;
BA_ "GenSigTimeoutTime_ECU" SG_ 2565864190 CylinderCutoutCylinderNumber 5000;
BA_ "GenSigSendType" SG_ 2565864190 CylinderCutoutCylinderNumber 0;
BA_ "GenSigTimeoutTime_ECU" SG_ 2565864190 ActuatorTestIndex 5000;
BA_ "GenSigSendType" SG_ 2565864190 ActuatorTestIndex 0;
BA_ "GenSigTimeoutTime_ECU" SG_ 2565864190 ActuatorTestType 5000;
BA_ "GenSigSendType" SG_ 2565864190 ActuatorTestType 0;
BA_ "GenSigTimeoutTime_ECU" SG_ 2565864190 ActuatorOutputValue 5000;
BA_ "GenSigSendType" SG_ 2565864190 ActuatorOutputValue 0;
BA_ "GenSigTimeoutTime_ECU" SG_ 2364538878 CmdBytePGN61184_Vector_XXX 5000;
BA_ "GenSigTimeoutTime_ECU" SG_ 2364538878 EngineBrakeTorque 5000;
BA_ "GenSigSendType" SG_ 2364538878 EngineBrakeTorque 0;
BA_ "GenSigTimeoutTime_ECU" SG_ 2566912049 CmdBytePGN65528_CAB 5000;
BA_ "GenSigTimeoutTime_ECU" SG_ 2566912049 MacExtrIllmnOpertTrig 5000;
BA_ "GenSigSendType" SG_ 2566912049 MacExtrIllmnOpertTrig 0;
BA_ "GenSigTimeoutTime_ECU" SG_ 2566912049 LtgModReq 5000;
BA_ "GenSigSendType" SG_ 2566912049 LtgModReq 0;
BA_ "GenSigTimeoutTime_ECU" SG_ 2364538859 CmdBytePGN61184_HAD 1000;
BA_ "GenSigTimeoutTime_ECU" SG_ 2364538859 JDIlluminationBrightnessPercent 1000;
BA_ "GenSigSendType" SG_ 2364538859 JDIlluminationBrightnessPercent 0;
BA_ "GenSigTimeoutTime_ECU" SG_ 2566912216 CmdBytePGN65528_MTU 60000;
BA_ "GenSigTimeoutTime_ECU" SG_ 2566912216 EngStartPrevent 60000;
BA_ "GenSigTimeoutTime_ECU" SG_ 2565865465 CmdBytePGN61184_OBT 60000;
BA_ "GenSigTimeoutTime_ECU" SG_ 2565865466 CmdBytePGN61184_OBT_FA 60000;
BA_ "GenSigTimeoutTime_ECU" SG_ 2565860090 CmdBytePGN61184_OBT_FA 60000;
BA_ "GenSigTimeoutTime_ECU" SG_ 2565860346 CmdBytePGN61184_OBT_FA 60000;
BA_ "GenSigTimeoutTime_ECU" SG_ 2565823482 CmdBytePGN61184_OBT_FA 60000;
BA_ "GenSigTimeoutTime_ECU" SG_ 2565860089 CmdBytePGN61184_OBT 60000;
BA_ "GenSigTimeoutTime_ECU" SG_ 2565860345 CmdBytePGN61184_OBT 60000;
BA_ "GenSigTimeoutTime_ECU" SG_ 2565823481 CmdBytePGN61184_OBT 60000;
BA_ "GenSigTimeoutTime_ECU" SG_ 2431647526 CmdBytePGN61184_VTV 5000;
BA_ "GenSigTimeoutTime_ECU" SG_ 2431647526 AutoSendFlowRate 5000;
BA_ "GenSigSendType" SG_ 2431647526 AutoSendFlowRate 0;
BA_ "GenSigTimeoutTime_ECU" SG_ 2431647526 AutoSendMoisture 5000;
BA_ "GenSigSendType" SG_ 2431647526 AutoSendMoisture 0;
BA_ "GenSigTimeoutTime_ECU" SG_ 2431647526 AutoSendMassUnit 5000;
BA_ "GenSigSendType" SG_ 2431647526 AutoSendMassUnit 0;
BA_ "GenSigTimeoutTime_ECU" SG_ 2364538662 CmdBytePGN61184_VTV 4000;
BA_ "GenSigTimeoutTime_ECU" SG_ 2364538662 CleanGrainBypActivationRequest 4000;
BA_ "GenSigSendType" SG_ 2364538662 CleanGrainBypActivationRequest 0;
BA_ "GenSigTimeoutTime_ECU" SG_ 2364538662 ProdMoistSnsrFillSnsState 4000;
BA_ "GenSigSendType" SG_ 2364538662 ProdMoistSnsrFillSnsState 0;
BA_ "GenSigTimeoutTime_ECU" SG_ 2565865254 CmdBytePGN61184_VTV 5000;
BA_ "GenSigTimeoutTime_ECU" SG_ 2565865254 CalibrationStatus 5000;
BA_ "GenSigSendType" SG_ 2565865254 CalibrationStatus 0;
BA_ "GenSigTimeoutTime_ECU" SG_ 2565865254 RequestHarvesterSetpointAdjustB1 5000;
BA_ "GenSigTimeoutTime_ECU" SG_ 2566911192 CmdBytePGN65524_MTU 500;
BA_ "GenSigTimeoutTime_ECU" SG_ 2566911192 CntlrHeartbeat_MTUPROP1 500;
BA_ "GenSigTimeoutTime_ECU" SG_ 2297429809 CmdBytePGN61184_CAB 500;
BA_ "GenSigTimeoutTime_ECU" SG_ 2297429809 OpCtrlD1CmdByte3BitPair12 500;
BA_ "GenSigSendType" SG_ 2297429809 OpCtrlD1CmdByte3BitPair12 0;
BA_ "GenSigTimeoutTime_ECU" SG_ 2297429809 OpCtrlD1CmdByte3BitPair56 500;
BA_ "GenSigSendType" SG_ 2297429809 OpCtrlD1CmdByte3BitPair56 0;
BA_ "GenSigTimeoutTime_ECU" SG_ 2297429809 OpCtrlD1CmdByte4BitPair12 500;
BA_ "GenSigSendType" SG_ 2297429809 OpCtrlD1CmdByte4BitPair12 0;
BA_ "GenSigTimeoutTime_ECU" SG_ 2297429809 OpCtrlD1CmdByte4BitPair56 500;
BA_ "GenSigSendType" SG_ 2297429809 OpCtrlD1CmdByte4BitPair56 0;
BA_ "GenSigTimeoutTime_ECU" SG_ 2297429809 OpCtrlD1CmdByte5BitPair12 500;
BA_ "GenSigSendType" SG_ 2297429809 OpCtrlD1CmdByte5BitPair12 0;
BA_ "GenSigTimeoutTime_ECU" SG_ 2297429809 OpCtrlD1CmdByte5BitPair34 500;
BA_ "GenSigSendType" SG_ 2297429809 OpCtrlD1CmdByte5BitPair34 0;
BA_ "GenSigTimeoutTime_ECU" SG_ 2297429809 OpCtrlD1CmdByte5BitPair56 500;
BA_ "GenSigSendType" SG_ 2297429809 OpCtrlD1CmdByte5BitPair56 0;
BA_ "GenSigTimeoutTime_ECU" SG_ 2297429809 OpCtrlD1CmdByte5BitPair78 500;
BA_ "GenSigSendType" SG_ 2297429809 OpCtrlD1CmdByte5BitPair78 0;
BA_ "GenSigTimeoutTime_ECU" SG_ 2297429809 OpCtrlD1CmdByte6BitPair12 500;
BA_ "GenSigSendType" SG_ 2297429809 OpCtrlD1CmdByte6BitPair12 0;
BA_ "GenSigTimeoutTime_ECU" SG_ 2297429809 OpCtrlD1CmdByte6BitPair34 500;
BA_ "GenSigSendType" SG_ 2297429809 OpCtrlD1CmdByte6BitPair34 0;
BA_ "GenSigTimeoutTime_ECU" SG_ 2297429809 OpCtrlD1CmdByte6BitPair56 500;
BA_ "GenSigSendType" SG_ 2297429809 OpCtrlD1CmdByte6BitPair56 0;
BA_ "GenSigTimeoutTime_ECU" SG_ 2297429809 OpCtrlD1CmdByte6BitPair78 500;
BA_ "GenSigSendType" SG_ 2297429809 OpCtrlD1CmdByte6BitPair78 0;
BA_ "GenSigTimeoutTime_ECU" SG_ 2297429809 OpCtrlD1CmdByte7BitPair12 500;
BA_ "GenSigSendType" SG_ 2297429809 OpCtrlD1CmdByte7BitPair12 0;
BA_ "GenSigTimeoutTime_ECU" SG_ 2297429809 OpCtrlD1CmdByte7BitPair56 500;
BA_ "GenSigSendType" SG_ 2297429809 OpCtrlD1CmdByte7BitPair56 0;
BA_ "GenSigTimeoutTime_ECU" SG_ 2297429809 OpCtrlD1CmdByte8BitPair12 500;
BA_ "GenSigSendType" SG_ 2297429809 OpCtrlD1CmdByte8BitPair12 0;
BA_ "GenSigTimeoutTime_ECU" SG_ 2297429809 OpCtrlD1CmdByte8BitPair56 500;
BA_ "GenSigSendType" SG_ 2297429809 OpCtrlD1CmdByte8BitPair56 0;
BA_ "GenSigTimeoutTime_ECU" SG_ 2298476593 CmdBytePGN65528_CAB 500;
BA_ "GenSigTimeoutTime_ECU" SG_ 2298476593 OptrCtrlEncdr4Inc 500;
BA_ "GenSigSendType" SG_ 2298476593 OptrCtrlEncdr4Inc 0;
BA_ "GenSigTimeoutTime_ECU" SG_ 2298476593 OptrCtrlEncdr4Dec 500;
BA_ "GenSigSendType" SG_ 2298476593 OptrCtrlEncdr4Dec 0;
BA_ "GenSigTimeoutTime_ECU" SG_ 2298476593 OperCtrlEncdr4Btn 500;
BA_ "GenSigSendType" SG_ 2298476593 OperCtrlEncdr4Btn 0;
BA_ "GenSigTimeoutTime_ECU" SG_ 2566912817 CmdBytePGN65531_CAB 5000;
BA_ "GenSigTimeoutTime_ECU" SG_ 2566912817 KeySwitchStart 5000;
BA_ "GenSigSendType" SG_ 2566912817 KeySwitchStart 0;
BA_ "GenSigTimeoutTime_ECU" SG_ 2566912817 KeySwitchRun 5000;
BA_ "GenSigSendType" SG_ 2566912817 KeySwitchRun 0;
BA_ "GenSigTimeoutTime_ECU" SG_ 2566912817 VehiclePowerState 5000;
BA_ "GenSigSendType" SG_ 2566912817 VehiclePowerState 0;
BA_ "GenSigTimeoutTime_ECU" SG_ 2297429851 CmdBytePGN61184_POD 500;
BA_ "GenSigTimeoutTime_ECU" SG_ 2297429851 DomainPcompRequestPOD 500;
BA_ "GenSigSendType" SG_ 2297429851 DomainPcompRequestPOD 0;
BA_ "GenSigTimeoutTime_ECU" SG_ 2297429851 DomainSpecificPressureRequestPOD 500;
BA_ "GenSigSendType" SG_ 2297429851 DomainSpecificPressureRequestPOD 0;
BA_ "GenSigTimeoutTime_ECU" SG_ 2298478058 CmdBytePGN65533_FED 60000;
BA_ "GenSigTimeoutTime_ECU" SG_ 2298478058 SettSystDetaHarvSetpAdjuPrio2 60000;
BA_ "GenSigTimeoutTime_ECU" SG_ 2298478059 CmdBytePGN65533_HAD 60000;
BA_ "GenSigTimeoutTime_ECU" SG_ 2298478059 SettSystDetaHarvSetpAdjuPrio2 60000;
BA_ "GenSigTimeoutTime_ECU" SG_ 2298477546 CmdBytePGN65531_FED 60000;
BA_ "GenSigTimeoutTime_ECU" SG_ 2298477546 SettSystDetaHiRateHarvSetpAdjuPrio2 60000;
BA_ "GenSigTimeoutTime_ECU" SG_ 2298477547 CmdBytePGN65531_HAD 60000;
BA_ "GenSigTimeoutTime_ECU" SG_ 2298477547 SettSystDetaHiRateHarvSetpAdjuPrio2 60000;
BA_ "GenSigTimeoutTime_ECU" SG_ 2432695038 CmdBytePGN65530_Vector_XXX 1250;
BA_ "GenSigTimeoutTime_ECU" SG_ 2432695038 LeftWingPosition 1250;
BA_ "GenSigSendType" SG_ 2432695038 LeftWingPosition 0;
BA_ "GenSigTimeoutTime_ECU" SG_ 2432695038 RightWingPosition 1250;
BA_ "GenSigSendType" SG_ 2432695038 RightWingPosition 0;
BA_ "GenSigTimeoutTime_ECU" SG_ 2432695038 SlipClutchState 1250;
BA_ "GenSigSendType" SG_ 2432695038 SlipClutchState 0;
BA_ "GenSigTimeoutTime_ECU" SG_ 2298477094 CmdBytePGN65530_VTV 500;
BA_ "GenSigTimeoutTime_ECU" SG_ 2298477094 TailingsVolumeFromSubnet 500;
BA_ "GenSigSendType" SG_ 2298477094 TailingsVolumeFromSubnet 0;
BA_ "GenSigTimeoutTime_ECU" SG_ 2298477094 TlngsOpt 500;
BA_ "GenSigSendType" SG_ 2298477094 TlngsOpt 0;
BA_ "GenSigTimeoutTime_ECU" SG_ 2634021414 CmdBytePGN65530_VTV 60000;
BA_ "GenSigTimeoutTime_ECU" SG_ 2634021414 TCMPitchCal 60000;
BA_ "GenSigSendType" SG_ 2634021414 TCMPitchCal 0;
BA_ "GenSigTimeoutTime_ECU" SG_ 2634021414 TCMRollCal 60000;
BA_ "GenSigSendType" SG_ 2634021414 TCMRollCal 0;
BA_ "GenSigTimeoutTime_ECU" SG_ 2634021414 TCMCalStatus 60000;
BA_ "GenSigSendType" SG_ 2634021414 TCMCalStatus 0;
BA_ "GenSigTimeoutTime_ECU" SG_ 2365587238 CmdBytePGN65535_VTV 1000;
BA_ "GenSigTimeoutTime_ECU" SG_ 2365587238 VehRollAng 1000;
BA_ "GenSigSendType" SG_ 2365587238 VehRollAng 0;
BA_ "GenSigTimeoutTime_ECU" SG_ 2365587238 VehYawRate 1000;
BA_ "GenSigSendType" SG_ 2365587238 VehYawRate 0;
BA_ "GenSigTimeoutTime_ECU" SG_ 2566912968 CmdBytePGN65531_DC1 60000;
BA_ "GenSigTimeoutTime_ECU" SG_ 2566913318 CmdBytePGN65533_VTV 5000;
BA_ "GenSigTimeoutTime_ECU" SG_ 2566913318 FeedModuForwComm 5000;
BA_ "GenSigSendType" SG_ 2566913318 FeedModuForwComm 0;
BA_ "GenSigTimeoutTime_ECU" SG_ 2566913318 FeedModuReveComm 5000;
BA_ "GenSigSendType" SG_ 2566913318 FeedModuReveComm 0;
BA_ "GenMsgCycleTime" BO_ 2298477147 100;
BA_ "GenMsgSendType" BO_ 2298477147 0;
BA_ "GenMsgCycleTimeFast" BO_ 2298477147 100;
BA_ "SingleFrame" BO_ 2298477147 1;
BA_ "GenMsgCycleTime" BO_ 2565823486 1000;
BA_ "GenMsgSendType" BO_ 2565823486 0;
BA_ "GenMsgCycleTimeFast" BO_ 2565823486 1000;
BA_ "SingleFrame" BO_ 2565823486 1;
BA_ "GenMsgCycleTime" BO_ 2499803739 1000;
BA_ "GenMsgSendType" BO_ 2499803739 0;
BA_ "GenMsgCycleTimeFast" BO_ 2499803739 100;
BA_ "SingleFrame" BO_ 2499803739 1;
BA_ "GenMsgCycleTime" BO_ 2499803995 1000;
BA_ "GenMsgSendType" BO_ 2499803995 0;
BA_ "GenMsgCycleTimeFast" BO_ 2499803995 1000;
BA_ "SingleFrame" BO_ 2499803995 1;
BA_ "GenMsgCycleTime" BO_ 2298477290 100;
BA_ "GenMsgSendType" BO_ 2298477290 0;
BA_ "GenMsgCycleTimeFast" BO_ 2298477290 20;
BA_ "SingleFrame" BO_ 2298477290 1;
BA_ "GenMsgCycleTime" BO_ 2566913002 1000;
BA_ "GenMsgSendType" BO_ 2566913002 0;
BA_ "GenMsgCycleTimeFast" BO_ 2566913002 240;
BA_ "SingleFrame" BO_ 2566913002 1;
BA_ "GenMsgCycleTime" BO_ 2566913022 1000;
BA_ "GenMsgSendType" BO_ 2566913022 0;
BA_ "GenMsgCycleTimeFast" BO_ 2566913022 240;
BA_ "SingleFrame" BO_ 2566913022 1;
BA_ "GenMsgCycleTime" BO_ 2499803882 1000;
BA_ "GenMsgSendType" BO_ 2499803882 0;
BA_ "GenMsgCycleTimeFast" BO_ 2499803882 1000;
BA_ "SingleFrame" BO_ 2499803882 1;
BA_ "GenMsgCycleTime" BO_ 2499804138 1000;
BA_ "GenMsgSendType" BO_ 2499804138 0;
BA_ "GenMsgCycleTimeFast" BO_ 2499804138 240;
BA_ "SingleFrame" BO_ 2499804138 1;
BA_ "GenMsgCycleTime" BO_ 2566912746 1000;
BA_ "GenMsgSendType" BO_ 2566912746 0;
BA_ "GenMsgCycleTimeFast" BO_ 2566912746 1000;
BA_ "SingleFrame" BO_ 2566912746 1;
BA_ "GenMsgCycleTime" BO_ 2499803174 1000;
BA_ "GenMsgSendType" BO_ 2499803174 0;
BA_ "GenMsgCycleTimeFast" BO_ 2499803174 1000;
BA_ "SingleFrame" BO_ 2499803174 1;
BA_ "GenMsgCycleTime" BO_ 2499803883 1000;
BA_ "GenMsgSendType" BO_ 2499803883 0;
BA_ "GenMsgCycleTimeFast" BO_ 2499803883 1000;
BA_ "SingleFrame" BO_ 2499803883 1;
BA_ "GenMsgCycleTime" BO_ 2566911014 1000;
BA_ "GenMsgSendType" BO_ 2566911014 0;
BA_ "GenMsgCycleTimeFast" BO_ 2566911014 1000;
BA_ "SingleFrame" BO_ 2566911014 1;
BA_ "GenMsgCycleTime" BO_ 2432695787 500;
BA_ "GenMsgSendType" BO_ 2432695787 0;
BA_ "GenMsgCycleTimeFast" BO_ 2432695787 500;
BA_ "SingleFrame" BO_ 2432695787 1;
BA_ "GenMsgCycleTime" BO_ 2566912806 1000;
BA_ "GenMsgSendType" BO_ 2566912806 0;
BA_ "GenMsgCycleTimeFast" BO_ 2566912806 100;
BA_ "SingleFrame" BO_ 2566912806 1;
BA_ "GenMsgCycleTime" BO_ 2566912254 2000;
BA_ "GenMsgSendType" BO_ 2566912254 0;
BA_ "GenMsgCycleTimeFast" BO_ 2566912254 125;
BA_ "SingleFrame" BO_ 2566912254 1;
BA_ "GenMsgCycleTime" BO_ 2298477350 80;
BA_ "GenMsgSendType" BO_ 2298477350 0;
BA_ "GenMsgCycleTimeFast" BO_ 2298477350 80;
BA_ "SingleFrame" BO_ 2298477350 1;
BA_ "GenMsgCycleTime" BO_ 2565865451 1000;
BA_ "GenMsgSendType" BO_ 2565865451 0;
BA_ "GenMsgCycleTimeFast" BO_ 2565865451 125;
BA_ "SingleFrame" BO_ 2565865451 1;
BA_ "GenMsgCycleTime" BO_ 2566913003 1000;
BA_ "GenMsgSendType" BO_ 2566913003 0;
BA_ "GenMsgCycleTimeFast" BO_ 2566913003 1000;
BA_ "SingleFrame" BO_ 2566913003 1;
BA_ "GenMsgCycleTime" BO_ 2297429995 100;
BA_ "GenMsgSendType" BO_ 2297429995 0;
BA_ "GenMsgCycleTimeFast" BO_ 2297429995 125;
BA_ "SingleFrame" BO_ 2297429995 1;
BA_ "GenMsgCycleTime" BO_ 2365585457 200;
BA_ "GenMsgSendType" BO_ 2365585457 0;
BA_ "GenMsgCycleTimeFast" BO_ 2365585457 200;
BA_ "SingleFrame" BO_ 2365585457 1;
BA_ "GenMsgCycleTime" BO_ 2566911211 1000;
BA_ "GenMsgSendType" BO_ 2566911211 0;
BA_ "GenMsgCycleTimeFast" BO_ 2566911211 125;
BA_ "SingleFrame" BO_ 2566911211 1;
BA_ "GenMsgCycleTime" BO_ 2499804906 1000;
BA_ "GenMsgSendType" BO_ 2499804906 0;
BA_ "GenMsgCycleTimeFast" BO_ 2499804906 240;
BA_ "SingleFrame" BO_ 2499804906 1;
BA_ "GenMsgCycleTime" BO_ 2365585969 200;
BA_ "GenMsgSendType" BO_ 2365585969 0;
BA_ "GenMsgCycleTimeFast" BO_ 2365585969 200;
BA_ "SingleFrame" BO_ 2365585969 1;
BA_ "GenMsgCycleTime" BO_ 2498756606 1000;
BA_ "GenMsgSendType" BO_ 2498756606 0;
BA_ "GenMsgCycleTimeFast" BO_ 2498756606 100;
BA_ "SingleFrame" BO_ 2498756606 1;
BA_ "GenMsgCycleTime" BO_ 2566913534 1000;
BA_ "GenMsgSendType" BO_ 2566913534 0;
BA_ "GenMsgCycleTimeFast" BO_ 2566913534 125;
BA_ "SingleFrame" BO_ 2566913534 1;
BA_ "GenMsgCycleTime" BO_ 2499805182 1000;
BA_ "GenMsgSendType" BO_ 2499805182 0;
BA_ "GenMsgCycleTimeFast" BO_ 2499805182 125;
BA_ "SingleFrame" BO_ 2499805182 1;
BA_ "GenMsgCycleTime" BO_ 2499805162 1000;
BA_ "GenMsgSendType" BO_ 2499805162 0;
BA_ "GenMsgCycleTimeFast" BO_ 2499805162 125;
BA_ "SingleFrame" BO_ 2499805162 1;
BA_ "GenMsgCycleTime" BO_ 2499802366 1000;
BA_ "GenMsgSendType" BO_ 2499802366 0;
BA_ "GenMsgCycleTimeFast" BO_ 2499802366 1000;
BA_ "SingleFrame" BO_ 2499802366 1;
BA_ "GenMsgCycleTime" BO_ 2566914026 1000;
BA_ "GenMsgSendType" BO_ 2566914026 0;
BA_ "GenMsgCycleTimeFast" BO_ 2566914026 100;
BA_ "SingleFrame" BO_ 2566914026 1;
BA_ "GenMsgCycleTime" BO_ 2566913830 1000;
BA_ "GenMsgSendType" BO_ 2566913830 0;
BA_ "GenMsgCycleTimeFast" BO_ 2566913830 1000;
BA_ "SingleFrame" BO_ 2566913830 1;
BA_ "GenMsgCycleTime" BO_ 2565865307 1000;
BA_ "GenMsgSendType" BO_ 2565865307 0;
BA_ "GenMsgCycleTimeFast" BO_ 2565865307 1000;
BA_ "SingleFrame" BO_ 2565865307 1;
BA_ "GenMsgCycleTime" BO_ 2565865416 60000;
BA_ "SingleFrame" BO_ 2565865416 1;
BA_ "GenMsgCycleTime" BO_ 2565865450 60000;
BA_ "SingleFrame" BO_ 2565865450 1;
BA_ "GenMsgCycleTime" BO_ 2565851185 60000;
BA_ "SingleFrame" BO_ 2565851185 1;
BA_ "GenMsgCycleTime" BO_ 2565859889 60000;
BA_ "SingleFrame" BO_ 2565859889 1;
BA_ "GenMsgCycleTime" BO_ 2565860145 60000;
BA_ "SingleFrame" BO_ 2565860145 1;
BA_ "GenMsgCycleTime" BO_ 2565823281 60000;
BA_ "SingleFrame" BO_ 2565823281 1;
BA_ "GenMsgCycleTime" BO_ 2565812680 60000;
BA_ "SingleFrame" BO_ 2565812680 1;
BA_ "GenMsgCycleTime" BO_ 2565860040 60000;
BA_ "SingleFrame" BO_ 2565860040 1;
BA_ "GenMsgCycleTime" BO_ 2565860296 60000;
BA_ "SingleFrame" BO_ 2565860296 1;
BA_ "GenMsgCycleTime" BO_ 2565823432 60000;
BA_ "SingleFrame" BO_ 2565823432 1;
BA_ "GenMsgCycleTime" BO_ 2565812714 60000;
BA_ "SingleFrame" BO_ 2565812714 1;
BA_ "GenMsgCycleTime" BO_ 2565851370 60000;
BA_ "SingleFrame" BO_ 2565851370 1;
BA_ "GenMsgCycleTime" BO_ 2565860330 60000;
BA_ "SingleFrame" BO_ 2565860330 1;
BA_ "GenMsgCycleTime" BO_ 2565823466 60000;
BA_ "SingleFrame" BO_ 2565823466 1;
BA_ "GenMsgCycleTime" BO_ 2565812715 60000;
BA_ "SingleFrame" BO_ 2565812715 1;
BA_ "GenMsgCycleTime" BO_ 2565851371 60000;
BA_ "SingleFrame" BO_ 2565851371 1;
BA_ "GenMsgCycleTime" BO_ 2565860075 60000;
BA_ "SingleFrame" BO_ 2565860075 1;
BA_ "GenMsgCycleTime" BO_ 2565823467 60000;
BA_ "SingleFrame" BO_ 2565823467 1;
BA_ "GenMsgCycleTime" BO_ 2565812571 60000;
BA_ "SingleFrame" BO_ 2565812571 1;
BA_ "GenMsgCycleTime" BO_ 2565851227 60000;
BA_ "SingleFrame" BO_ 2565851227 1;
BA_ "GenMsgCycleTime" BO_ 2565859931 60000;
BA_ "SingleFrame" BO_ 2565859931 1;
BA_ "GenMsgCycleTime" BO_ 2565860187 60000;
BA_ "SingleFrame" BO_ 2565860187 1;
BA_ "GenMsgCycleTime" BO_ 2566912859 1000;
BA_ "GenMsgSendType" BO_ 2566912859 0;
BA_ "GenMsgCycleTimeFast" BO_ 2566912859 100;
BA_ "SingleFrame" BO_ 2566912859 1;
BA_ "GenMsgCycleTime" BO_ 2498756602 1000;
BA_ "GenMsgSendType" BO_ 2498756602 0;
BA_ "GenMsgCycleTimeFast" BO_ 2498756602 1000;
BA_ "SingleFrame" BO_ 2498756602 1;
BA_ "GenMsgCycleTime" BO_ 2566912747 1000;
BA_ "GenMsgSendType" BO_ 2566912747 0;
BA_ "GenMsgCycleTimeFast" BO_ 2566912747 100;
BA_ "SingleFrame" BO_ 2566912747 1;
BA_ "GenMsgCycleTime" BO_ 2565864190 1000;
BA_ "GenMsgSendType" BO_ 2565864190 0;
BA_ "GenMsgCycleTimeFast" BO_ 2565864190 1000;
BA_ "SingleFrame" BO_ 2565864190 1;
BA_ "GenMsgCycleTime" BO_ 2364538878 1000;
BA_ "GenMsgSendType" BO_ 2364538878 0;
BA_ "GenMsgCycleTimeFast" BO_ 2364538878 20;
BA_ "SingleFrame" BO_ 2364538878 1;
BA_ "GenMsgCycleTime" BO_ 2566912049 1000;
BA_ "GenMsgSendType" BO_ 2566912049 0;
BA_ "GenMsgCycleTimeFast" BO_ 2566912049 40;
BA_ "SingleFrame" BO_ 2566912049 1;
BA_ "GenMsgCycleTime" BO_ 2364538859 200;
BA_ "GenMsgSendType" BO_ 2364538859 0;
BA_ "GenMsgCycleTimeFast" BO_ 2364538859 200;
BA_ "SingleFrame" BO_ 2364538859 1;
BA_ "GenMsgCycleTime" BO_ 2566912216 60000;
BA_ "SingleFrame" BO_ 2566912216 1;
BA_ "GenMsgCycleTime" BO_ 2565865465 60000;
BA_ "SingleFrame" BO_ 2565865465 1;
BA_ "GenMsgCycleTime" BO_ 2565865466 60000;
BA_ "SingleFrame" BO_ 2565865466 1;
BA_ "GenMsgCycleTime" BO_ 2565860090 60000;
BA_ "SingleFrame" BO_ 2565860090 1;
BA_ "GenMsgCycleTime" BO_ 2565860346 60000;
BA_ "SingleFrame" BO_ 2565860346 1;
BA_ "GenMsgCycleTime" BO_ 2565823482 60000;
BA_ "SingleFrame" BO_ 2565823482 1;
BA_ "GenMsgCycleTime" BO_ 2565860089 60000;
BA_ "SingleFrame" BO_ 2565860089 1;
BA_ "GenMsgCycleTime" BO_ 2565860345 60000;
BA_ "SingleFrame" BO_ 2565860345 1;
BA_ "GenMsgCycleTime" BO_ 2565823481 60000;
BA_ "SingleFrame" BO_ 2565823481 1;
BA_ "GenMsgCycleTime" BO_ 2431647526 1000;
BA_ "GenMsgSendType" BO_ 2431647526 0;
BA_ "GenMsgCycleTimeFast" BO_ 2431647526 1000;
BA_ "SingleFrame" BO_ 2431647526 1;
BA_ "GenMsgCycleTime" BO_ 2364538662 125;
BA_ "GenMsgSendType" BO_ 2364538662 0;
BA_ "GenMsgCycleTimeFast" BO_ 2364538662 125;
BA_ "SingleFrame" BO_ 2364538662 1;
BA_ "GenMsgCycleTime" BO_ 2565865254 1000;
BA_ "GenMsgSendType" BO_ 2565865254 0;
BA_ "GenMsgCycleTimeFast" BO_ 2565865254 1000;
BA_ "SingleFrame" BO_ 2565865254 1;
BA_ "GenMsgCycleTime" BO_ 2566911192 100;
BA_ "SingleFrame" BO_ 2566911192 1;
BA_ "GenMsgCycleTime" BO_ 2297429809 100;
BA_ "GenMsgSendType" BO_ 2297429809 0;
BA_ "GenMsgCycleTimeFast" BO_ 2297429809 100;
BA_ "SingleFrame" BO_ 2297429809 1;
BA_ "GenMsgCycleTime" BO_ 2298476593 100;
BA_ "GenMsgSendType" BO_ 2298476593 0;
BA_ "GenMsgCycleTimeFast" BO_ 2298476593 100;
BA_ "SingleFrame" BO_ 2298476593 1;
BA_ "GenMsgCycleTime" BO_ 2566912817 1000;
BA_ "GenMsgSendType" BO_ 2566912817 0;
BA_ "GenMsgCycleTimeFast" BO_ 2566912817 100;
BA_ "SingleFrame" BO_ 2566912817 1;
BA_ "GenMsgCycleTime" BO_ 2297429851 100;
BA_ "GenMsgSendType" BO_ 2297429851 0;
BA_ "GenMsgCycleTimeFast" BO_ 2297429851 20;
BA_ "SingleFrame" BO_ 2297429851 1;
BA_ "GenMsgCycleTime" BO_ 2298478058 60000;
BA_ "SingleFrame" BO_ 2298478058 1;
BA_ "GenMsgCycleTime" BO_ 2298478059 60000;
BA_ "SingleFrame" BO_ 2298478059 1;
BA_ "GenMsgCycleTime" BO_ 2298477546 60000;
BA_ "SingleFrame" BO_ 2298477546 1;
BA_ "GenMsgCycleTime" BO_ 2298477547 60000;
BA_ "SingleFrame" BO_ 2298477547 1;
BA_ "GenMsgCycleTime" BO_ 2432695038 250;
BA_ "GenMsgSendType" BO_ 2432695038 0;
BA_ "GenMsgCycleTimeFast" BO_ 2432695038 100;
BA_ "SingleFrame" BO_ 2432695038 1;
BA_ "GenMsgCycleTime" BO_ 2298477094 100;
BA_ "GenMsgSendType" BO_ 2298477094 0;
BA_ "GenMsgCycleTimeFast" BO_ 2298477094 125;
BA_ "SingleFrame" BO_ 2298477094 1;
BA_ "GenMsgCycleTime" BO_ 2634021414 60000;
BA_ "GenMsgSendType" BO_ 2634021414 0;
BA_ "GenMsgCycleTimeFast" BO_ 2634021414 60000;
BA_ "SingleFrame" BO_ 2634021414 1;
BA_ "GenMsgCycleTime" BO_ 2365587238 200;
BA_ "GenMsgSendType" BO_ 2365587238 0;
BA_ "GenMsgCycleTimeFast" BO_ 2365587238 200;
BA_ "SingleFrame" BO_ 2365587238 1;
BA_ "GenMsgCycleTime" BO_ 2566912968 60000;
BA_ "SingleFrame" BO_ 2566912968 1;
BA_ "GenMsgCycleTime" BO_ 2566913318 1000;
BA_ "GenMsgSendType" BO_ 2566913318 0;
BA_ "GenMsgCycleTimeFast" BO_ 2566913318 1000;
BA_ "SingleFrame" BO_ 2566913318 1;
VAL_ 2298477147 CmdBytePGN65530_POD 8448 "EngineCoolingFanSpeeds " 8704 "EngineCoolingFanSystem " ;
VAL_ 2298477147 CoolingFanSystemRequestor 0 " No Request" 1 " Excessive Engine Coolant Temperature" 2 " Excessive Hydraulic Oil Temperature" 3 " Excessive Transmission Oil Temeperature" 4 " Fan Off" 5 " Excessive Engine Intake Air Temperature" 6 " Excessive MEG Oil Temperature" 7 " AC System" 8 " Debris System" 9 " Minimum Cooling Fan Speed" 10 " Minimum Cooling Fan Speed Override" 11 " Excessive Fuel Temperature" 12 " System Faulted" 13 " Full Fan Speed" 14 " Maximum Controllable Fan Speed" 254 " Error" 255 " NotAvailable" ;
VAL_ 2298477147 CoolingFanControlModeState 0 " Off" 1 " Full Speed" 2 " Maximum Controllable Speed" 3 " Fan Speed Arbitration" 14 " DEM_Error" 15 " DEM_Not_available" ;
VAL_ 2298477147 CoolingFanFaultedRequestor 0 " Air Conditioner System" 1 " Crop Type" 2 " Main Hydraulic Reservoir Oil Temperature" 3 " Main Engine Gearcase Oil Temperature" 4 " Ambient Air Temperature" 5 " Fuel Temperature" 6 " Engine Charge Air Cooler Temperature" 7 " Engine Coolant Temperature" 8 " Engine Cooling Fan Speed Not Detected" 9 " Engine Cooling Fan Sensor Supply Voltage Fault" 10 " Engine Cooling Fan Low Fan Speed Fault" 11 " Engine Cooling Fan Solenoid Power Shorted Low" 12 " NoFault" 254 " Error" 255 " NotAvailable" ;
VAL_ 2565823486 CmdBytePGN61184_Vector_XXX 9060 "Engine_Derate_Status " ;
VAL_ 2499803739 CmdBytePGN65530_POD 11528 "EngineManagementSpeedStatus " 21248 "PowertrainDomainMiscellaneousLowPriority2 " 6 "PowerTrainConfiguration " 8192 "PowerTrainHydraulics1 " 11776 "Scheduled_Power_Reduction_Application_and_Torque_Offset " 15362 "VehicleOverrideRequestsPOD " ;
VAL_ 2499803739 HydrCharPresSensStat 0 " Normal_Pressure" 1 " Low_Pressure_Warning" 2 " Very_Low_Pressure_Warning" 3 " High_Pressure_Warning" 8 " No_Fault" 9 " Out_Of_Range_Low" 10 " Out_Of_Range_High" 11 " Sensor_Failed" 12 " Supply_Reference_Failed" 13 " Not_Ready" 14 " Error" 15 " Not_Available" ;
VAL_ 2499803739 EngineSpeedManagementActive 0 " DEM_Off" 1 " DEM_On" 2 " DEM_Reserved__Stds" 3 " DEM_Dont_caretake_no_action" ;
VAL_ 2499803739 VehicleTrailerStatus 0 " Trailer is not detected" 1 " Trailer is detected" 2 " Error" 3 " NotAvailable" ;
VAL_ 2499803739 FourWDStatus 0 " Off" 1 " Low Active" 2 " High Active" 14 " Error" 15 " NotAvailable" ;
VAL_ 2499803739 DiffLockState 0 " Diff lock disengaged in manual mode" 1 " Diff lock engaged in manual mode" 2 " Diff lock disengaged in auto mode" 3 " Diff lock engaged in auto mode" 4 " Diff lock engagement prevented due to speed" 14 " Error" 15 " Not Available" ;
VAL_ 2499803995 CmdBytePGN65531_POD 5377 "EnginePowerParameters2 " 19456 "HVACMiscCommands " 33 "PowertrainDomainMiscellaneousHighPriority2 " ;
VAL_ 2499803995 ParkBrakeManuallyEngagedSts 0 " Not Manually Engaged" 1 " Manually Engaged" 2 " Error" 3 " NotAvailable" ;
VAL_ 2499803995 ACClutchInhibit 1 " DEM_On" 0 " DEM_Off" 2 " DEM_Error" 3 " DEM_NotAvailable" ;
VAL_ 2298477290 CmdBytePGN65530_FED 12800 "FEDPressureRequestCommands " ;
VAL_ 2298477290 DomainPcompRequestFED 0 " Off" 1 " On" 2 " No_Command" 14 " Error" 15 " Not_available" ;
VAL_ 2298477290 DomainPcompRequest2FED 0 " Off" 1 " On" 2 " No_Command" 14 " Error" 15 " Not_available" ;
VAL_ 2566913002 CmdBytePGN65531_FED 2811 "FeederHouseDustFanConfigurationData0xFB0A " 3835 "FrontEndDomainMiscellaneousStatus2 " 865 "HeaderAutomationCharacteristics " 12288 "Vehicle_Configuration_Management_Response " ;
VAL_ 2566913002 DustFanSpdSnsrSts 0 " En_SpeedSensorStatus_InRange" 1 " En_SpeedSensorStatus_OutOfRangeLow" 2 " En_SpeedSensorStatus_OutOfRangeHigh" 3 " En_SpeedSensorStatus_ZeroSpeedFault" 4 " En_SpeedSensorStatus_LowSpeedFault" 7 " En_SpeedSensorStatus_SensorReferenceFault" 10 " En_SpeedSensorStatus_NotEngaged" 11 " En_SpeedSensorStatus_Engaged" 14 " En_SpeedSensorStatus_Error" 15 " En_SpeedSensorStatus_NotAvailable" ;
VAL_ 2566913002 HdrTransptModState 14 " En_HdrTransptMod_Error" 15 " En_HdrTransptMod_NotAvailable" 4 " En_HdrTransptMod_ReadyToTransport" 3 " En_HdrTransptMod_NotReadyToTransport" 5 " En_HdrTransptMod_MovingToTransport" 0 " En_HdrTransptMod_NotInstalled" 1 " En_HdrTransptMod_Disabled" 2 " En_HdrTransptMod_Faulted" ;
VAL_ 2566913002 LateralTiltSensorStatus 0 " En_SpeedSensorStatus_InRange" 1 " En_SpeedSensorStatus_OutOfRangeLow" 2 " En_SpeedSensorStatus_OutOfRangeHigh" 3 " En_SpeedSensorStatus_ZeroSpeedFault" 4 " En_SpeedSensorStatus_LowSpeedFault" 7 " En_SpeedSensorStatus_SensorReferenceFault" 10 " En_SpeedSensorStatus_NotEngaged" 11 " En_SpeedSensorStatus_Engaged" 14 " En_SpeedSensorStatus_Error" 15 " En_SpeedSensorStatus_NotAvailable" ;
VAL_ 2566913022 CmdBytePGN65531_Vector_XXX 3323 "FEEHeaderTelematics " 3067 "GSAData2 " 1531 "HeaderLightingFaultStatus " 48 "JDMachineHealthFilterMonitoring " ;
VAL_ 2566913022 RightFlasherHdrLightFaultState 0 " EnOnOff2StatesOff" 1 " EnOnOff2StatesOn" 2 " EnOnOff2StatesError" 3 " EnOnOff2StatesNotAvailable" ;
VAL_ 2566913022 LeftFlasherHdrLightFaultState 0 " EnOnOff2StatesOff" 1 " EnOnOff2StatesOn" 2 " EnOnOff2StatesError" 3 " EnOnOff2StatesNotAvailable" ;
VAL_ 2566913022 HdrFlexWingDraperVrnt 0 " En_HdrFlexWingDraperVrnt_RigidKnife" 1 " En_HdrFlexWingDraperVrnt_FlexKnife" 2 " En_HdrFlexWingDraperVrnt_OilSeedRape" 14 " En_HdrFlexWingDraperVrnt_Error" 15 " En_HdrFlexWingDraperVrnt_NotAvailable" ;
VAL_ 2566913022 DraperBltProtnInstldOptn 0 " En_OnOff2States_Off" 1 " En_OnOff2States_On" 2 " En_OnOff2States_Error" 3 " En_OnOff2States_NotAvailable" ;
VAL_ 2499803882 CmdBytePGN65530_FED 13056 "FrontEndDomainMiscellaneousStatus3 " 14850 "VehicleOverrideRequestsFED " ;
VAL_ 2499803882 ClearBlockageEngagementState 0 " DEM_Disengaged" 1 " DEM_Engaged" 2 " DEM_EngagedReverse" 3 " DEM_Overridden" 4 " DEM_EngagedModulation" 5 " DEM_EngagementInProgress" 14 " DEM_Error" 15 " DEM_NotAvailable" ;
VAL_ 2499803882 EngThrottleOverrideRequestFED 0 " DEM_No_Idle" 1 " DEM_Low_Idle" 2 " DEM_Mid_Idle" 3 " DEM_High_Idle" 4 " DEM_High_Idle_reduced_throttle" 5 " DEM_No_Command" ;
VAL_ 2499803882 SepDisengageOverrideRequestFED 0 " DEM_Off" 1 " DEM_On" 2 " DEM_Error" 3 " DEM_Not_available_or_not_installed" ;
VAL_ 2499804138 CmdBytePGN65531_FED 1275 "FrontEndDomainToHeaderStatus2 " 1787 "FrontEndDomainInformation " 6898 "HarvesterVehicleHours2 " 1377 "HeaderEngagementAutomationStatus " ;
VAL_ 2499804138 BackshaftSpeedSnsrSts 11 " DEM_Engaged" 14 " DEM_Error" 0 " DEM_InRange" 7 " DEM_SensorReferenceFault" 4 " DEM_LowSpeedFault" 15 " DEM_NotAvailable" 2 " DEM_OutOfRangeHigh" 1 " DEM_OutOfRangeLow" 10 " DEM_NotEngaged" 3 " DEM_ZeroSpeedFault" ;
VAL_ 2499804138 HeadRaisLoweEngaContStat 0 " Actual Engagement Undefined" 1 " Actual Disengaged" 2 " Actual Engage" 14 " Error" 15 " Not Available" ;
VAL_ 2499804138 HeadRaisLoweResuSetpInte 0 " En_ExternalInterfaceBoolean_False" 1 " En_ExternalInterfaceBoolean_True" 2 " En_ExternalInterfaceBoolean_Error" 3 " En_ExternalInterfaceBoolean_NotAvailable" ;
VAL_ 2499804138 WingPosnStToMainBus 0 " En_WingPositionStates_FullyFolded" 1 " En_WingPositionStates_PartiallyFolded" 2 " En_WingPositionStates_PartiallyUnfolded" 3 " En_WingPositionStates_FullyUnfolded" 4 " En_WingPositionStates_DeckPlatesResuming" 5 " En_WingPositionStates_Folding" 6 " En_WingPositionStates_Unfolding" 7 " En_WingPositionStates_PartiallyFoldedClearance" 8 " En_WingPositionStates_PartiallyFoldedCleanOut" 9 " En_WingPositionStates_WingSensorsNotInstalled" 14 " En_WingPositionStates_Error" 15 " En_WingPositionStates_NotAvailable" ;
VAL_ 2499804138 WingLvlgMstOptnToMainBus 0 " En_WingLevelMasterOption_NotInstalled" 1 " En_WingLevelMasterOption_RaiseNotInstalled" 2 " En_WingLevelMasterOption_Installed" 14 " En_WingLevelMasterOption_Error" 15 " En_WingLevelMasterOption_NotAvailable" ;
VAL_ 2499804138 TopAugTypInstldDispToMainBus 0 " En_TopAugTyp_None" 1 " En_TopAugTyp_Standard" 2 " En_TopAugTyp_Fingered" 14 " En_TopAugTyp_Error" 15 " En_TopAugTyp_NotAvailable" ;
VAL_ 2499804138 GaugeWhlOptnDispToMainBus 0 " En_OnOff2States_Off" 1 " En_OnOff2States_On" 2 " En_OnOff2States_Error" 3 " En_OnOff2States_NotAvailable" ;
VAL_ 2499804138 InteTranInstDispToMainBus 0 " En_OnOff2States_Off" 1 " En_OnOff2States_On" 2 " En_OnOff2States_Error" 3 " En_OnOff2States_NotAvailable" ;
VAL_ 2499804138 SideKnivesInstldDispToMainBus 0 " En_OnOff2States_Off" 1 " En_OnOff2States_On" 2 " En_OnOff2States_Error" 3 " En_OnOff2States_NotAvailable" ;
VAL_ 2499804138 CropLifterInstldDispToMainBus 0 " En_OnOff2States_Off" 1 " En_OnOff2States_On" 2 " En_OnOff2States_Error" 3 " En_OnOff2States_NotAvailable" ;
VAL_ 2499804138 OdometerStyleHdrHrCntrEna 0 " En_ModeEnableStates_Disabled" 1 " En_ModeEnableStates_Enabled" 2 " En_ModeEnableStates_Error" 3 " En_ModeEnableStates_NotAvailable" ;
VAL_ 2566912746 CmdBytePGN65530_FED 1543 "GaugeWheelPositionSensors " 7168 "HeaderOptions " 29441 "JD_Configurable_Lighting_Status_-_Right_Hand_Work_Lights " 35330 "SetpointInfoRequestHarvesterSetpointAdjust " ;
VAL_ 2566912746 HeaderGaugeWhlOptnEnbld 0 " En_OnOff2States_Off" 1 " En_OnOff2States_On" 2 " En_OnOff2States_Error" 3 " En_OnOff2States_NotAvailable" ;
VAL_ 2566912746 HeaderFoldOptnEnbld 0 " En_FoldingHeaderOption_Disabled" 1 " En_FoldingHeaderOption_EnabledWithNoSensor" 2 " En_FoldingHeaderOption_EnabledWithDualSensor" 14 " En_FoldingHeaderOption_Error" 15 " En_FoldingHeaderOption_NotAvailable" ;
VAL_ 2566912746 ReelInstalledOptEnbld 0 " En_OnOff2States_Off" 1 " En_OnOff2States_On" 2 " En_OnOff2States_Error" 3 " En_OnOff2States_NotAvailable" ;
VAL_ 2566912746 DraperBltInstalledOptEnbld 0 " En_OnOff2States_Off" 1 " En_OnOff2States_On" 2 " En_OnOff2States_Error" 3 " En_OnOff2States_NotAvailable" ;
VAL_ 2566912746 CutrbarPosnCtrlEnbld 0 " En_ModeEnableStates_Disabled" 1 " En_ModeEnableStates_Enabled" 2 " En_ModeEnableStates_Error" 3 " En_ModeEnableStates_NotAvailable" ;
VAL_ 2566912746 WingLvlgMstOptnToVehBus 0 " En_WingLevelMasterOption_NotInstalled" 1 " En_WingLevelMasterOption_RaiseNotInstalled" 2 " En_WingLevelMasterOption_Installed" 14 " En_WingLevelMasterOption_Error" 15 " En_WingLevelMasterOption_NotAvailable" ;
VAL_ 2566912746 WorkLight21RightStatus 0 " Deactivated" 1 " Activated" 2 " Fault_Detected" 3 " Not_Available" ;
VAL_ 2499803174 CmdBytePGN65528_VTV 194 "Grain_Bypass_Damaged_Grain_Information_#1 " 196 "Grain_Bypass_Heavy_Material_Other_Than_Grain_Information_#1 " 195 "Grain_Bypass_Light_Material_Other_Than_Grain_Information_#1 " 197 "Grain_Bypass_Unthreshed_Grain_Information_#1 " ;
VAL_ 2499803883 CmdBytePGN65530_HAD 49 "GrainHandlingProfile " 10752 "RotationalAlarmCommandRequest " 15106 "VehicleOverrideRequestsHAD " ;
VAL_ 2499803883 UnloadingAugerFold 0 " Not Enabled" 1 " Enabled" 14 " Error" 15 " Not Available" ;
VAL_ 2499803883 RotationalAlarmCommand 0 " Off" 1 " On" 2 " Flash" 3 " Inactive" 14 " Error" 15 " NotAvailable" ;
VAL_ 2499803883 EngThrottleOverrideRequestHAD 0 " DEM_No_Idle" 1 " DEM_Low_Idle" 2 " DEM_Mid_Idle" 3 " DEM_High_Idle" 4 " DEM_High_Idle_reduced_throttle" 5 " DEM_No_Command" ;
VAL_ 2499803883 HdrDisengageOverrideRequestHAD 0 " DEM_Off" 1 " DEM_On" 2 " DEM_Error" 3 " DEM_Not_available_or_not_installed" ;
VAL_ 2566911014 CmdBytePGN65524_VTV 2 "GrainLossData5 " 3 "GrainLossData6 " 107 "GrainQualityImageCountInfo " 100 "Guidance_System_Command_JD_Extended " 145 "HeaderWidthDisplayData2 " 41 "ICA2DataMessage1 " 102 "Local_Error_Sensor_Commands " ;
VAL_ 2566911014 IC2SteadyState 0 " Off" 1 " On" 14 " Error" 15 " Not available ornot installed" ;
VAL_ 2566911014 IC2Enabled 0 " Off" 1 " ICA2 Enabled" 2 " SO Enabled" 3 " HSAplus Enabled" 14 " Error" 15 " Not available" ;
VAL_ 2566911014 IC2ShortTermStatusSepLoss 0 " Off" 1 " On" 14 " Error" 15 " Not available or not installed" ;
VAL_ 2566911014 IC2LongTermStatusSepLoss 0 " Off" 1 " On" 14 " Error" 15 " Not available or not installed" ;
VAL_ 2566911014 IC2ShortTermStatusShLoss 0 " Off" 1 " On" 14 " Error" 15 " Not available or not installed" ;
VAL_ 2566911014 IC2LongTermStatusShLoss 0 " Off" 1 " On" 14 " Error" 15 " Not available or not installed" ;
VAL_ 2566911014 IC2DiagHighestActiveFault 0 " ROTOR_PRESSURE_ERROR" 254 " Error" 255 " Not available or not installed" 1 " BOTH_SHOE_LOSS_SENSORS_BLOCKED_OR_DAMAGED" 2 " SEPARATOR_LOSS_SENSOR_BLOCKED_OR_DAMAGED" 3 " GRAIN_LOSS_MONITOR_CONTROLLER_NOT_DETECTED_OR_UNAVAILABLE" 4 " CROP_TYPE_UNSUPPORTED" 5 " CLEAN_GRAIN_ELEVATOR_MASS_FLOW_TOO_LOW_OR_NOT_DETECTED" 6 " ACTIVE_YIELD_MANAGER_MASS_FLOW_TOO_LOW_OR_NOT_DETECTED" 7 " GRAIN_QUALITY_MONITOR_ERROR" 8 " GRAIN_QUALITY_MONITOR_REPROGRAMMING" 9 " GRAIN_QUALITY_CAMERA_UNAVAILABLE" 10 " GRAIN_QUALITY_CAMERA_HARDWARE_ERROR" 11 " GRAIN_QUALITY_MONITOR_NOT_AVAILABLE" 12 " GRAIN_QUALITY_CAMERA_LENS_DIRTY" 13 " CLEAN_GRAIN_SAMPLE_BYPASS_BLOCKED" 14 " LEFT_SHOE_LOSS_SENSOR_BLOCKED_OR_DAMAGED" 15 " RIGHT_SHOE_LOSS_SENSOR_BLOCKED_OR_DAMAGED" 16 " ROTOR_SPEED_SETPOINT_NOT_REACHED" 17 " THRESHING_CLEARANCE_SETPOINT_NOT_REACHED" 18 " CHAFFER_OPENING_SETPOINT_NOT_REACHED" 19 " SIEVE_OPENING_SETPOINT_NOT_REACHED" 20 " FAN_SPEED_SETPOINT_NOT_REACHED" 21 " GRAIN_QUALITY_CAMERA_LENS_PARTIALLY_DIRTY" 22 " GRAIN_BYPASS_MOTOR_ISSUE_DETECTED" 23 " TAILINGS_VOLUME_SENSOR_ISSUE_DETECTED" 24 " TAILINGS_BYPASS_CAMERA_LENS_DIRTY" 25 " TAILINGS_BYPASS_CAMERA_HARDWARE_ERROR" 26 " CLEAN_GRAIN_BYPASS_MASS_FLOW_TOO_LOW_OR_NOT_DETECTED" 27 " TAILINGS_BYPASS_CAMERA_LIMP_HOME_MODE" 28 " TAILINGS_BYPASS_CAMERA_UNAVAILABLE" 29 " GRAIN_QUALITY_CAMERA_CROP_MISMATCH_DETECTED" 30 " SEPARATOR_NOT_ENGAGED" 31 " HEADER_NOT_ENGAGED" 32 " ENGINE_NOT_IN_HIGH_IDLE" 33 " ROAD_MODE_ENABLED" 34 " UNSTEADY_GROUND_SPEED" 35 " NO_CROP_FLOW" 36 " HEADER_ABOVE_RECORD_STOP_HEIGHT" 37 " UNUSED" 250 " DIAG_MANAGER_NO_FAULT" ;
VAL_ 2566911014 IC2DiagFaultState 0 " No faults are present" 1 " Crop type mismatch" 2 " One or more Reduced Performance faults are present (and no No Guarantee of Performance faults are present)" 3 " Not ready inconsistent conditions" 4 " Not ready header height below record stop height" 5 " Not ready not harvesting" 6 " One or more No Guarantee of Performance faults are present" 7 " Crop type unsupported" 14 " Error" 15 " Not available or not installed" ;
VAL_ 2566911014 IC2ShortTermStatusCropGap 0 " Crop Gap State Not Active" 1 " Crop Gap State Active" 14 " Error" 15 " Not available or not installed" ;
VAL_ 2566911014 GPSMsgRate 0 " EnGPSMsgRateNoGPS" 1 " EnGPSMsgRate5Hz" 2 " EnGPSMsgRate10Hz" 3 " EnGPSMsgRate20Hz" 4 " EnGPSMsgRate50Hz" 5 " EnGPSMsgRate100Hz" 6 " EnGPSMsgRateErr" 7 " EnGPSMsgRateUkwn" ;
VAL_ 2566911014 AT2ExitCode_GSCJDE 0 " ATECNoCode" 1 " ATECTransmissionInPark" 2 " ATECFICAFault" 3 " ATECWhlSpdSlow" 4 " ATECAltGuidanceActive" 5 " ATECIncorrectGear" 13 " ATECCmdMsdTimeout" 250 " ATECLastTransitionOk" 16 " ATECAuthDenied" 21 " ATECWhlSpdFast" 22 " ATECOilTempTooLow" 23 " ATECDiagMode" 24 " ATECCtrlState" 25 " ATECResumeNotPressed" 26 " ATECCurvatureNotMatched" 50 " ATECInvalidCommand" 51 " ATECNoOperatorPresence" 52 " ATECImpReleasedControl" 53 " ATECGlobalStop" 54 " ATECOperatorOverride" 62 " ATECECError" 63 " ATECECNotAvailable" 64 " ATECStartUp" 65 " ATECShutDown" 66 " ATECAutoTracShutdown" 67 " ATECEngineOff" 68 " ATECNotCalibrated" 69 " ATECVoltagenotStable" 70 " ATECOperatorPresenceDataBad" 71 " ATECResumeSwitchDataBad" 72 " ATECVehStateMsgMissing" 73 " ATECVehStateMsgBadData" 74 " ATECAdvGuidanceStatusMsgMissing" 75 " ATECAdvGuidanceStatusMsgBadData" 76 " ATECActiveInReverseTimeout" 77 " ATECGPSWheelSpeedMismatch" 78 " ATECNoValidTrack" 79 " ATECInvalidGPS" 80 " ATECShutdownStateFaulted" 81 " ATECGSDDataFaulted" 82 " ATECExtGuidanceStatusMsgFaulted" 83 " ATECExtGuidanceStatusExtendedMsgFaulted" 84 " ATECVehDirSpeedMsgFaulted" 85 " ATECVehRollYawMsgFaulted" 86 " ATECTCMMsgFaulted" 87 " ATECLateralError" 88 " ATECHeadingError" 89 " ATECTrackNumChanged" 90 " ATECTCMInactive" 91 " ATECRSGPSTransitionTooLarge" 92 " ATECRSOutOfRow" 93 " ATECRSGreenstarTrackingFault" 94 " ATECRSSensorFault" 95 " ATECRSGPSFault" 100 " ATECTransportMode" 101 " ATECAuxPumpOn" 102 " ATECBoomsFolded" 103 " ATECHeaderNotEngaged" 104 " ATECFourWheelSteerTimeout" 105 " ATECCrabSteering" 254 " ATECEC8BitError" 255 " ATECEC8BitNotAvailable" ;
VAL_ 2566911014 CrvtrCntrlATState_GSCJDE 5 " AutoTracSysSt_Actv" 1 " AutoTracSysSt_Disad" 3 " AutoTracSysSt_Enad" 14 " AutoTracSysSt_Err" 0 " AutoTracSysSt_None" 2 " AutoTracSysSt_RdyToEna" 8 " AutoTracSysSt_SrvModActv" 7 " AutoTracSysSt_SrvModEnad" 6 " AutoTracSysSt_SrvModReqd" 4 " AutoTracSysSt_TranToActv" 15 " AutoTracSysSt_Ukwn" ;
VAL_ 2566911014 SensorType_LESC 0 " SnsrTyp_VisionRowGuid" 1 " SnsrTyp_Combine" 2 " SnsrTyp_Reichardt" 3 " SnsrTyp_ReichardtSplit" 4 " SnsrTyp_CottonPicker" 5 " SnsrTyp_ImpVisionRowGuid" 6 " SnsrTyp_CottonStripper" 14 " SnsrTyp_Err" 15 " SnsrTyp_Ukwn" ;
VAL_ 2566911014 CalibrationRequest_LESC 0 " RSCalReq_Start" 1 " RSCalReq_Next" 2 " RSCalReq_Previous" 3 " RSCalReq_Cancel" 4 " RSCalReq_Save" 5 " RSCalReq_NoRequest" 14 " RSCalReq_Error" 15 " RSCalReq_Ukwn" ;
VAL_ 2432695787 CmdBytePGN65533_HAD 1280 "GrainLossErrorStates " 1536 "GrainLossInputConfiguration " ;
VAL_ 2432695787 GlmController2Input1Error 0 " DEM_NormOper" 1 " DEM_SnsrPlugged" 2 " DEM_OpenCirc" 14 " DEM_Error" 15 " DEM_NotAvailable" ;
VAL_ 2432695787 GlmController2Input2Error 0 " DEM_NormOper" 1 " DEM_SnsrPlugged" 2 " DEM_OpenCirc" 14 " DEM_Error" 15 " DEM_NotAvailable" ;
VAL_ 2432695787 GlmController2Input3Error 0 " DEM_NormOper" 1 " DEM_SnsrPlugged" 2 " DEM_OpenCirc" 14 " DEM_Error" 15 " DEM_NotAvailable" ;
VAL_ 2432695787 GlmController2Input4Error 0 " DEM_NormOper" 1 " DEM_SnsrPlugged" 2 " DEM_OpenCirc" 14 " DEM_Error" 15 " DEM_NotAvailable" ;
VAL_ 2432695787 GlmController1Input1Error 0 " DEM_NormOper" 1 " DEM_SnsrPlugged" 2 " DEM_OpenCirc" 14 " DEM_Error" 15 " DEM_NotAvailable" ;
VAL_ 2432695787 GlmController1Input2Error 0 " DEM_NormOper" 1 " DEM_SnsrPlugged" 2 " DEM_OpenCirc" 14 " DEM_Error" 15 " DEM_NotAvailable" ;
VAL_ 2432695787 GlmController1Input3Error 0 " DEM_NormOper" 1 " DEM_SnsrPlugged" 2 " DEM_OpenCirc" 14 " DEM_Error" 15 " DEM_NotAvailable" ;
VAL_ 2432695787 GlmController1Input4Error 0 " DEM_NormOper" 1 " DEM_SnsrPlugged" 2 " DEM_OpenCirc" 14 " DEM_Error" 15 " DEM_NotAvailable" ;
VAL_ 2432695787 GlmController2Error 0 " NormOper" 2 " WdgRst" 1 " InBootBlk" 15 " NotAvailable" ;
VAL_ 2432695787 GlmController1Error 0 " NormOper" 2 " WdgRst" 1 " InBootBlk" 15 " NotAvailable" ;
VAL_ 2432695787 GlmController1Input1Type 0 " En_GrainLossInputType_None" 1 " En_GrainLossInputType_Shoe" 2 " En_GrainLossInputType_Separator" 14 " En_GrainLossInputType_Error" 15 " En_GrainLossInputType_NotAvailable" ;
VAL_ 2432695787 GlmController1Input2Type 0 " En_GrainLossInputType_None" 1 " En_GrainLossInputType_Shoe" 2 " En_GrainLossInputType_Separator" 14 " En_GrainLossInputType_Error" 15 " En_GrainLossInputType_NotAvailable" ;
VAL_ 2432695787 GlmController1Input3Type 0 " En_GrainLossInputType_None" 1 " En_GrainLossInputType_Shoe" 2 " En_GrainLossInputType_Separator" 14 " En_GrainLossInputType_Error" 15 " En_GrainLossInputType_NotAvailable" ;
VAL_ 2432695787 GlmController1Input4Type 0 " En_GrainLossInputType_None" 1 " En_GrainLossInputType_Shoe" 2 " En_GrainLossInputType_Separator" 14 " En_GrainLossInputType_Error" 15 " En_GrainLossInputType_NotAvailable" ;
VAL_ 2432695787 GlmController2Input1Type 0 " En_GrainLossInputType_None" 1 " En_GrainLossInputType_Shoe" 2 " En_GrainLossInputType_Separator" 14 " En_GrainLossInputType_Error" 15 " En_GrainLossInputType_NotAvailable" ;
VAL_ 2432695787 GlmController2Input2Type 0 " En_GrainLossInputType_None" 1 " En_GrainLossInputType_Shoe" 2 " En_GrainLossInputType_Separator" 14 " En_GrainLossInputType_Error" 15 " En_GrainLossInputType_NotAvailable" ;
VAL_ 2432695787 GlmController2Input3Type 0 " En_GrainLossInputType_None" 1 " En_GrainLossInputType_Shoe" 2 " En_GrainLossInputType_Separator" 14 " En_GrainLossInputType_Error" 15 " En_GrainLossInputType_NotAvailable" ;
VAL_ 2432695787 GlmController2Input4Type 0 " En_GrainLossInputType_None" 1 " En_GrainLossInputType_Shoe" 2 " En_GrainLossInputType_Separator" 14 " En_GrainLossInputType_Error" 15 " En_GrainLossInputType_NotAvailable" ;
VAL_ 2566912806 CmdBytePGN65531_VTV 15104 "GrainLossNGPDDisplayData " ;
VAL_ 2566912254 CmdBytePGN65528_Vector_XXX 192 "Grain_Quality_System_Bypass_Motor_Control " 115 "JDAftertreatmentSCRSystemState " 155 "Local_Error_Sensor_Data " ;
VAL_ 2566912254 SensorType_LESD 0 " SnsrTyp_VisionRowGuid" 1 " SnsrTyp_Combine" 2 " SnsrTyp_Reichardt" 3 " SnsrTyp_ReichardtSplit" 4 " SnsrTyp_CottonPicker" 5 " SnsrTyp_ImpVisionRowGuid" 6 " SnsrTyp_CottonStripper" 14 " SnsrTyp_Err" 15 " SnsrTyp_Ukwn" ;
VAL_ 2566912254 GrainBypassMotorStatus 0 " En_GrainBypassMotorStatus_MotorOffGrnLevelSnsrOff" 1 " En_GrainBypassMotorStatus_MotorOnGrnLevelSnsrOff" 2 " En_GrainBypassMotorStatus_MotorOffGrnLevelSnsrOn" 3 " En_GrainBypassMotorStatus_MotorOnGrnLevelSnsrOn" 4 " En_GrainBypassMotorStatus_MotorOffLimpHomeMode" 5 " En_GrainBypassMotorStatus_MotorOnLimpHomeMode" 6 " En_GrainBypassMotorStatus_HighCurrentFault" 7 " En_GrainBypassMotorStatus_LowCurrentFault" 8 " En_GrainBypassMotorStatus_ShortedHighFault" 14 " En_GrainBypassMotorStatus_Error" 15 " En_GrainBypassMotorStatus_NotAvailable" ;
VAL_ 2298477350 CmdBytePGN65531_VTV 505 "GSACommand " ;
VAL_ 2298477350 GSACommandStatus 0 " DISABLED" 1 " STANDBY" 2 " CONTROLLING" 254 " Error" 255 " NotAvailable" ;
VAL_ 2565865451 CmdBytePGN61184_HAD 38500 "HarvestingDomainConfiguration " 17508 "HarvestingDomainResidueStatus " 36964 "HarvestSeparatorGrainLossAnalysisData " 37220 "HarvestShoeGrainLossAnalysisData1 " 37476 "HarvestShoeGrainLossAnalysisData2 " 7922 "JD_ACKnowledgement " 2553 "JD_Network_Capabilities " 2544 "OperatorControlsB2Response " 3568 "OperatorControlsB3Response " 13556 "OperatorControlsB5Response " 14580 "OperatorControlsB6Response " 241 "Prop_Request_PGN_Dual_Cmd_Byte " 219 "Prop_Request_PGN_Single_Cmd_Byte " 15858 "ResponseHarvesterSetpointAdjust " 41828 "VehicleLightingFaultStatus " ;
VAL_ 2565865451 OpCtrlB2RspByte5BitQuad14 0 " DEM_bit_state_0" 1 " DEM_bit_state_1" 2 " DEM_bit_state_2" 3 " DEM_bit_state_3" 4 " DEM_bit_state_4" 5 " DEM_bit_state_5" 6 " DEM_bit_state_6" 7 " DEM_bit_state_7" 14 " DEM_Error" 15 " DEM_Not_available_or_not_installed" ;
VAL_ 2565865451 OpCtrlB2RspByte8BitQuad14 0 " DEM_bit_state_0" 1 " DEM_bit_state_1" 2 " DEM_bit_state_2" 3 " DEM_bit_state_3" 4 " DEM_bit_state_4" 5 " DEM_bit_state_5" 6 " DEM_bit_state_6" 7 " DEM_bit_state_7" 14 " DEM_Error" 15 " DEM_Not_available_or_not_installed" ;
VAL_ 2565865451 OpCtrlB3RspByte6BitQuad58 0 " bit_state_0" 1 " bit_state_1" 2 " bit_state_2" 3 " bit_state_3" 4 " bit_state_4" 5 " bit_state_5" 6 " bit_state_6" 7 " bit_state_7" 8 " bit_state_8" 14 " Error" 15 " Not_available_or_not_installed" ;
VAL_ 2565865451 OpCtrlB5RspByte6BitQuad58 0 " DEM_bit_state_0" 1 " DEM_bit_state_1" 2 " DEM_bit_state_2" 3 " DEM_bit_state_3" 4 " DEM_bit_state_4" 5 " DEM_bit_state_5" 6 " DEM_bit_state_6" 7 " DEM_bit_state_7" 14 " DEM_Error" 15 " DEM_Not_available_or_not_installed" ;
VAL_ 2565865451 OpCtrlB6RspByte3BitQuad14 0 " DEM_bit_state_0" 1 " DEM_bit_state_1" 2 " DEM_bit_state_2" 3 " DEM_bit_state_3" 4 " DEM_bit_state_4" 5 " DEM_bit_state_5" 6 " DEM_bit_state_6" 7 " DEM_bit_state_7" 14 " DEM_Error" 15 " DEM_Not_available_or_not_installed" ;
VAL_ 2565865451 ChopWindrowState 0 " En_ChopWindrowState_AtChopPosition" 1 " En_ChopWindrowState_AtWindrowPosition" 2 " MovingToWindrowPosition" 3 " En_ChopWindrowState_MovingToChopPosition" 4 " En_ChopWindrowState_IndeterminatePosition" 5 " En_ChopWindrowState_AtTransportPosition" 6 " En_ChopWindrowState_ChopInWindrowIndeterminatePosition" 7 " En_ChopWindrowState_ChopInWindrowInPosition" 8 " En_ChopWindrowState_ChopOutWindrowIndeterminatePosition" 9 " En_ChopWindrowState_ChopIndeterminateWindrowInPosition" 10 " En_ChopWindrowState_ChopIndeterminateWindrowOutPosition" 14 " En_ChopWindrowState_Error" 15 " En_ChopWindrowState_Not_availablenot_installed" ;
VAL_ 2565865451 ChopperState 0 " En_GenericRaiseLowerStates_Disabled" 1 " En_GenericRaiseLowerStates_Indeterminate" 2 " En_GenericRaiseLowerStates_Raised" 3 " En_GenericRaiseLowerStates_Lowered" 4 " En_GenericRaiseLowerStates_Raising" 5 " En_GenericRaiseLowerStates_Lowering" 14 " En_GenericRaiseLowerStates_Error" 15 " En_GenericRaiseLowerStates_NotAvailable" ;
VAL_ 2565865451 CANTailingsElevatorType 0 " En_TailingsElevatorType_SConventional" 1 " En_TailingsElevatorType_SRethresher1" 2 " En_TailingsElevatorType_DRethresher1" 3 " En_TailingsElevatorType_P34P4Conventional" 4 " En_TailingsElevatorType_TWConventional" 5 " En_TailingsElevatorType_P5Conventional" ;
VAL_ 2565865451 ShoeChafferElmntType 0 " En_CleaningShoeElementType_NotInstalled" 1 " En_CleaningShoeElementType_DF4GeneralPurpose" 2 " En_CleaningShoeElementType_DF4DeepTooth" 3 " En_CleaningShoeElementType_DF4HighPerformance" 4 " En_CleaningShoeElementType_DF4PremiumCorn" 5 " En_CleaningShoeElementType_DF3GeneralPurpose" 6 " En_CleaningShoeElementType_DF3DeepTooth" 7 " En_CleaningShoeElementType_DF4ShortTooth" 14 " Error" 15 " Not_Available" ;
VAL_ 2565865451 ShoeSieveElmntType 0 " En_CleaningShoeElementType_NotInstalled" 1 " En_CleaningShoeElementType_DF4GeneralPurpose" 2 " En_CleaningShoeElementType_DF4DeepTooth" 3 " En_CleaningShoeElementType_DF4HighPerformance" 4 " En_CleaningShoeElementType_DF4PremiumCorn" 5 " En_CleaningShoeElementType_DF3GeneralPurpose" 6 " En_CleaningShoeElementType_DF3DeepTooth" 7 " En_CleaningShoeElementType_DF4ShortTooth" 14 " Error" 15 " Not_Available" ;
VAL_ 2565865451 ChopWindrowEnaSt 0 " En_ChopWindrowModeEnableState_ChopperOnly" 1 " En_ChopWindrowModeEnableState_ChopToDropDoorOnly" 2 " En_ChopWindrowModeEnableState_DualActuatorForDoorAndTailBoard" 14 " En_ChopWindrowModeEnableState_Error" 15 " En_ChopWindrowModeEnableState_NotAvailable" ;
VAL_ 2565865451 CANVehSpcFrontLight1FaultState 0 " EnRecfgbleLtgFltStsNoFaults" 1 " EnRecfgbleLtgFltStsLeftFaulty" 2 " EnRecfgbleLtgFltStsRightFaulty" 3 " EnRecfgbleLtgFltStsAllFaulty" 14 " EnRecfgbleLtgFltStsError" 15 " EnRecfgbleLtgFltStsNotAvailable" ;
VAL_ 2565865451 CANVehSpcSideLight1FaultState 0 " EnRecfgbleLtgFltStsNoFaults" 1 " EnRecfgbleLtgFltStsLeftFaulty" 2 " EnRecfgbleLtgFltStsRightFaulty" 3 " EnRecfgbleLtgFltStsAllFaulty" 14 " EnRecfgbleLtgFltStsError" 15 " EnRecfgbleLtgFltStsNotAvailable" ;
VAL_ 2566913003 CmdBytePGN65531_HAD 8945 "Harvesting_Domain_Grain_Tank_Status_2 " 8689 "Harvesting_Domain_System_Information " 60928 "HillmasterSystemInformation " 12288 "Vehicle_Configuration_Management_Response " ;
VAL_ 2566913003 FeedAccelSnsrSts 0 " InRange" 1 " OutOfRangeLow" 2 " OutOfRangeHigh" 3 " ZeroSpeedFault" 4 " LowSpeedFault" 7 " SensorReferenceFault" 10 " NotEngaged" 11 " Engaged" 14 " Error" 15 " NotAvailable" ;
VAL_ 2566913003 ChassisForeAftTiltCalDone 0 " En_OnOff2States_Off" 1 " En_OnOff2States_On" 2 " En_OnOff2States_Error" 3 " En_OnOff2States_NotAvailable" ;
VAL_ 2566913003 ChassisForeAftTiltSnsrSts 0 " En_SensorStatus_InRange" 1 " En_SensorStatus_OutOfRangeLow" 2 " En_SensorStatus_OutOfRangeHigh" 3 " En_SensorStatus_OutOfUsableRangeLow" 4 " En_SensorStatus_OutOfUsableRangeHigh" 5 " En_SensorStatus_OutOfCalibratedRangeLow" 6 " En_SensorStatus_OutOfCalibratedRangeHigh" 7 " En_SensorStatus_SensorReferenceFault" 14 " En_SensorStatus_Error" 15 " En_SensorStatus_NotAvailable" ;
VAL_ 2566913003 HillmasterSystemMode 0 " Disabled" 1 " Manual" 2 " Auto" 3 " Lowering" 14 " Error" 15 " Not available_not installed" ;
VAL_ 2566913003 HillMasterTiltRequest 0 " DEM_Off" 1 " DEM_On" 2 " DEM_Error" 3 " DEM_Not_available_or_not_installed" ;
VAL_ 2297429995 CmdBytePGN61184_HAD 3064 "HarvestingDomainThreshingStatus " 18532 "HarvestingDomainHydraulics1 " ;
VAL_ 2297429995 RotorGear 123 " ReverseSecond" 124 " ReverseFirst" 125 " Neutral" 126 " ForwardFirst" 127 " ForwardSecond" 128 " ForwardThird" 251 " Park" 254 " Error" 255 " Not available" ;
VAL_ 2297429995 SeparatorDrive 0 " DEM_Disengaged" 1 " DEM_Engaged" 2 " DEM_EngagedReverse" 3 " DEM_Overridden" 14 " DEM_Error" 15 " DEM_Not_available" ;
VAL_ 2297429995 SystemPressureAchievable 0 " En_OnOff2States_Off" 1 " En_OnOff2States_On" 2 " En_OnOff2States_Error" 3 " En_OnOff2States_NotAvailable" ;
VAL_ 2297429995 SystemPressure2Achievable 0 " En_OnOff2States_Off" 1 " En_OnOff2States_On" 2 " En_OnOff2States_Error" 3 " En_OnOff2States_NotAvailable" ;
VAL_ 2365585457 CmdBytePGN65528_CAB 40 "HarvesterOperatorData " ;
VAL_ 2365585457 HarvEngageCmds 0 " Disengage" 1 " Engage Forward" 2 " Engage Reverse" 14 " Error" 15 " NotAvailable" ;
VAL_ 2365585457 HarvEngageCmds2 0 " Disengage" 1 " Engage Forward" 2 " Engage Reverse" 14 " Error" 15 " NotAvailable" ;
VAL_ 2566911211 CmdBytePGN65524_HAD 110 "HarvestingAutomationOptions " ;
VAL_ 2566911211 HarvestSmartEnable 0 " En_ModeEnableStates_Disabled" 1 " En_ModeEnableStates_Enabled" 2 " En_ModeEnableStates_Error" 3 " En_ModeEnableStates_NotAvailable" ;
VAL_ 2566911211 ActiveTerrainAdjustEnable 0 " En_ModeEnableStates_Disabled" 1 " En_ModeEnableStates_Enabled" 2 " En_ModeEnableStates_Error" 3 " En_ModeEnableStates_NotAvailable" ;
VAL_ 2566911211 IntelligentCombineAdjustOption 0 " En_IntelligentCombineAdjustOptionType_ICANotInstalled" 1 " En_IntelligentCombineAdjustOptionType_ICAEnabled" 2 " En_IntelligentCombineAdjustOptionType_ICA2Enabled" 3 " En_IntelligentCombineAdjustOptionType_ICARedesign" 14 " En_IntelligentCombineAdjustOptionType_Error" 15 " En_IntelligentCombineAdjustOptionType_NotAvailable" ;
VAL_ 2566911211 MoistureSensorType 0 " En_MoistureSensorTypes_None" 1 " En_MoistureSensorTypes_Mounted" 2 " En_MoistureSensorTypes_Ag" 3 " En_MoistureSensorTypes_AgAutoCal" 4 " En_MoistureSensorTypes_Gen3" 5 " En_MoistureSensorTypes_Gen3AutoCal" 14 " En_MoistureSensorTypes_Error" 15 " En_MoistureSensorTypes_NotAvailable" 6 " En_MoistureSensorTypes_Yield3withoutAY" 7 " En_MoistureSensorTypes_Yield3withAY" ;
VAL_ 2566911211 ForwardLookingPerceptionOption 0 " None" 1 " Available" ;
VAL_ 2566911211 AutomationUXOption 0 " CombineAdvisor" 1 " HarvestAutomationUX" ;
VAL_ 2566911211 HillmasterInstalledOption 0 " False" 1 " True" 14 " Error" 15 " NotAvailable" ;
VAL_ 2566911211 ChassisForeAftSensorInstalled 0 " Not Installed" 1 " Installed" 14 " Error" 15 " NotAvailable" ;
VAL_ 2566911211 GrainBypassOption 0 " None" 1 " AgLeader" 2 " Harvest Settings Automation" ;
VAL_ 2499804906 CmdBytePGN65534_FED 67 "HarvesterFrontEndShaftSpeedsandPositions " 71 "HeaderHeightDisplayData2 " ;
VAL_ 2365585969 CmdBytePGN65530_CAB 12032 "HarvesterOperatorSwitchRawData " ;
VAL_ 2365585969 HarvEngageCmdOnSignalInput 1 " On" 2 " Off" 14 " Error" 15 " NotAvailable" ;
VAL_ 2365585969 HarvEngageCmd2OnSignalInput 1 " On" 2 " Off" 14 " Error" 15 " NotAvailable" ;
VAL_ 2498756606 CmdBytePGN61184_Vector_XXX 31076 "HeaderAuxiliaryFunctionstoHeader1 " ;
VAL_ 2498756606 HdrAuxResumeTogReq 0 " En_OnOff2States_Off" 1 " En_OnOff2States_On" 2 " En_OnOff2States_Error" 3 " En_OnOff2States_NotAvailable" ;
VAL_ 2566913534 CmdBytePGN65533_Vector_XXX 2560 "HeaderConfigurationDataToFrontEndDomain1 " ;
VAL_ 2499805182 CmdBytePGN65535_Vector_XXX 17 "HeaderHeightControlModeState " 34 "Tractor_Setup_#1 " ;
VAL_ 2499805182 ReelPositionActive 0 " Disabled" 1 " Enabled" 2 " Error" 3 " Not Available" ;
VAL_ 2499805162 CmdBytePGN65535_FED 24 "HeaderWidthDisplayData " 18 "HeaderHeightActiveDisplayData " 22 "HeaderHeightPercentDisplayData " ;
VAL_ 2499805162 HdrHeightActResumeNmbr 0 " DEM_No_active_mode" 1 " DEM_Mode_corresponding_to_button_1" 2 " DEM_Mode_corresponding_to_button_2" 3 " DEM_Mode_corresponding_to_button_3" ;
VAL_ 2499805162 SelctdDigDisp 0 " FeederhouseHeightPosition" 1 " HeaderHeightPercent" 2 " FloatPressure" 3 " FlexPressure" 4 " HeaderHeightPosition" 5 " HeaderWidthRows" 6 " ReelSpeedRatio" 14 " Error" 15 " Not Available" ;
VAL_ 2499802366 CmdBytePGN65524_Vector_XXX 48 "ICA2DataMessage2 " ;
VAL_ 2499802366 IC2ShortTermStatusDmgdGrain 0 " Off" 1 " On" 14 " Error" 15 " Not Available or Not Installed" ;
VAL_ 2499802366 IC2LongTermStatusDmgdGrain 0 " Off" 1 " On" 14 " Error" 15 " Not Available or Not Installed" ;
VAL_ 2499802366 IC2ShortTermStatusMOGL 0 " Off" 1 " On" 14 " Error" 15 " Not Available or Not Installed" ;
VAL_ 2499802366 IC2LongTermStatusMOGL 0 " Off" 1 " On" 14 " Error" 15 " Not Available or Not Installed" ;
VAL_ 2499802366 IC2ShortTermStatusMOGH 0 " Off" 1 " On" 14 " Error" 15 " Not Available or Not Installed" ;
VAL_ 2499802366 IC2LongTermStatusMOGH 0 " Off" 1 " On" 14 " Error" 15 " Not Available or Not Installed" ;
VAL_ 2499802366 IC2ShortTermStatusUnthrGrain 0 " Off" 1 " On" 14 " Error" 15 " Not Available or Not Installed" ;
VAL_ 2499802366 IC2LongTermStatusUnthrGrain 0 " Off" 1 " On" 14 " Error" 15 " Not Available or Not Installed" ;
VAL_ 2499802366 IC2ShortTermStatusTlngsVol 0 " Off" 1 " On" 14 " Error" 15 " Not Available or Not Installed" ;
VAL_ 2566914026 CmdBytePGN65535_FED 247 "InteractiveCalibrationECUtoTool " ;
VAL_ 2566914026 ActVehicleCal 4 " En_CalibrationOverride_Header" 5 " En_CalibrationOverride_FlexWingRange" 7 " En_CalibrationOverride_FdrhseLiftRange" 8 " En_CalibrationOverride_HeaderAuxFunctions" 14 " En_CalibrationOverride_GaugeWheelPosition" 27 " En_CalibrationOverride_FdrhseTiltRange" 28 " En_CalibrationOverride_FdrHseTiltSpeed" 29 " En_CalibrationOverride_WingPosition" 32 " En_CalibrationOverride_GaugeWheelSpeed" 120 " En_CalibrationOverride_FdrHseForeAftTiltRange" 121 " En_CalibrationOverride_FdrhseLiftSpeed" 122 " En_CalibrationOverride_PressureCancelTuning" 123 " En_CalibrationOverride_StalkSizeSensor" 124 " En_CalibrationOverride_HeaderWeight" 254 " En_CalibrationOverride_Error" 255 " En_CalibrationOverride_NotAvailable" ;
VAL_ 2566913830 CmdBytePGN65535_VTV 246 "InteractiveCalibrationTooltoECU " 38 "IntelligentCombineAdjustCommunication " ;
VAL_ 2566913830 ActiveTerrainAdjustEnable 0 " Not Active" 1 " Active" 2 " Error" 3 " Not Available" ;
VAL_ 2565865307 CmdBytePGN61184_POD 2556 "IOExpanderOutputPinStateMessage3 " 7922 "JD_ACKnowledgement " 2553 "JD_Network_Capabilities " 3568 "OperatorControlsB3Response " 13556 "OperatorControlsB5Response " 10226 "PCKeyboardScanCodeMessage2 " 24676 "PowertrainDomaintoDriveTrainCharacteristics " 21604 "PowertrainDomainMiscellaneousLowPriority " 241 "Prop_Request_PGN_Dual_Cmd_Byte " 219 "Prop_Request_PGN_Single_Cmd_Byte " 41828 "VehicleLightingFaultStatus " 42084 "VehicleLightingFaultStatus1 " ;
VAL_ 2565865307 IOExpOutputPinState3Status 0 " DEM_NoFault" 1 " DEM_OpenCircuit" 2 " DEM_Overload" 3 " DEM_NoCommandReceived" ;
VAL_ 2565865307 OpCtrlB3RspByte3BitQuad14 0 " bit_state_0" 1 " bit_state_1" 2 " bit_state_2" 3 " bit_state_3" 4 " bit_state_4" 5 " bit_state_5" 6 " bit_state_6" 7 " bit_state_7" 8 " bit_state_8" 14 " Error" 15 " Not_available_or_not_installed" ;
VAL_ 2565865307 OpCtrlB3RspByte3BitQuad58 0 " bit_state_0" 1 " bit_state_1" 2 " bit_state_2" 3 " bit_state_3" 4 " bit_state_4" 5 " bit_state_5" 6 " bit_state_6" 7 " bit_state_7" 8 " bit_state_8" 14 " Error" 15 " Not_available_or_not_installed" ;
VAL_ 2565865307 OpCtrlB3RspByte4BitQuad14 0 " bit_state_0" 1 " bit_state_1" 2 " bit_state_2" 3 " bit_state_3" 4 " bit_state_4" 5 " bit_state_5" 6 " bit_state_6" 7 " bit_state_7" 8 " bit_state_8" 14 " Error" 15 " Not_available_or_not_installed" ;
VAL_ 2565865307 OpCtrlB3RspByte4BitQuad58 0 " bit_state_0" 1 " bit_state_1" 2 " bit_state_2" 3 " bit_state_3" 4 " bit_state_4" 5 " bit_state_5" 6 " bit_state_6" 7 " bit_state_7" 8 " bit_state_8" 14 " Error" 15 " Not_available_or_not_installed" ;
VAL_ 2565865307 OpCtrlB3RspByte5BitQuad14 0 " bit_state_0" 1 " bit_state_1" 2 " bit_state_2" 3 " bit_state_3" 4 " bit_state_4" 5 " bit_state_5" 6 " bit_state_6" 7 " bit_state_7" 8 " bit_state_8" 14 " Error" 15 " Not_available_or_not_installed" ;
VAL_ 2565865307 OpCtrlB3RspByte6BitQuad14 0 " bit_state_0" 1 " bit_state_1" 2 " bit_state_2" 3 " bit_state_3" 4 " bit_state_4" 5 " bit_state_5" 6 " bit_state_6" 7 " bit_state_7" 8 " bit_state_8" 14 " Error" 15 " Not_available_or_not_installed" ;
VAL_ 2565865307 OpCtrlB3RspByte7BitQuad14 0 " bit_state_0" 1 " bit_state_1" 2 " bit_state_2" 3 " bit_state_3" 4 " bit_state_4" 5 " bit_state_5" 6 " bit_state_6" 7 " bit_state_7" 8 " bit_state_8" 14 " Error" 15 " Not_available_or_not_installed" ;
VAL_ 2565865307 OpCtrlB3RspByte7BitQuad58 0 " bit_state_0" 1 " bit_state_1" 2 " bit_state_2" 3 " bit_state_3" 4 " bit_state_4" 5 " bit_state_5" 6 " bit_state_6" 7 " bit_state_7" 8 " bit_state_8" 14 " Error" 15 " Not_available_or_not_installed" ;
VAL_ 2565865307 OpCtrlB3RspByte8BitQuad14 0 " bit_state_0" 1 " bit_state_1" 2 " bit_state_2" 3 " bit_state_3" 4 " bit_state_4" 5 " bit_state_5" 6 " bit_state_6" 7 " bit_state_7" 8 " bit_state_8" 14 " Error" 15 " Not_available_or_not_installed" ;
VAL_ 2565865307 OpCtrlB3RspByte8BitQuad58 0 " bit_state_0" 1 " bit_state_1" 2 " bit_state_2" 3 " bit_state_3" 4 " bit_state_4" 5 " bit_state_5" 6 " bit_state_6" 7 " bit_state_7" 8 " bit_state_8" 14 " Error" 15 " Not_available_or_not_installed" ;
VAL_ 2565865307 OpCtrlB5RspByte5BitQuad14 0 " DEM_bit_state_0" 1 " DEM_bit_state_1" 2 " DEM_bit_state_2" 3 " DEM_bit_state_3" 4 " DEM_bit_state_4" 5 " DEM_bit_state_5" 6 " DEM_bit_state_6" 7 " DEM_bit_state_7" 14 " DEM_Error" 15 " DEM_Not_available_or_not_installed" ;
VAL_ 2565865307 OpCtrlB5RspByte6BitQuad14 0 " DEM_bit_state_0" 1 " DEM_bit_state_1" 2 " DEM_bit_state_2" 3 " DEM_bit_state_3" 4 " DEM_bit_state_4" 5 " DEM_bit_state_5" 6 " DEM_bit_state_6" 7 " DEM_bit_state_7" 14 " DEM_Error" 15 " DEM_Not_available_or_not_installed" ;
VAL_ 2565865307 OpCtrlB5RspByte7BitQuad14 0 " DEM_bit_state_0" 1 " DEM_bit_state_1" 2 " DEM_bit_state_2" 3 " DEM_bit_state_3" 4 " DEM_bit_state_4" 5 " DEM_bit_state_5" 6 " DEM_bit_state_6" 7 " DEM_bit_state_7" 14 " DEM_Error" 15 " DEM_Not_available_or_not_installed" ;
VAL_ 2565865307 CurrentGearRange 123 " DEM_Reverse2" 124 " DEM_Reverse1" 125 " DEM_Neutral" 126 " DEM_First" 127 " DEM_Second" 128 " DEM_Third" 251 " DEM_Park" 254 " DEM_Error" 255 " DEM_Not_Available" ;
VAL_ 2565865307 ProDriveTransMode 121 " ReverseRoadMode2" 122 " ReverseRoadMode1" 123 " ReverseMode2" 124 " ReverseMode1" 125 " Neutral" 126 " ForwardMode1" 127 " ForawardMode2" 128 " ForwardRoadMode1" 129 " ForwardRoadMode2" 254 " Error" 255 " NotAvailable" ;
VAL_ 2565865307 ParkBrakeStateAutomatic 0 " DEM_Off" 1 " DEM_On" 2 " DEM_Error" 3 " DEM_Not_available_or_not_installed" ;
VAL_ 2565865307 ParkLock 0 " DEM_Park_lock_is_disengaged" 1 " DEM_Park_lock_is_engaged" 2 " DEM_Error" 3 " DEM_Not_available_or_not_installed" ;
VAL_ 2565865307 LowFuelLevelAlarm 0 " Off" 1 " On" 2 " Error" 3 " NotAvailableOrNotInstalled" ;
VAL_ 2565865307 CANVehSpcRearLight1FaultState 0 " EnRecfgbleLtgFltStsNoFaults" 1 " EnRecfgbleLtgFltStsLeftFaulty" 2 " EnRecfgbleLtgFltStsRightFaulty" 3 " EnRecfgbleLtgFltStsAllFaulty" 14 " EnRecfgbleLtgFltStsError" 15 " EnRecfgbleLtgFltStsNotAvailable" ;
VAL_ 2565865307 LeftFlasherLightFaultState 0 " EnOnOff2StatesOff" 1 " EnOnOff2StatesOn" 2 " EnOnOff2StatesError" 3 " EnOnOff2StatesNotAvailable" ;
VAL_ 2565865307 RightFlasherLightFaultState 0 " EnOnOff2StatesOff" 1 " EnOnOff2StatesOn" 2 " EnOnOff2StatesError" 3 " EnOnOff2StatesNotAvailable" ;
VAL_ 2565865416 CmdBytePGN61184_DC1 7922 "JD_ACKnowledgement " 241 "Prop_Request_PGN_Dual_Cmd_Byte " 219 "Prop_Request_PGN_Single_Cmd_Byte " ;
VAL_ 2565865450 CmdBytePGN61184_FED 7922 "JD_ACKnowledgement " 2553 "JD_Network_Capabilities " 241 "Prop_Request_PGN_Dual_Cmd_Byte " 219 "Prop_Request_PGN_Single_Cmd_Byte " 15858 "ResponseHarvesterSetpointAdjust " ;
VAL_ 2565851185 CmdBytePGN61184_CAB 7922 "JD_ACKnowledgement " ;
VAL_ 2565859889 CmdBytePGN61184_CAB 7922 "JD_ACKnowledgement " ;
VAL_ 2565860145 CmdBytePGN61184_CAB 7922 "JD_ACKnowledgement " ;
VAL_ 2565823281 CmdBytePGN61184_CAB 7922 "JD_ACKnowledgement " ;
VAL_ 2565812680 CmdBytePGN61184_DC1 7922 "JD_ACKnowledgement " ;
VAL_ 2565860040 CmdBytePGN61184_DC1 7922 "JD_ACKnowledgement " ;
VAL_ 2565860296 CmdBytePGN61184_DC1 7922 "JD_ACKnowledgement " ;
VAL_ 2565823432 CmdBytePGN61184_DC1 7922 "JD_ACKnowledgement " ;
VAL_ 2565812714 CmdBytePGN61184_FED 7922 "JD_ACKnowledgement " ;
VAL_ 2565851370 CmdBytePGN61184_FED 7922 "JD_ACKnowledgement " ;
VAL_ 2565860330 CmdBytePGN61184_FED 7922 "JD_ACKnowledgement " ;
VAL_ 2565823466 CmdBytePGN61184_FED 7922 "JD_ACKnowledgement " ;
VAL_ 2565812715 CmdBytePGN61184_HAD 7922 "JD_ACKnowledgement " ;
VAL_ 2565851371 CmdBytePGN61184_HAD 7922 "JD_ACKnowledgement " ;
VAL_ 2565860075 CmdBytePGN61184_HAD 7922 "JD_ACKnowledgement " ;
VAL_ 2565823467 CmdBytePGN61184_HAD 7922 "JD_ACKnowledgement " ;
VAL_ 2565812571 CmdBytePGN61184_POD 7922 "JD_ACKnowledgement " ;
VAL_ 2565851227 CmdBytePGN61184_POD 7922 "JD_ACKnowledgement " ;
VAL_ 2565859931 CmdBytePGN61184_POD 7922 "JD_ACKnowledgement " ;
VAL_ 2565860187 CmdBytePGN61184_POD 7922 "JD_ACKnowledgement " ;
VAL_ 2566912859 CmdBytePGN65531_POD 1280 "JD_Displayed_Engine_Power " 33024 "Mission_Power_Information " 5121 "PowerMeterAutomation " 4865 "PowerMeterThresholds " 12288 "Vehicle_Configuration_Management_Response " ;
VAL_ 2566912859 DisplayedEnginePowerMode 0 " Blank_no_text_shown" 1 " ECO" 2 " MAX" 3 " PPT" 14 " Error" 15 " NotAvailable" ;
VAL_ 2566912859 MissionPowerStatus 0 " Unpowered" 1 " Starting" 2 " Powered" 3 " ShuttingDown" 14 " Error" 15 " Not available" ;
VAL_ 2498756602 CmdBytePGN61184_OBT_FA 8292 "JDAftertreatmentServiceInterface " 2916 "JDEngineTestMessage " ;
VAL_ 2498756602 JDEngineTestMode 0 " No_Test_Enabled" 1 " Harness_Diagnostics" 255 " NotAvailable" ;
VAL_ 2498756602 JDEngineTestState 0 " Off" 1 " Active" 2 " Aborted" 3 " Complete" 254 " Error" 255 " NotAvailable" ;
VAL_ 2498756602 JDEngineTestActiveType 0 " Off" 1 " Factory" 2 " Application" 3 " Hold" 254 " Error" 255 " NotAvailable" ;
VAL_ 2498756602 JDEngineTestComponentID 0 " Engine_Position_and_Timing_Sensors" 1 " Oil_Control_Valve" 2 " Exhaust_Brake_1" 3 " Exhaust_Brake_2" 32 " Engine_Electric_Lift_Pump" 33 " Fuel_Injectors" 48 " High_Pressure_Fuel_Pump_Control_Valve" 49 " High_Pressure_Common_Rail_Fuel_Pressure_Relief_Valve" 64 " EGR_Valve" 65 " Air_Throttle" 66 " Exhaust_Throttle" 67 " Turbocharger_Actuator" 68 " Exhaust_Throttle_Power" 69 " Turbocharger_Compressor_Inlet_Sensor_Power" 70 " Turbocharger_Speed_Sensor" 80 " DEF_Supply_Module_Pump" 81 " DEF_Supply_Module_Reverting_Valve" 82 " DEF_Tank_Coolant_Control_Valve" 83 " DEF_Suction_Line_Heater" 84 " DEF_Pressure_Line_Heater" 85 " DEF_Return_Line_Heater" 86 " DEF_Module_Heater" 87 " DEF_Header_Power" 88 " NOx_Sensor_Power" 96 " Starter_Relay" 97 " Starter_Relay_Low_Side" 98 " Alternator_1_L_Terminal" 99 " Alternator_2_L_Terminal" 100 " Cold_Start" 101 " AC_Compressor" 102 " Air_Brake_Compressor" 103 " Fan_Reverse" 104 " Fan_Forward" 105 " Fan_Speed_Sensor" 106 " Vehicle_or_Other_Speed_Sensor" 107 " Spare_Sensor_Power" 108 " OEM_Spare_High_Side_Driver" 109 " OEM_Spare_1_High_Side_Driver" 110 " OEM_Spare_2_High_Side_Driver" 254 " Error" 255 " Not_available" ;
VAL_ 2498756602 HydrocarbonInjectorPurge 0 " Disable" 1 " Enable" 2 " Rsrvd_Stds" 3 " Dont care take no action" ;
VAL_ 2498756602 DiesOxidCataServReplComp 0 " Not Active" 1 " Active" 2 " Rsrvd_Stds" 3 " Dont care take no action" ;
VAL_ 2498756602 DiesPartFiltUninHydrDiagClea 0 " Not Active" 1 " Active" 2 " Rsrvd_Stds" 3 " Dont care take no action" ;
VAL_ 2498756602 DiesOxidCataOutlTempDiagClea 0 " Not Active" 1 " Active" 2 " Rsrvd_Stds" 3 " Dont care take no action" ;
VAL_ 2498756602 DiesOxidCataUninHydrDiagClea 0 " Not Active" 1 " Active" 2 " Rsrvd_Stds" 3 " Dont care take no action" ;
VAL_ 2498756602 DiesPartFiltServReplComp 0 " Not Active" 1 " Active" 2 " Rsrvd_Stds" 3 " Dont care take no action" ;
VAL_ 2498756602 AfteDiesPartFiltRegeCleaFreqFaul 0 " Take no action" 1 " Reset" 2 " Rsrvd_Stds" 3 " Not applicable" ;
VAL_ 2498756602 ServcRegenReq 0 " Not Active" 1 " Active" 2 " Rsrvd_Stds" 3 " Dont care take no action" ;
VAL_ 2498756602 AfteDiesExhaFluiPresContRequ 0 " False" 1 " True" 2 " Rsrvd_Stds" 3 " Dont care take no action" ;
VAL_ 2498756602 AfteSCRReplRese 0 " Not Active" 1 " Active" 2 " Rsrvd_Stds" 3 " Dont care take no action" ;
VAL_ 2498756602 AfteDiesPartFiltOutlGasHighTempStatComm 0 " Not Active" 1 " Active" 2 " Rsrvd_Stds" 3 " Dont care take no action" ;
VAL_ 2498756602 AfteDiesExhaFluiTankHeatCoolValvTest 0 " Not Active" 1 " Active" 2 " Rsrvd_Stds" 3 " Dont care take no action" ;
VAL_ 2498756602 AfteDiesExhaFluiSystShutTest 0 " Not Active" 1 " Active" 2 " Rsrvd_Stds" 3 " Dont care take no action" ;
VAL_ 2498756602 AfteDiesExhaFluiInjeDiagTest 0 " Not Active" 1 " Active" 2 " Rsrvd_Stds" 3 " Dont care take no action" ;
VAL_ 2498756602 AfteDiesExhaFluiInjeQuanTest 0 " Not Active" 1 " Active" 2 " Rsrvd_Stds" 3 " Dont care take no action" ;
VAL_ 2566912747 CmdBytePGN65530_HAD 29185 "JD_Configurable_Lighting_Status_-_Left_Hand_Work_Lights " 29441 "JD_Configurable_Lighting_Status_-_Right_Hand_Work_Lights " 35330 "SetpointInfoRequestHarvesterSetpointAdjust " ;
VAL_ 2566912747 WorkLight4LeftStatus 0 " Deactivated" 1 " Activated" 2 " Fault_Detected" 3 " Not_Available" ;
VAL_ 2566912747 WorkLight10LeftStatus 0 " Deactivated" 1 " Activated" 2 " Fault_Detected" 3 " Not_Available" ;
VAL_ 2566912747 WorkLight22LeftStatus 0 " Deactivated" 1 " Activated" 2 " Fault_Detected" 3 " Not_Available" ;
VAL_ 2566912747 WorkLight4RightStatus 0 " Deactivated" 1 " Activated" 2 " Fault_Detected" 3 " Not_Available" ;
VAL_ 2566912747 WorkLight10RightStatus 0 " Deactivated" 1 " Activated" 2 " Fault_Detected" 3 " Not_Available" ;
VAL_ 2566912747 WorkLight19RightStatus 0 " Deactivated" 1 " Activated" 2 " Fault_Detected" 3 " Not_Available" ;
VAL_ 2566912747 WorkLight20RightStatus 0 " Deactivated" 1 " Activated" 2 " Fault_Detected" 3 " Not_Available" ;
VAL_ 2566912747 WorkLight22RightStatus 0 " Deactivated" 1 " Activated" 2 " Fault_Detected" 3 " Not_Available" ;
VAL_ 2565864190 CmdBytePGN61184_Vector_XXX 356 "JDEngineFunctionalTest " ;
VAL_ 2565864190 CompressionTest 0 " Enabled" 1 " Disabled" ;
VAL_ 2565864190 CylinderDiagnostics 0 " Enabled" 1 " Disabled" ;
VAL_ 2565864190 CylinderCutoutTest 0 " Enabled" 1 " Disabled" ;
VAL_ 2565864190 CylinderDiagnosticsTrigger 0 " Enabled" 1 " Disabled" ;
VAL_ 2565864190 ActuatorDriverTest 0 " Enabled" 1 " Disabled" ;
VAL_ 2565864190 EngiOverShutTestEnab 0 " Inactive" 1 " Active" 2 " Reserved" 3 " TakeNoAction" ;
VAL_ 2565864190 CompressionTestState 0 " Disabled" 1 " Possible" 2 " Active" 3 " TemperatureError" 4 " EngineModeError" 5 " EngineSpeedError" 6 " CamCrankError" 7 " TooMuchTime" 8 " Cancelled" 9 " Successful" 254 " Error" 255 " NotAvailable" ;
VAL_ 2565864190 CylinderDiagnosticsState 0 " NeverActive" 1 " InProgress" 2 " TemperatureError" 3 " CamOrCrankFailure" 4 " ImproperEngineMode" 5 " Overspeed" 6 " ThrottleError" 7 " Timeout" 8 " Cancelled" 9 " SuccessfulCompletion" 10 " WaitingForTrigger" 254 " Error" 255 " NotAvailable" ;
VAL_ 2364538878 CmdBytePGN61184_Vector_XXX 1636 "JDEngineControlMessage1 " ;
VAL_ 2566912049 CmdBytePGN65528_CAB 69 "JDLightingCommand3 " ;
VAL_ 2566912049 MacExtrIllmnOpertTrig 0 " DEM_Off" 1 " DEM_Park_Light" 2 " DEM_Road_Light" 3 " DEM_Field_Light" 4 " DEM_Egress_Light" 15 " DEM_Not_available_or_not_installed" ;
VAL_ 2566912049 LtgModReq 0 " EnLtgModReqOff" 1 " EnLtgModReqPark" 2 " EnLtgModReqRoadLow" 3 " EnLtgModReqRoadHigh" 4 " EnLtgModReqField1" 5 " EnLtgModReqField2" 6 " EnLtgModReqEgress" 14 " EnLtgModReqError" 15 " EnLtgModReqNotAvailable" ;
VAL_ 2364538859 CmdBytePGN61184_HAD 9714 "LightingLightbarStateControl " ;
VAL_ 2566912216 CmdBytePGN65528_MTU 84 "Machine_Control_-_GPS/Cell_Start_Inhibit " ;
VAL_ 2566912216 EngStartPrevent 0 " No Inhibit" 1 " Inhibit One" 2 " Inhibit Two" 14 " Error" 15 " Not Available or Not Installed" ;
VAL_ 2565865465 CmdBytePGN61184_OBT 11250 "Machine_Network_Health_Data_Command " ;
VAL_ 2565865466 CmdBytePGN61184_OBT_FA 11250 "Machine_Network_Health_Data_Command " ;
VAL_ 2565860090 CmdBytePGN61184_OBT_FA 11250 "Machine_Network_Health_Data_Command " ;
VAL_ 2565860346 CmdBytePGN61184_OBT_FA 11250 "Machine_Network_Health_Data_Command " ;
VAL_ 2565823482 CmdBytePGN61184_OBT_FA 11250 "Machine_Network_Health_Data_Command " ;
VAL_ 2565860089 CmdBytePGN61184_OBT 11250 "Machine_Network_Health_Data_Command " ;
VAL_ 2565860345 CmdBytePGN61184_OBT 11250 "Machine_Network_Health_Data_Command " ;
VAL_ 2565823481 CmdBytePGN61184_OBT 11250 "Machine_Network_Health_Data_Command " ;
VAL_ 2431647526 CmdBytePGN61184_VTV 2383 "Massflow/Moisture_PGN " ;
VAL_ 2431647526 AutoSendMassUnit 0 " Kg" 1 " 10kg" 2 " 100kg" 3 " 1000kg" 14 " Error" 15 " NotAvailable" ;
VAL_ 2364538662 CmdBytePGN61184_VTV 16996 "Moisture_Sensor_Grain_Bypass_Request " ;
VAL_ 2364538662 CleanGrainBypActivationRequest 0 " DEM_Deactivate" 1 " DEM_Activate" 14 " DEM_Error" 15 " DEM_Not_available_or_not_installed" ;
VAL_ 2364538662 ProdMoistSnsrFillSnsState 0 " Off" 1 " On" 2 " Error" 3 " Not Available" ;
VAL_ 2565865254 CmdBytePGN61184_VTV 15346 "MSCCalibrationStatus " 15602 "RequestHarvesterSetpointAdjust " ;
VAL_ 2565865254 CalibrationStatus 0 " Calibration Failed" 1 " Calibration Save Requested Too Fast" 2 " Calibration Save Requested Succeeded" 3 " Calibration Save Requested Succeeded No Change" 4 " Calibration No Save Requested Succeeded" 5 " Calibration Not Calibrated" 6 " Calibration Is Calibrated" 7 " Calibration Warmup" 254 " Calibration Error" 255 " Calibration Not available or Not installed" ;
VAL_ 2566911192 CmdBytePGN65524_MTU 53 "MTU_Proprietary_Message_#1 " ;
VAL_ 2566911192 CntlrHeartbeat_MTUPROP1 0 " Not active" 1 " Active" 2 " Error" 3 " Not Available" ;
VAL_ 2297429809 CmdBytePGN61184_CAB 2033 "OperatorControlsD1Command " ;
VAL_ 2297429809 OpCtrlD1CmdByte3BitPair12 0 " En_OnOff2States_Off" 1 " En_OnOff2States_On" 2 " En_OnOff2States_Error" 3 " En_OnOff2States_NotAvailable" ;
VAL_ 2297429809 OpCtrlD1CmdByte3BitPair56 0 " En_OnOff2States_Off" 1 " En_OnOff2States_On" 2 " En_OnOff2States_Error" 3 " En_OnOff2States_NotAvailable" ;
VAL_ 2297429809 OpCtrlD1CmdByte4BitPair12 0 " En_OnOff2States_Off" 1 " En_OnOff2States_On" 2 " En_OnOff2States_Error" 3 " En_OnOff2States_NotAvailable" ;
VAL_ 2297429809 OpCtrlD1CmdByte4BitPair56 0 " En_OnOff2States_Off" 1 " En_OnOff2States_On" 2 " En_OnOff2States_Error" 3 " En_OnOff2States_NotAvailable" ;
VAL_ 2297429809 OpCtrlD1CmdByte5BitPair12 0 " En_OnOff2States_Off" 1 " En_OnOff2States_On" 2 " En_OnOff2States_Error" 3 " En_OnOff2States_NotAvailable" ;
VAL_ 2297429809 OpCtrlD1CmdByte5BitPair34 0 " En_OnOff2States_Off" 1 " En_OnOff2States_On" 2 " En_OnOff2States_Error" 3 " En_OnOff2States_NotAvailable" ;
VAL_ 2297429809 OpCtrlD1CmdByte5BitPair56 0 " En_OnOff2States_Off" 1 " En_OnOff2States_On" 2 " En_OnOff2States_Error" 3 " En_OnOff2States_NotAvailable" ;
VAL_ 2297429809 OpCtrlD1CmdByte5BitPair78 0 " En_OnOff2States_Off" 1 " En_OnOff2States_On" 2 " En_OnOff2States_Error" 3 " En_OnOff2States_NotAvailable" ;
VAL_ 2297429809 OpCtrlD1CmdByte6BitPair12 0 " En_OnOff2States_Off" 1 " En_OnOff2States_On" 2 " En_OnOff2States_Error" 3 " En_OnOff2States_NotAvailable" ;
VAL_ 2297429809 OpCtrlD1CmdByte6BitPair34 0 " En_OnOff2States_Off" 1 " En_OnOff2States_On" 2 " En_OnOff2States_Error" 3 " En_OnOff2States_NotAvailable" ;
VAL_ 2297429809 OpCtrlD1CmdByte6BitPair56 0 " En_OnOff2States_Off" 1 " En_OnOff2States_On" 2 " En_OnOff2States_Error" 3 " En_OnOff2States_NotAvailable" ;
VAL_ 2297429809 OpCtrlD1CmdByte6BitPair78 0 " En_OnOff2States_Off" 1 " En_OnOff2States_On" 2 " En_OnOff2States_Error" 3 " En_OnOff2States_NotAvailable" ;
VAL_ 2297429809 OpCtrlD1CmdByte7BitPair12 0 " En_OnOff2States_Off" 1 " En_OnOff2States_On" 2 " En_OnOff2States_Error" 3 " En_OnOff2States_NotAvailable" ;
VAL_ 2297429809 OpCtrlD1CmdByte7BitPair56 0 " En_OnOff2States_Off" 1 " En_OnOff2States_On" 2 " En_OnOff2States_Error" 3 " En_OnOff2States_NotAvailable" ;
VAL_ 2297429809 OpCtrlD1CmdByte8BitPair12 0 " En_OnOff2States_Off" 1 " En_OnOff2States_On" 2 " En_OnOff2States_Error" 3 " En_OnOff2States_NotAvailable" ;
VAL_ 2297429809 OpCtrlD1CmdByte8BitPair56 0 " En_OnOff2States_Off" 1 " En_OnOff2States_On" 2 " En_OnOff2States_Error" 3 " En_OnOff2States_NotAvailable" ;
VAL_ 2298476593 CmdBytePGN65528_CAB 133 "OperatorControlsEncoders2 " ;
VAL_ 2298476593 OperCtrlEncdr4Btn 0 " DEM_Off" 1 " DEM_On" 2 " DEM_Error" 3 " DEM_Not_available_or_not_installed" ;
VAL_ 2566912817 CmdBytePGN65531_CAB 9970 "OperatorSwitchControls4 " 32768 "Vehicle_State_Management " 12288 "Vehicle_Configuration_Management_Response " ;
VAL_ 2566912817 KeySwitchStart 0 " DEM_Off" 1 " DEM_On" 2 " DEM_Error" 3 " DEM_Not_available_or_not_installed" ;
VAL_ 2566912817 KeySwitchRun 0 " DEM_Off" 1 " DEM_On" 2 " DEM_Error" 3 " DEM_Not_available_or_not_installed" ;
VAL_ 2566912817 VehiclePowerState 0 " VEHICLE_STATE_OFF" 1 " VEHICLE_STATE_AWAKE" 2 " VEHICLE_STATE_STARTING" 3 " VEHICLE_STATE_WARMUP" 4 " VEHICLE_STATE_POWERED" 5 " VEHICLE_STATE_SHUTDOWN" 6 " VEHICLE_STATE_QUIET" ;
VAL_ 2297429851 CmdBytePGN61184_POD 22372 "PODPressureRequestCommands " ;
VAL_ 2297429851 DomainPcompRequestPOD 0 " Off" 1 " On" 2 " No_Command" 14 " Error" 15 " Not_available" ;
VAL_ 2298478058 CmdBytePGN65533_FED 256 "SettingSystemDetailsHarvesterSetpointAdjust_Priority2 " ;
VAL_ 2298478059 CmdBytePGN65533_HAD 256 "SettingSystemDetailsHarvesterSetpointAdjust_Priority2 " ;
VAL_ 2298477546 CmdBytePGN65531_FED 763 "SettingSystemDetailsHiRateHarvesterSetpointAdjust_Priority2 " ;
VAL_ 2298477547 CmdBytePGN65531_HAD 763 "SettingSystemDetailsHiRateHarvesterSetpointAdjust_Priority2 " ;
VAL_ 2432695038 CmdBytePGN65530_Vector_XXX 11008 "SlipClutchDisplayData " 4103 "WingPositions " ;
VAL_ 2432695038 SlipClutchState 0 " En_UIDisplayEnableState_Disabled" 1 " En_UIDisplayEnableState_Enabled" 2 " En_UIDisplayEnableState_FeatureHide" 3 " En_UIDisplayEnableState_FeatureError" 14 " En_UIDisplayEnableState_Error" 15 " En_UIDisplayEnableState_NotAvailable" ;
VAL_ 2298477094 CmdBytePGN65530_VTV 12544 "TailingsSystemStatus " ;
VAL_ 2298477094 TlngsOpt 0 " En_ExternalInterfaceBoolean_False" 1 " En_ExternalInterfaceBoolean_True" 2 " En_ExternalInterfaceBoolean_Error" 3 " En_ExternalInterfaceBoolean_NotAvailable" ;
VAL_ 2634021414 CmdBytePGN65530_VTV 58 "TCM_Calibration_Status " ;
VAL_ 2634021414 TCMCalStatus 0 " En_TCMCalibrationStatus_ Pending" 1 " En_TCMCalibrationStatus_ CalibrationValid" 2 " En_TCMCalibrationStatus_ CalibrationInvalid" 14 " En_TCMCalibrationStatus_ Error" 15 " En_TCMCalibrationStatus_ Not Available" ;
VAL_ 2365587238 CmdBytePGN65535_VTV 225 "Vehicle_Roll/Yaw_Rate " ;
VAL_ 2566912968 CmdBytePGN65531_DC1 12288 "Vehicle_Configuration_Management_Response " ;
VAL_ 2566913318 CmdBytePGN65533_VTV 1792 "VirtualTerminalToFrontEndDomainCommands1 " ;
VAL_ 2566913318 FeedModuForwComm 0 " DEM_Off" 1 " DEM_On" 2 " DEM_Reserved__Stds" 3 " DEM_Dont_caretake_no_action" ;
VAL_ 2566913318 FeedModuReveComm 0 " DEM_Off" 1 " DEM_On" 2 " DEM_Reserved__Stds" 3 " DEM_Dont_caretake_no_action" ;
