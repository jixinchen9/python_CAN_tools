VERSION ""

NS_ :

BS_ :

BU_ : CAB FED HAD JDL OBT OBT_FA PDU POD VTV XCP DC1 MTU

BO_ 2566912550 Mx_FFFA_P6_0x26: 8 VTV
 SG_ CmdBytePGN65530_VTV M : 0|16@1+ (1,0) [0|0] ""  HAD,JDL,FED
 SG_ GSAEngineSpeedDelta m263 : 32|16@1+ (0.003906,-127) [-127|128] ""  JDL
 SG_ GSADeltaValue m519 : 16|8@1+ (1,-127) [-127|128] ""  JDL
 SG_ GSAEffectiveTargetEnginePower m775 : 32|8@1+ (1,0) [0|255] ""  JDL
 SG_ GSAMaxGroundSpeed m1031 : 16|16@1+ (0.003906,0) [0|256] ""  JDL
 SG_ GSATargetEnginePower m1287 : 48|8@1+ (1,0) [0|255] ""  JDL
 SG_ AutoUnloadAugerEngmtCmd m9216 : 16|4@1+ (1,0) [0|15] ""  HAD
 SG_ HdrAutomationFeaturesReset m21249 : 16|4@1+ (1,0) [0|15] ""  Vector__XXX
 SG_ ShoeAreaLoss m23040 : 16|16@1+ (0.001,0) [0|20] ""  JDL
 SG_ SepAreaLoss m23040 : 32|16@1+ (0.001,0) [0|20] ""  JDL
 SG_ ShoePercentLoss m25600 : 16|16@1+ (0.001,0) [0|60] ""  JDL
 SG_ SepPercentLoss m25600 : 32|16@1+ (0.001,0) [0|60] ""  JDL
 SG_ GrainLossScaleFactor m25600 : 48|16@1+ (0.001,0) [0|65] ""  JDL
 SG_ HarvSetpInfoAckRespB1 m35586 : 16|48@1+ (1,0) [0|281474976710655] ""  FED,HAD

BO_ 2499803686 Mx_FFFA_P5_0x26: 8 VTV
 SG_ CmdBytePGN65530_VTV M : 0|16@1+ (1,0) [0|0] ""  JDL,PDU
 SG_ HdrGndSetg m4359 : 16|8@1+ (1,0) [0|255] ""  Vector__XXX
 SG_ FlexWingTunRatRstToDft m4359 : 36|2@1+ (1,0) [0|3] ""  Vector__XXX
 SG_ GSAflpRMSE m4871 : 16|16@1+ (1,0) [0|65535] "Count"  JDL
 SG_ GSAmbfRMSE m4871 : 32|16@1+ (1,0) [0|65535] "Count"  JDL
 SG_ GSAfusedRMSE m4871 : 48|16@1+ (1,0) [0|65535] "Count"  JDL
 SG_ GSACoverageMapRMSE m5127 : 16|16@1+ (1,0) [0|65535] "Count"  JDL
 SG_ GSAConstantRMSE m5127 : 32|16@1+ (1,0) [0|65535] "Count"  JDL
 SG_ GSAActivePredictionSource m5127 : 48|4@1+ (1,0) [0|15] ""  JDL
 SG_ GSAActiveControlMode m5383 : 16|4@1+ (1,0) [0|15] ""  JDL
 SG_ GSAActiveUnloadingOnTheGoMode m5383 : 20|4@1+ (1,0) [0|15] ""  JDL
 SG_ GSATerrainCompensationEnabled m5383 : 24|4@1+ (1,0) [0|15] ""  JDL
 SG_ GSADownCropEnabled m5383 : 32|4@1+ (1,0) [0|15] ""  JDL
 SG_ GSADownCropSensitivity m5383 : 36|4@1+ (1,0) [0|15] ""  JDL
 SG_ GSADownCropMaxSpeed m5383 : 40|16@1+ (0.00390625,0) [0|255.996] ""  JDL
 SG_ GSACropState m5383 : 56|8@1+ (1,0) [0|255] ""  JDL
 SG_ MBFHealthStatus m5639 : 16|4@1+ (1,0) [0|15] ""  JDL
 SG_ AutoDeckPlateToggleRequest m21761 : 16|2@1+ (1,0) [0|3] ""  Vector__XXX
 SG_ AutoDeckPlateTightnessLevel m21761 : 20|4@1+ (1,0) [0|15] ""  Vector__XXX
 SG_ SlipClutchDetectionToggleRequest m21761 : 24|8@1+ (1,0) [0|255] ""  Vector__XXX
 SG_ TotalBrokenGrainFilter1 m32771 : 16|16@1+ (0.002,0) [0|100] ""  JDL
 SG_ TotalForeignMaterialFilter1 m32771 : 32|16@1+ (0.002,0) [0|100] ""  JDL
 SG_ TotalGrainLossFilter1 m32771 : 48|16@1+ (0.0008,0) [0|51.404] ""  JDL
 SG_ MassFlowRateFilter1 m33027 : 16|16@1+ (0.2,0) [0|10000] ""  JDL
 SG_ MassFlowRateFilter2 m33027 : 32|16@1+ (0.2,0) [0|10000] ""  JDL
 SG_ TotalBrokenGrainUserDefinedLimit m33283 : 16|16@1+ (0.002,0) [0|100] ""  Vector__XXX
 SG_ TotaForeMateUserDefiLimi m33283 : 32|16@1+ (0.002,0) [0|100] ""  Vector__XXX
 SG_ TotalGrainLossUserDefinedLimit m33283 : 48|16@1+ (0.0008,0) [0|51.404] ""  Vector__XXX
 SG_ GrainLossDispOpt m33539 : 16|4@1+ (1,0) [0|15] ""  PDU

BO_ 2365585958 Mx_FFFA_P3_0x26: 8 VTV
 SG_ CmdBytePGN65530_VTV M : 0|16@1+ (1,0) [0|0] ""  JDL,PDU,HAD
 SG_ VehRollAng m8224 : 16|16@1+ (0.0078125,-200) [-200|301.99] "deg"  HAD
 SG_ RollRateExtRange m8224 : 32|16@1+ (0.0078125,-250) [-250|250.992] "deg/sec"  HAD
 SG_ GSALimitingFactor m17665 : 16|4@1+ (1,0) [0|15] ""  JDL,PDU

BO_ 2499804158 Mx_FFFB_P5_0xFE: 8 Vector__XXX
 SG_ CmdBytePGN65531_Vector_XXX M : 0|16@1+ (1,0) [0|0] ""  JDL,FED,POD,VTV
 SG_ GSAStatus m249 : 16|8@1+ (1,0) [0|255] ""  FED,POD,VTV
 SG_ GSAOperatorDesiredSpeed m249 : 24|16@1+ (0.00390625,0) [0|250.996] "KiloMtrPerHr"  VTV
 SG_ GSAMinVehSpdLim m249 : 40|16@1+ (0.00390625,0) [0|250.996] "KiloMtrPerHr"  VTV
 SG_ ReelAutomationAutoActivation m1571 : 16|8@1+ (1,0) [0|255] ""  JDL
 SG_ ReelAutomationManualActivation m1571 : 24|8@1+ (1,0) [0|255] ""  JDL
 SG_ ReelAutomationPseudoResume m1571 : 32|8@1+ (1,0) [0|255] ""  JDL
 SG_ HSAUtilization m3579 : 16|4@1+ (1,0) [0|15] ""  JDL
 SG_ GSAUtilization m3579 : 20|4@1+ (1,0) [0|15] ""  JDL
 SG_ TSAUtilization m3579 : 24|4@1+ (1,0) [0|15] ""  JDL
 SG_ ReelAutomationUtilization m3579 : 32|4@1+ (1,0) [0|15] ""  JDL
 SG_ DownCropReelAutoUtil m3579 : 36|4@1+ (1,0) [0|15] ""  JDL
 SG_ TerrFollAutoUtil m3579 : 40|4@1+ (1,0) [0|15] ""  JDL
 SG_ CurrentCropProcessingPower m7675 : 16|8@1+ (1,0) [0|250] ""  JDL
 SG_ LossCropProcessingPowerTarget m7675 : 24|8@1+ (1,0) [0|250] ""  JDL
 SG_ TerrainCropProcessingPowerTarget m7675 : 32|8@1+ (1,0) [0|250] ""  JDL
 SG_ CropProcessingPowerTarget m7675 : 40|8@1+ (1,0) [0|250] ""  JDL
 SG_ MaxCropProcessingTarget m7675 : 48|8@1+ (1,0) [0|250] ""  JDL
 SG_ EstimatedUnloadingPowerPercent m7675 : 56|8@1+ (1,0) [0|250] ""  JDL
 SG_ MinCropProcessingTarget m9459 : 16|8@1+ (1,0) [0|250] ""  JDL
 SG_ CropProcPoweInteStat m9459 : 24|4@1+ (1,0) [0|15] ""  JDL
 SG_ CropProcPoweInteTargValu m9715 : 16|8@1+ (1,0) [0|250] ""  JDL
 SG_ CropProcPoweInteCommStat m9715 : 24|4@1+ (1,0) [0|15] ""  JDL
 SG_ ActiEarSaveLeftActuPosi m29696 : 16|8@1+ (1,0) [0|100] ""  VTV
 SG_ ActiEarSaveRighActuPosi m29696 : 24|8@1+ (1,0) [0|100] ""  VTV
 SG_ ActiEarSaveMoveInteAchi m29696 : 32|2@1+ (1,0) [0|3] ""  VTV
 SG_ ActiveEarSaversLeftActuatorValid m29696 : 34|2@1+ (1,0) [0|3] ""  VTV
 SG_ ActiEarSaveRighActuVali m29696 : 36|2@1+ (1,0) [0|3] ""  VTV
 SG_ ActiEarSaveLinkUnliEnabStat m29696 : 38|2@1+ (1,0) [0|3] ""  VTV
 SG_ ActiveEarSaversOptionInstalled m29696 : 40|2@1+ (1,0) [0|3] ""  VTV
 SG_ ActiEarSaveHighCurrDete m29696 : 42|2@1+ (1,0) [0|3] ""  VTV
 SG_ LeftActiveEarSaversEnabled m29696 : 44|2@1+ (1,0) [0|3] ""  VTV
 SG_ RightActiveEarSaversEnabled m29696 : 46|2@1+ (1,0) [0|3] ""  VTV
 SG_ WingFoldInterlockOverlayBm m29952 : 16|16@1+ (1,0) [0|0] ""  VTV
 SG_ WingFoldUnfoldCmdActive m29952 : 32|2@1+ (1,0) [0|3] ""  VTV
 SG_ TerrFollAutoToggComm m29952 : 34|2@1+ (1,0) [0|3] ""  VTV
 SG_ TerrainFollowingAutomationMode m29952 : 36|4@1+ (1,0) [0|15] ""  VTV
 SG_ ReelExtendRetractSensorStatus m29952 : 40|4@1+ (1,0) [0|15] ""  VTV
 SG_ ReelRaiseLowerSensorStatus m29952 : 44|4@1+ (1,0) [0|15] ""  VTV
 SG_ ReelPositionResumeEnabled m29952 : 48|2@1+ (1,0) [0|3] ""  VTV
 SG_ HeaderWeightCalEnabled m29952 : 50|2@1+ (1,0) [0|3] ""  VTV
 SG_ AutoDPSensorStuckWSBm m29952 : 56|8@1+ (1,0) [0|0] ""  VTV
 SG_ CuttAutoLockConfEnabStatBm m30208 : 16|8@1+ (1,0) [0|0] ""  VTV
 SG_ CuttAutoLockUIConfEnabBm m30208 : 24|8@1+ (1,0) [0|0] ""  VTV

BO_ 2566913574 Mx_FFFE_P6_0x26: 8 VTV
 SG_ CmdBytePGN65534_VTV M : 0|8@1+ (1,0) [0|0] ""  JDL,HAD,POD
 SG_ FeedFrwdSpeed m17 : 8|16@1+ (0.125,0) [0|8031.875] "rpm"  JDL
 SG_ CropTypeID m51 : 8|8@1+ (1,0) [0|255] ""  HAD,POD
 SG_ HarvSepRotrPressState m55 : 40|4@1+ (1,0) [0|15] ""  JDL
 SG_ ProdMassFlowState m55 : 44|4@1+ (1,0) [0|15] ""  Vector__XXX
 SG_ GSALossMaintainEnable m196 : 24|2@1+ (1,0) [0|3] ""  JDL

BO_ 2566911230 Mx_FFF4_P6_0xFE: 8 Vector__XXX
 SG_ CmdBytePGN65524_Vector_XXX M : 0|8@1+ (1,0) [0|0] ""  PDU,VTV
 SG_ CrvtrCntrlATState_ATSV m95 : 24|4@1+ (1,0) [0|15] ""  PDU,VTV
 SG_ SteeredWheelAngle m95 : 8|16@1+ (0.0078125,-200) [-200|301.99] "deg"  VTV
 SG_ RedSteerWarnLightRequest m95 : 28|2@1+ (1,0) [0|3] ""  VTV
 SG_ Heartbeat m95 : 52|4@1+ (1,0) [0|15] "Count"  VTV
 SG_ AT2ExitCode_GMSJDE m99 : 8|8@1+ (1,0) [0|255] ""  VTV
 SG_ WheelBasedVehicleSpeed_GMSJDE m99 : 16|16@1+ (0.00390625,0) [0|0.9765625] "km/h"  VTV
 SG_ VehDirection m99 : 32|4@1+ (1,0) [0|15] ""  VTV
 SG_ AutoTracSystemState m99 : 36|4@1+ (1,0) [0|15] ""  VTV
 SG_ StarfireFwdCfg_GMSJDE m99 : 40|3@1+ (1,0) [0|7] ""  VTV
 SG_ ActivateGuidanceRequest m99 : 43|2@1+ (1,0) [0|3] ""  VTV
 SG_ AuxiliarySteerMode m99 : 48|4@1+ (1,0) [0|15] ""  VTV
 SG_ Heartbeat m99 : 52|4@1+ (1,0) [0|0] ""  VTV
 SG_ SensorType_LESS m101 : 8|4@1+ (1,0) [0|15] ""  VTV
 SG_ CalProgress_LESS m101 : 12|4@1+ (10,0) [0|100] "%"  VTV
 SG_ SensorVoltageLeft_LESS m101 : 16|8@1+ (0.1,0) [0|5.8] "V"  VTV
 SG_ SensorVoltageRight_LESS m101 : 24|8@1+ (0.1,0) [0|5.8] "V"  VTV
 SG_ SensorBias_LESS m101 : 32|10@1+ (1,-511) [-511|510] "mm"  VTV
 SG_ CalState_LESS m101 : 42|5@1+ (1,0) [0|31] ""  VTV
 SG_ CalPage_LESS m101 : 48|4@1+ (1,0) [0|15] ""  VTV
 SG_ SensorType_VSRS m108 : 8|4@1+ (1,0) [0|15] ""  VTV
 SG_ TransmissionState_VSRS m108 : 12|4@1+ (1,0) [0|15] ""  VTV
 SG_ WheelBasedVehicleSpeed_VSRS m108 : 16|16@1+ (0.00390625,0) [0|0.9765625] "km/h"  VTV
 SG_ AntennaLocationXaxis m108 : 32|16@1+ (0.001,0) [0|0] ""  VTV
 SG_ SensorShift m108 : 48|4@1+ (1,0) [0|15] ""  VTV

BO_ 2566912603 Mx_FFFA_P6_0x5B: 8 POD
 SG_ CmdBytePGN65530_POD M : 0|16@1+ (1,0) [0|0] ""  VTV,CAB
 SG_ RatedPower m518 : 16|16@1+ (1,0) [0|65535] ""  VTV
 SG_ PeakPower m518 : 32|16@1+ (1,0) [0|65535] ""  VTV
 SG_ TransmissionPowerPercent m518 : 48|8@1+ (1,-100) [-100|50] ""  VTV
 SG_ BoostPowerMeterStartYellowC m27136 : 16|8@1+ (0.5,0) [0|125.5] "%"  VTV
 SG_ BoostPowerMeterStartRedD m27136 : 24|8@1+ (0.5,0) [0|125.5] "%"  VTV
 SG_ BoostPowerMeterStartRedE m27136 : 32|8@1+ (0.5,0) [0|125.5] "%"  VTV
 SG_ WorkLight13LeftStatus m29185 : 40|2@1+ (1,0) [0|3] ""  CAB
 SG_ WorkLight13RightStatus m29441 : 40|2@1+ (1,0) [0|3] ""  CAB

BO_ 2566913585 CabClimate1_CAB: 8 CAB
 SG_ CmdBytePGN65534_CAB M : 0|8@1+ (1,0) [0|0] ""  POD
 SG_ CabACRefCmprsrOutPress m11 : 24|8@1+ (16,0) [0|4000] ""  POD

BO_ 2565864446 Mx_EFFB_P6_0xFE: 8 Vector__XXX
 SG_ CmdBytePGN61184_Vector_XXX M : 0|16@1+ (1,0) [0|0] ""  JDL
 SG_ ForwardEyeOpeningPort1 m33018 : 16|8@1+ (1,0) [0|100] "%"  JDL
 SG_ ForwardLinkMarginPort1 m33018 : 24|8@1+ (10,0) [0|2560] "mV"  JDL
 SG_ ReverseLinkMarginPort1 m33018 : 32|8@1+ (10,0) [0|2560] "mV"  JDL
 SG_ CurrentDrawPort1 m33018 : 40|6@1+ (5,0) [0|320] "mA"  JDL
 SG_ ForwardEyeOpeningPort3 m33530 : 16|8@1+ (1,0) [0|100] "%"  JDL
 SG_ ForwardLinkMarginPort3 m33530 : 24|8@1+ (10,0) [0|2560] "mV"  JDL
 SG_ ReverseLinkMarginPort3 m33530 : 32|8@1+ (10,0) [0|2560] "mV"  JDL
 SG_ CurrentDrawPort3 m33530 : 40|6@1+ (5,0) [0|320] "mA"  JDL
 SG_ EthernetStatus m35066 : 16|3@1+ (1,0) [0|7] ""  JDL
 SG_ WatchdogReason m35066 : 19|5@1+ (1,0) [0|31] ""  JDL
 SG_ ControllerTemperature m35066 : 24|8@1+ (1,0) [0|255] ""  JDL
 SG_ WatchdogCount m35066 : 32|8@1+ (1,0) [0|255] ""  JDL

BO_ 2565865470 Mx_EFFF_P6_0xFE: 8 Vector__XXX
 SG_ CmdBytePGN61184_Vector_XXX M : 0|16@1+ (1,0) [0|0] ""  JDL,POD,CAB,PDU,VTV,OBT_FA
 SG_ CompressionTest m356 : 16|1@1+ (1,0) [0|1] ""  OBT_FA
 SG_ CylinderDiagnostics m356 : 17|1@1+ (1,0) [0|1] ""  OBT_FA
 SG_ CylinderCutoutTest m356 : 18|1@1+ (1,0) [0|1] ""  OBT_FA
 SG_ CylinderDiagnosticsTrigger m356 : 19|1@1+ (1,0) [0|1] ""  OBT_FA
 SG_ ActuatorDriverTest m356 : 20|1@1+ (1,0) [0|1] ""  OBT_FA
 SG_ EngiOverShutTestEnab m356 : 22|2@1+ (1,0) [0|3] ""  OBT_FA
 SG_ CompressionTestState m356 : 24|8@1+ (1,0) [0|255] ""  OBT_FA
 SG_ CylinderDiagnosticsState m356 : 32|8@1+ (1,0) [0|255] ""  OBT_FA
 SG_ CylinderCutoutCylinderNumber m356 : 40|8@1+ (1,0) [0|12] ""  OBT_FA
 SG_ ActuatorTestIndex m356 : 48|5@1+ (1,0) [0|0] ""  OBT_FA
 SG_ ActuatorTestType m356 : 53|2@1+ (1,0) [0|0] ""  OBT_FA
 SG_ ActuatorOutputValue m356 : 56|8@1+ (1,0) [0|250] ""  OBT_FA
 SG_ AftrNmbrSulfDepCleaEven m1015 : 16|16@1+ (1,0) [0|5] ""  JDL
 SG_ AftrNmbrNOxCnvrEffnRcovEven m1015 : 32|16@1+ (1,0) [0|5] ""  JDL
 SG_ AftrtrtmntNmbrUreaDepCleanEvent m1015 : 48|16@1+ (1,0) [0|5] ""  JDL
 SG_ JDPresEngCtrlMode m4196 : 16|8@1+ (1,0) [0|255] ""  JDL
 SG_ EngOpStateFromEcu m8696 : 16|4@1+ (1,0) [0|15] ""  CAB
 SG_ EngWaitToStartLamp m8696 : 20|2@1+ (1,0) [0|3] ""  CAB,PDU
 SG_ EngProtectSysHasShtdwnEng m8696 : 22|2@1+ (1,0) [0|3] ""  CAB
 SG_ RemainingStartingAidTime m8696 : 24|16@1+ (1,0) [0|64255] ""  CAB,PDU
 SG_ EngStrCooldwnTimer m8696 : 40|8@1+ (1,0) [0|250] ""  CAB
 SG_ MngdEngShutdwnCooldwnTimer m8696 : 48|16@1+ (1,0) [0|64255] ""  CAB,POD
 SG_ EngTorqueDerateSetpnt m9060 : 24|8@1+ (0.4,0) [0|100] ""  POD
 SG_ DPFTtlNmbrOfActRegen m10993 : 16|16@1+ (1,0) [0|64255] ""  JDL
 SG_ DPFTtlNmbrOfAbrtdRegen m10993 : 32|16@1+ (1,0) [0|64255] ""  JDL
 SG_ DPFPresNmbrAbortRegen m10993 : 48|16@1+ (1,0) [0|64255] ""  JDL
 SG_ SPRMaxTorque m21860 : 16|16@1+ (0.0625,0) [0|4095] ""  JDL
 SG_ SPRActiveFlag m21860 : 32|2@1+ (1,0) [0|3] ""  JDL
 SG_ HeadOffGrouContModeAllo m30564 : 16|4@1+ (1,0) [0|15] ""  VTV
 SG_ HeadOnGrouContModeAllo m30564 : 20|4@1+ (1,0) [0|15] ""  VTV
 SG_ ForwardEyeOpeningPort1 m33018 : 16|8@1+ (1,0) [0|100] "%"  JDL
 SG_ ForwardLinkMarginPort1 m33018 : 24|8@1+ (10,0) [0|2560] "mV"  JDL
 SG_ ReverseLinkMarginPort1 m33018 : 32|8@1+ (10,0) [0|2560] "mV"  JDL
 SG_ CurrentDrawPort1 m33018 : 40|6@1+ (5,0) [0|320] "mA"  JDL
 SG_ HeaderAuxIconEnbld m33124 : 20|2@1+ (1,0) [0|3] ""  PDU
 SG_ ForwardEyeOpeningPort3 m33530 : 16|8@1+ (1,0) [0|100] "%"  JDL
 SG_ ForwardLinkMarginPort3 m33530 : 24|8@1+ (10,0) [0|2560] "mV"  JDL
 SG_ ReverseLinkMarginPort3 m33530 : 32|8@1+ (10,0) [0|2560] "mV"  JDL
 SG_ CurrentDrawPort3 m33530 : 40|6@1+ (5,0) [0|320] "mA"  JDL
 SG_ EthernetStatus m35066 : 16|3@1+ (1,0) [0|7] ""  JDL
 SG_ WatchdogReason m35066 : 19|5@1+ (1,0) [0|31] ""  JDL
 SG_ ControllerTemperature m35066 : 24|8@1+ (1,0) [0|255] ""  JDL
 SG_ WatchdogCount m35066 : 32|8@1+ (1,0) [0|255] ""  JDL

BO_ 2365584177 ClosSystPgnA18JDHWAutoShifPara_CAB: 8 CAB
 SG_ CmdBytePGN65523_CAB M : 0|8@1+ (1,0) [0|0] ""  POD,VTV,FED,HAD
 SG_ HydroHndlPstn m49 : 8|16@1+ (0.0025,0) [0|160.6375] ""  POD,VTV
 SG_ ParkBrakeReq m49 : 44|2@1+ (1,0) [0|3] ""  Vector__XXX
 SG_ HydHndlState m49 : 56|3@1+ (1,0) [0|7] ""  FED,HAD,POD

BO_ 2566913770 Mx_FFFE_P6_0xEA: 8 FED
 SG_ CmdBytePGN65534_FED M : 0|8@1+ (1,0) [0|0] ""  Vector__XXX

BO_ 2566913771 Mx_FFFE_P6_0xEB: 8 HAD
 SG_ CmdBytePGN65534_HAD M : 0|8@1+ (1,0) [0|0] ""  Vector__XXX

BO_ 2566913627 Mx_FFFE_P6_0x5B: 8 POD
 SG_ CmdBytePGN65534_POD M : 0|8@1+ (1,0) [0|0] ""  Vector__XXX
 SG_ EngType m236 : 8|8@1+ (1,0) [0|255] ""  Vector__XXX

BO_ 2566912200 ContDispPoweMana3_DC1: 8 DC1
 SG_ CmdBytePGN65528_DC1 M : 0|8@1+ (1,0) [0|0] ""  Vector__XXX

BO_ 2566912234 Mx_FFF8_P6_0xEA: 8 FED
 SG_ CmdBytePGN65528_FED M : 0|8@1+ (1,0) [0|0] ""  Vector__XXX
 SG_ CutterBarPstn m118 : 24|16@1+ (1,0) [0|64255] ""  Vector__XXX

BO_ 2566912235 Mx_FFF8_P6_0xEB: 8 HAD
 SG_ CmdBytePGN65528_HAD M : 0|8@1+ (1,0) [0|0] ""  VTV
 SG_ SeparatorEngagedVideoTrigger m239 : 16|4@1+ (1,0) [0|15] ""  VTV
 SG_ AugerEngagedVideoTrigger m239 : 20|4@1+ (1,0) [0|15] ""  VTV
 SG_ GrainTank_3_4_VideoTrigger m239 : 24|4@1+ (1,0) [0|15] ""  VTV
 SG_ GrainTankFullVideoTrigger m239 : 28|4@1+ (1,0) [0|15] ""  VTV
 SG_ SepaEngaReveVideTrig m239 : 32|4@1+ (1,0) [0|15] ""  VTV
 SG_ SepaDisEngaReveVideTrig m239 : 36|4@1+ (1,0) [0|15] ""  VTV
 SG_ AugerSwungOutVideoTrigger m239 : 40|4@1+ (1,0) [0|15] ""  VTV
 SG_ RoadTransportVideoTrigger m239 : 44|4@1+ (1,0) [0|15] ""  VTV

BO_ 2566912091 ContDispPoweMana3_POD: 8 POD
 SG_ CmdBytePGN65528_POD M : 0|8@1+ (1,0) [0|0] ""  Vector__XXX

BO_ 2498756586 Mx_EFFF_P5_0xEA: 8 FED
 SG_ CmdBytePGN61184_FED M : 0|16@1+ (1,0) [0|0] ""  CAB,HAD,PDU,VTV,POD
 SG_ CtlrDispPwrStateCmd m5876 : 16|4@1+ (1,0) [0|15] ""  CAB
 SG_ FdrhseRaiseLwrSysState m29284 : 16|4@1+ (1,0) [0|15] ""  HAD,PDU,VTV
 SG_ FdrhseLatTiltSysState m29284 : 20|4@1+ (1,0) [0|15] ""  PDU,VTV
 SG_ MachineHarvestingState m29284 : 24|2@1+ (1,0) [0|3] ""  HAD,POD,VTV
 SG_ HeaderDrive m29284 : 28|4@1+ (1,0) [0|15] ""  CAB,HAD,POD,VTV
 SG_ HdrType m29284 : 32|8@1+ (1,0) [0|255] ""  HAD,PDU,VTV
 SG_ HdrTiltAng m29284 : 40|8@1+ (0.4,0) [0|250] ""  PDU,VTV
 SG_ ReelSpeedSystemMode m29284 : 48|4@1+ (1,0) [0|15] ""  PDU,VTV
 SG_ ValidHeadConnectionStatus m29284 : 52|2@1+ (1,0) [0|3] ""  VTV
 SG_ FrntEndPreEngmtChecksPassd m29284 : 58|4@1+ (1,0) [0|15] ""  POD,VTV
 SG_ LateralTiltOptn m29284 : 62|2@1+ (1,0) [0|3] ""  Vector__XXX

BO_ 2498756587 Mx_EFFF_P5_0xEB: 8 HAD
 SG_ CmdBytePGN61184_HAD M : 0|16@1+ (1,0) [0|0] ""  CAB,VTV,OBT,POD,FED
 SG_ RoadFieldMode m2808 : 16|2@1+ (1,0) [0|3] ""  FED,POD,VTV
 SG_ AutoBeaconLightsCmd m2808 : 20|2@1+ (1,0) [0|3] ""  CAB,VTV
 SG_ EstimdRoadFieldMode m2808 : 32|2@1+ (1,0) [0|3] ""  FED,POD,VTV
 SG_ CtlrDispPwrStateCmd m5876 : 16|4@1+ (1,0) [0|15] ""  CAB
 SG_ UnldngAugerPstn m17252 : 16|8@1+ (0.4,0) [0|100] ""  VTV
 SG_ GrainTankFillLvl m17252 : 24|8@1+ (0.4,0) [0|100] ""  OBT,VTV
 SG_ UnldgAugBootPstn m17252 : 32|8@1+ (0.4,0) [0|100] ""  OBT,VTV
 SG_ GrainTankCoversState m17252 : 40|4@1+ (1,0) [0|15] ""  OBT,POD,VTV
 SG_ FoldingUnloadingAugerState m17252 : 44|4@1+ (1,0) [0|15] ""  VTV
 SG_ FountainLdngAugState m17252 : 48|4@1+ (1,0) [0|15] ""  OBT,VTV
 SG_ GrainTank34FullAlrm m17252 : 52|2@1+ (1,0) [0|3] ""  OBT,VTV
 SG_ GrainTankFullAlrm m17252 : 54|2@1+ (1,0) [0|3] ""  OBT,VTV
 SG_ UnloadingAugerDrive m17252 : 56|4@1+ (1,0) [0|15] ""  FED,OBT,POD,VTV
 SG_ UnldgAugBootCleanoutState m17252 : 60|4@1+ (1,0) [0|15] ""  VTV
 SG_ FeedAccelSpd m17764 : 16|16@1+ (1,0) [0|64255] ""  FED,OBT,VTV
 SG_ ShoeSpd m17764 : 32|16@1+ (1,0) [0|64255] ""  OBT,VTV
 SG_ CleanGrainElevSpd m17764 : 48|16@1+ (1,0) [0|64255] ""  OBT,VTV
 SG_ TailingsSpd m18020 : 16|16@1+ (1,0) [0|64255] ""  OBT,VTV
 SG_ SpreaderSpd m18020 : 48|16@1+ (1,0) [0|64255] ""  OBT,VTV
 SG_ LoadingAugSpd m18276 : 16|16@1+ (1,0) [0|64255] ""  OBT
 SG_ FrontCrossAugSpd m18276 : 32|16@1+ (1,0) [0|64255] ""  OBT
 SG_ ChopperSpd m18788 : 16|16@1+ (1,0) [0|64255] ""  OBT
 SG_ RearCrossAugSpd m18788 : 32|16@1+ (1,0) [0|64255] ""  OBT
 SG_ ProdFanSpd m19044 : 16|16@1+ (1,0) [0|64255] ""  OBT
 SG_ ChafferPstn m19044 : 32|8@1+ (1,-125) [-125|125] ""  OBT
 SG_ SievePstn m19044 : 40|8@1+ (1,-125) [-125|125] ""  OBT
 SG_ TotalSeparatorHours m21092 : 16|32@1+ (0.05,0) [0|210554060.75] ""  POD,VTV
 SG_ ThreshingPressure m38244 : 16|16@1+ (0.5,0) [0|0] ""  OBT,VTV
 SG_ ThreshingPressureStatus m38244 : 32|4@1+ (1,0) [0|15] ""  VTV
 SG_ TineSepGratePstn m38244 : 40|8@1+ (0.4,0) [0|100] ""  OBT

BO_ 2498756443 Mx_EFFF_P5_0x5B: 8 POD
 SG_ CmdBytePGN61184_POD M : 0|16@1+ (1,0) [0|0] ""  CAB,FED,HAD,VTV,PDU
 SG_ CtlrDispPwrStateCmd m5876 : 16|4@1+ (1,0) [0|15] ""  CAB
 SG_ AirCompEngageState m21348 : 32|2@1+ (1,0) [0|3] ""  FED,HAD,VTV
 SG_ LoBattVoltAlrm m21348 : 34|2@1+ (1,0) [0|3] ""  FED,HAD,VTV
 SG_ AltRegultrStateAlrm m21348 : 36|2@1+ (1,0) [0|3] ""  FED,HAD,VTV
 SG_ EngRun m21348 : 38|2@1+ (1,0) [0|3] ""  FED,HAD,VTV
 SG_ EngThrottleState m21348 : 40|8@1+ (1,0) [0|255] ""  FED,HAD,VTV
 SG_ EnginePowerPercent m21348 : 48|8@1+ (1,0) [0|125] ""  FED,PDU,VTV
 SG_ VehicleMovingState m21348 : 56|4@1+ (1,0) [0|15] ""  FED,HAD,VTV
 SG_ FlexpowerStatusToVeh m21348 : 60|2@1+ (1,0) [0|3] ""  VTV

BO_ 2632974171 Mx_EFFF_P7_0x5B: 8 POD
 SG_ CmdBytePGN61184_POD M : 0|16@1+ (1,0) [0|0] ""  JDL,HAD,VTV
 SG_ Opt4WD m22884 : 16|2@1+ (1,0) [0|3] ""  Vector__XXX
 SG_ EngSpdInRoadMode m22884 : 22|2@1+ (1,0) [0|3] ""  Vector__XXX
 SG_ OptType4WD m22884 : 24|4@1+ (1,0) [0|15] ""  JDL
 SG_ TracksOption m22884 : 32|4@1+ (1,0) [0|15] ""  HAD,VTV

BO_ 2634021610 ControllerHealthInfo_FED: 8 FED
 SG_ CmdBytePGN65530_FED M : 0|16@1+ (1,0) [0|0] ""  HAD,POD
 SG_ ControllerInfoFrame m11520 : 16|8@1+ (1,0) [0|0] ""  HAD,POD

BO_ 2634021611 ControllerHealthInfo_HAD: 8 HAD
 SG_ CmdBytePGN65530_HAD M : 0|16@1+ (1,0) [0|0] ""  FED,POD
 SG_ ControllerInfoFrame m11520 : 16|8@1+ (1,0) [0|0] ""  FED,POD

BO_ 2634021416 ControllerHealthInfo_PDU: 8 PDU
 SG_ CmdBytePGN65530_PDU M : 0|16@1+ (1,0) [0|0] ""  FED,HAD,POD
 SG_ ControllerInfoFrame m11520 : 16|8@1+ (1,0) [0|0] ""  FED,HAD,POD

BO_ 2634021467 Mx_FFFA_P7_0x5B: 8 POD
 SG_ CmdBytePGN65530_POD M : 0|16@1+ (1,0) [0|0] ""  FED,HAD,VTV
 SG_ ControllerInfoFrame m11520 : 16|8@1+ (1,0) [0|0] ""  FED,HAD
 SG_ GrouSpeeAutoMaxGrouSpdDec m34304 : 16|2@1+ (1,0) [0|3] ""  VTV
 SG_ GrouSpeeAutoMaxGrouSpdInc m34304 : 18|2@1+ (1,0) [0|3] ""  VTV

BO_ 2632974314 Mx_EFFF_P7_0xEA: 8 FED
 SG_ CmdBytePGN61184_FED M : 0|16@1+ (1,0) [0|0] ""  Vector__XXX

BO_ 2632974315 Mx_EFFF_P7_0xEB: 8 HAD
 SG_ CmdBytePGN61184_HAD M : 0|16@1+ (1,0) [0|0] ""  Vector__XXX

BO_ 2632974330 Mx_EFFF_P7_0xFA: 8 OBT_FA
 SG_ CmdBytePGN61184_OBT_FA M : 0|16@1+ (1,0) [0|0] ""  Vector__XXX

BO_ 2632969194 Mx_EFEB_P7_0xEA: 8 FED
 SG_ CmdBytePGN61184_FED M : 0|16@1+ (1,0) [0|0] ""  Vector__XXX

BO_ 2632932330 Mx_EF5B_P7_0xEA: 8 FED
 SG_ CmdBytePGN61184_FED M : 0|16@1+ (1,0) [0|0] ""  Vector__XXX

BO_ 2632968939 Mx_EFEA_P7_0xEB: 8 HAD
 SG_ CmdBytePGN61184_HAD M : 0|16@1+ (1,0) [0|0] ""  Vector__XXX

BO_ 2632932331 Mx_EF5B_P7_0xEB: 8 HAD
 SG_ CmdBytePGN61184_HAD M : 0|16@1+ (1,0) [0|0] ""  Vector__XXX

BO_ 2632968954 Mx_EFEA_P7_0xFA: 8 OBT_FA
 SG_ CmdBytePGN61184_OBT_FA M : 0|16@1+ (1,0) [0|0] ""  Vector__XXX

BO_ 2632969210 Mx_EFEB_P7_0xFA: 8 OBT_FA
 SG_ CmdBytePGN61184_OBT_FA M : 0|16@1+ (1,0) [0|0] ""  Vector__XXX

BO_ 2632932346 Mx_EF5B_P7_0xFA: 8 OBT_FA
 SG_ CmdBytePGN61184_OBT_FA M : 0|16@1+ (1,0) [0|0] ""  Vector__XXX

BO_ 2632968795 Mx_EFEA_P7_0x5B: 8 POD
 SG_ CmdBytePGN61184_POD M : 0|16@1+ (1,0) [0|0] ""  Vector__XXX

BO_ 2632969051 Mx_EFEB_P7_0x5B: 8 POD
 SG_ CmdBytePGN61184_POD M : 0|16@1+ (1,0) [0|0] ""  Vector__XXX

BO_ 2499803942 Mx_FFFB_P5_0x26: 8 VTV
 SG_ CmdBytePGN65531_VTV M : 0|16@1+ (1,0) [0|0] ""  FED,JDL
 SG_ HeadRaisLoweEngaContComm m1633 : 16|4@1+ (1,0) [0|15] ""  FED,JDL
 SG_ LadderAutomationState m11771 : 24|2@1+ (1,0) [0|3] ""  FED
 SG_ ActiEarSaveLeftActuPosiSetpReq m39168 : 16|8@1+ (1,0) [0|100] ""  Vector__XXX
 SG_ ActiEarSaveRighActuPosiSetpReq m39168 : 24|8@1+ (1,0) [0|100] ""  Vector__XXX
 SG_ ActiEarSaveLinkUnliToggReq m39168 : 32|2@1+ (1,0) [0|3] ""  Vector__XXX
 SG_ LeftActiEarSaveEnabFromDisp m39168 : 36|2@1+ (1,0) [0|3] ""  Vector__XXX
 SG_ RighActiEarSaveEnabFromDisp m39168 : 40|2@1+ (1,0) [0|3] ""  Vector__XXX
 SG_ MinimumDeckPlateSpacing m39168 : 48|8@1+ (1,0) [0|250] ""  Vector__XXX
 SG_ TerrFollAutoEnabStat m39424 : 16|2@1+ (1,0) [0|3] ""  Vector__XXX
 SG_ TerrFollAutoSens m39424 : 24|8@1+ (1,0) [0|250] ""  Vector__XXX
 SG_ OpCtrlPreset2 m39424 : 32|2@1+ (1,0) [0|3] ""  Vector__XXX
 SG_ OpCtrlPreset3 m39424 : 36|2@1+ (1,0) [0|3] ""  Vector__XXX
 SG_ FLPFrontAxleToGroundDistance m39424 : 40|16@1+ (1,-9999) [-9999|9999] ""  Vector__XXX
 SG_ CutterbarAutoLockConfigRequestBm m39680 : 16|8@1+ (1,0) [0|0] ""  Vector__XXX

BO_ 2649751345 Mx_EFFF_P7_0x31: 8 CAB
 SG_ CmdBytePGN126720_CAB M : 0|8@1+ (1,0) [0|0] ""  Vector__XXX

BO_ 2649751496 Mx_EFFF_P7_0xC8: 8 DC1
 SG_ CmdBytePGN126720_DC1 M : 0|8@1+ (1,0) [0|0] ""  Vector__XXX

BO_ 2649751530 Mx_EFFF_P7_0xEA: 8 FED
 SG_ CmdBytePGN126720_FED M : 0|8@1+ (1,0) [0|0] ""  Vector__XXX

BO_ 2649751531 Mx_EFFF_P7_0xEB: 8 HAD
 SG_ CmdBytePGN126720_HAD M : 0|8@1+ (1,0) [0|0] ""  Vector__XXX

BO_ 2649751387 Mx_EFFF_P7_0x5B: 8 POD
 SG_ CmdBytePGN126720_POD M : 0|8@1+ (1,0) [0|0] ""  Vector__XXX

BO_ 2649737265 DTC_Query_Response_TX_CAB_RX_DC1: 8 CAB
 SG_ CmdBytePGN126720_CAB M : 0|8@1+ (1,0) [0|0] ""  Vector__XXX

BO_ 2649745969 DTC_Query_Response_TX_CAB_RX_FED: 8 CAB
 SG_ CmdBytePGN126720_CAB M : 0|8@1+ (1,0) [0|0] ""  Vector__XXX

BO_ 2649746225 DTC_Query_Response_TX_CAB_RX_HAD: 8 CAB
 SG_ CmdBytePGN126720_CAB M : 0|8@1+ (1,0) [0|0] ""  Vector__XXX

BO_ 2649709361 DTC_Query_Response_TX_CAB_RX_POD: 8 CAB
 SG_ CmdBytePGN126720_CAB M : 0|8@1+ (1,0) [0|0] ""  Vector__XXX

BO_ 2649698760 DTC_Query_Response_TX_DC1_RX_CAB: 8 DC1
 SG_ CmdBytePGN126720_DC1 M : 0|8@1+ (1,0) [0|0] ""  Vector__XXX

BO_ 2649746120 DTC_Query_Response_TX_DC1_RX_FED: 8 DC1
 SG_ CmdBytePGN126720_DC1 M : 0|8@1+ (1,0) [0|0] ""  Vector__XXX

BO_ 2649746376 DTC_Query_Response_TX_DC1_RX_HAD: 8 DC1
 SG_ CmdBytePGN126720_DC1 M : 0|8@1+ (1,0) [0|0] ""  Vector__XXX

BO_ 2649709512 DTC_Query_Response_TX_DC1_RX_POD: 8 DC1
 SG_ CmdBytePGN126720_DC1 M : 0|8@1+ (1,0) [0|0] ""  Vector__XXX

BO_ 2649698794 DTC_Query_Response_TX_FED_RX_CAB: 8 FED
 SG_ CmdBytePGN126720_FED M : 0|8@1+ (1,0) [0|0] ""  Vector__XXX

BO_ 2649737450 DTC_Query_Response_TX_FED_RX_DC1: 8 FED
 SG_ CmdBytePGN126720_FED M : 0|8@1+ (1,0) [0|0] ""  Vector__XXX

BO_ 2649746410 DTC_Query_Response_TX_FED_RX_HAD: 8 FED
 SG_ CmdBytePGN126720_FED M : 0|8@1+ (1,0) [0|0] ""  Vector__XXX

BO_ 2649709546 DTC_Query_Response_TX_FED_RX_POD: 8 FED
 SG_ CmdBytePGN126720_FED M : 0|8@1+ (1,0) [0|0] ""  Vector__XXX

BO_ 2649698795 DTC_Query_Response_TX_HAD_RX_CAB: 8 HAD
 SG_ CmdBytePGN126720_HAD M : 0|8@1+ (1,0) [0|0] ""  Vector__XXX

BO_ 2649737451 DTC_Query_Response_TX_HAD_RX_DC1: 8 HAD
 SG_ CmdBytePGN126720_HAD M : 0|8@1+ (1,0) [0|0] ""  Vector__XXX

BO_ 2649746155 DTC_Query_Response_TX_HAD_RX_FED: 8 HAD
 SG_ CmdBytePGN126720_HAD M : 0|8@1+ (1,0) [0|0] ""  Vector__XXX

BO_ 2649709547 DTC_Query_Response_TX_HAD_RX_POD: 8 HAD
 SG_ CmdBytePGN126720_HAD M : 0|8@1+ (1,0) [0|0] ""  Vector__XXX

BO_ 2649698651 DTC_Query_Response_TX_POD_RX_CAB: 8 POD
 SG_ CmdBytePGN126720_POD M : 0|8@1+ (1,0) [0|0] ""  Vector__XXX

BO_ 2649737307 DTC_Query_Response_TX_POD_RX_DC1: 8 POD
 SG_ CmdBytePGN126720_POD M : 0|8@1+ (1,0) [0|0] ""  Vector__XXX

BO_ 2649746011 DTC_Query_Response_TX_POD_RX_FED: 8 POD
 SG_ CmdBytePGN126720_POD M : 0|8@1+ (1,0) [0|0] ""  Vector__XXX

BO_ 2649746267 DTC_Query_Response_TX_POD_RX_HAD: 8 POD
 SG_ CmdBytePGN126720_POD M : 0|8@1+ (1,0) [0|0] ""  Vector__XXX

BO_ 2298477310 EASEventDetectionInformation_Vector__XXX: 8 Vector__XXX
 SG_ CmdBytePGN65530_Vector_XXX M : 0|16@1+ (1,0) [0|0] ""  JDL
 SG_ EventDetectionStatus m22529 : 16|8@1+ (1,0) [0|255] ""  JDL

BO_ 2565865265 Mx_EFFF_P6_0x31: 8 CAB
 SG_ CmdBytePGN61184_CAB M : 0|16@1+ (1,0) [0|0] ""  HAD,POD,FED,VTV,DC1
 SG_ PGNRqstProp m219 : 16|24@1+ (1,0) [0|0] ""  FED,HAD,POD,DC1
 SG_ REQPGNCMDBYTE1 m219 : 40|8@1+ (1,0) [0|0] ""  FED,HAD,POD,DC1
 SG_ PGNRqstProp m241 : 16|24@1+ (1,0) [0|0] ""  FED,HAD,POD,DC1
 SG_ REQPGNCMDBYTE1 m241 : 40|8@1+ (1,0) [0|0] ""  FED,HAD,POD,DC1
 SG_ REQPGNCMDBYTE2 m241 : 48|8@1+ (1,0) [0|0] ""  FED,HAD,POD,DC1
 SG_ OpCtrlA1CmdByte3BitPair12 m752 : 16|2@1+ (1,0) [0|3] ""  FED,HAD
 SG_ OpCtrlA1CmdByte3BitPair56 m752 : 20|2@1+ (1,0) [0|3] ""  FED,HAD
 SG_ OpCtrlA1CmdByte4BitPair12 m752 : 24|2@1+ (1,0) [0|3] ""  FED,HAD,POD
 SG_ OpCtrlA1CmdByte4BitPair34 m752 : 26|2@1+ (1,0) [0|3] ""  FED,HAD,POD
 SG_ OpCtrlA1CmdByte4BitPair56 m752 : 28|2@1+ (1,0) [0|3] ""  FED,HAD,POD
 SG_ OpCtrlA1CmdByte4BitPair78 m752 : 30|2@1+ (1,0) [0|3] ""  FED,HAD,POD
 SG_ OpCtrlA1CmdByte5BitPair12 m752 : 32|2@1+ (1,0) [0|3] ""  FED,HAD,POD
 SG_ OpCtrlA1CmdByte5BitPair34 m752 : 34|2@1+ (1,0) [0|3] ""  FED,HAD,POD,VTV
 SG_ OpCtrlA1CmdByte5BitPair78 m752 : 38|2@1+ (1,0) [0|3] ""  FED,HAD,POD
 SG_ OpCtrlA1CmdByte6BitPair12 m752 : 40|2@1+ (1,0) [0|3] ""  FED,HAD,POD
 SG_ OpCtrlB2CmdByte3BitQuad14 m2288 : 16|4@1+ (1,0) [0|15] ""  HAD
 SG_ OpCtrlB2CmdByte4BitQuad14 m2288 : 24|4@1+ (1,0) [0|15] ""  FED,HAD,POD
 SG_ OpCtrlB2CmdByte4BitQuad58 m2288 : 28|4@1+ (1,0) [0|15] ""  FED,HAD,POD
 SG_ OpCtrlB2CmdByte5BitQuad14 m2288 : 32|4@1+ (1,0) [0|15] ""  HAD
 SG_ OpCtrlB2CmdByte5BitQuad58 m2288 : 36|4@1+ (1,0) [0|15] ""  HAD
 SG_ OpCtrlB2CmdByte8BitQuad14 m2288 : 56|4@1+ (1,0) [0|15] ""  HAD
 SG_ OpCtrlB2CmdByte8BitQuad58 m2288 : 60|4@1+ (1,0) [0|15] ""  FED
 SG_ OpCtrlB3CmdByte3BitQuad14 m3312 : 16|4@1+ (1,0) [0|15] ""  Vector__XXX
 SG_ OpCtrlB3CmdByte3BitQuad58 m3312 : 20|4@1+ (1,0) [0|15] ""  Vector__XXX
 SG_ OpCtrlB3CmdByte4BitQuad14 m3312 : 24|4@1+ (1,0) [0|15] ""  POD
 SG_ OpCtrlB3CmdByte4BitQuad58 m3312 : 28|4@1+ (1,0) [0|15] ""  POD
 SG_ OpCtrlB3CmdByte5BitQuad14 m3312 : 32|4@1+ (1,0) [0|15] ""  POD
 SG_ OpCtrlB3CmdByte6BitQuad14 m3312 : 40|4@1+ (1,0) [0|15] ""  Vector__XXX
 SG_ OpCtrlB3CmdByte6BitQuad58 m3312 : 44|4@1+ (1,0) [0|15] ""  HAD
 SG_ OpCtrlB3CmdByte7BitQuad14 m3312 : 48|4@1+ (1,0) [0|15] ""  Vector__XXX
 SG_ OpCtrlB3CmdByte7BitQuad58 m3312 : 52|4@1+ (1,0) [0|15] ""  Vector__XXX
 SG_ OpCtrlB3CmdByte8BitQuad14 m3312 : 56|4@1+ (1,0) [0|15] ""  Vector__XXX
 SG_ OpCtrlB3CmdByte8BitQuad58 m3312 : 60|4@1+ (1,0) [0|15] ""  POD
 SG_ EngineDesiredOperatingState m8440 : 16|4@1+ (1,0) [0|15] ""  POD
 SG_ EngStartCtrl m9458 : 16|2@1+ (1,0) [0|3] ""  POD
 SG_ EngStarterStatus m9458 : 20|4@1+ (1,0) [0|15] ""  Vector__XXX
 SG_ OpCtrlB5CmdByte4BitQuad58 m13300 : 28|4@1+ (1,0) [0|15] ""  FED
 SG_ OpCtrlB5CmdByte5BitQuad14 m13300 : 32|4@1+ (1,0) [0|15] ""  POD
 SG_ OpCtrlB5CmdByte5BitQuad58 m13300 : 36|4@1+ (1,0) [0|15] ""  FED
 SG_ OpCtrlB5CmdByte6BitQuad14 m13300 : 40|4@1+ (1,0) [0|15] ""  HAD,POD
 SG_ OpCtrlB5CmdByte6BitQuad58 m13300 : 44|4@1+ (1,0) [0|15] ""  FED,HAD,POD
 SG_ OpCtrlB5CmdByte7BitQuad14 m13300 : 48|4@1+ (1,0) [0|15] ""  FED,HAD,POD
 SG_ OpCtrlB5CmdByte7BitQuad58 m13300 : 52|4@1+ (1,0) [0|15] ""  FED,HAD,POD
 SG_ OpCtrlB5CmdByte8BitQuad14 m13300 : 56|4@1+ (1,0) [0|15] ""  FED,HAD,POD
 SG_ OpCtrlB5CmdByte8BitQuad58 m13300 : 60|4@1+ (1,0) [0|15] ""  FED,HAD,POD
 SG_ OpCtrlB6CmdByte3BitQuad14 m14324 : 16|4@1+ (1,0) [0|15] ""  FED,HAD,POD
 SG_ BrakeLightsCommand m25956 : 16|4@1+ (1,0) [0|15] ""  POD
 SG_ BeaconLightsCommand m25956 : 20|4@1+ (1,0) [0|15] ""  POD
 SG_ LeftMarkerLightsCommand m25956 : 24|4@1+ (1,0) [0|15] ""  POD
 SG_ LeftFlasherLightsCommand m25956 : 32|4@1+ (1,0) [0|15] ""  FED,POD
 SG_ RightFlasherLightsCommand m25956 : 36|4@1+ (1,0) [0|15] ""  FED,POD
 SG_ FlasherLightsFlashRate m26212 : 40|8@1+ (1,0) [0|250] ""  FED,POD
 SG_ FlasherLightsPriority m26468 : 40|8@1+ (1,0) [0|255] ""  FED
 SG_ SyncSignal1 m27236 : 16|2@1+ (1,0) [0|3] ""  HAD,POD
 SG_ GlobalTimer m27236 : 56|8@1+ (1,0) [0|250] ""  HAD,POD
 SG_ CANField1VehSpcFrontLight1 m41060 : 16|4@1+ (1,0) [0|15] ""  HAD
 SG_ CANField1VehSpcSideLight1 m41060 : 28|4@1+ (1,0) [0|15] ""  HAD
 SG_ CANField1VehSpcRearLight1 m41060 : 40|4@1+ (1,0) [0|15] ""  POD
 SG_ CANField2VehSpcFrontLight1 m41316 : 16|4@1+ (1,0) [0|15] ""  HAD
 SG_ CANField2VehSpcSideLight1 m41316 : 28|4@1+ (1,0) [0|15] ""  HAD
 SG_ CANField2VehSpcRearLight1 m41316 : 40|4@1+ (1,0) [0|15] ""  POD
 SG_ CANEgressVehSpcFrontLight1 m41572 : 16|4@1+ (1,0) [0|15] ""  HAD
 SG_ CANEgressVehSpcSideLight1 m41572 : 28|4@1+ (1,0) [0|15] ""  HAD
 SG_ CANEgressVehSpcRearLight1 m41572 : 40|4@1+ (1,0) [0|15] ""  POD

CM_ BO_ 2566912550 "AutoDeckPlateParameters2; AutoUnloadOutputsToVehicle; GrainAreaLoss; GrainPercentLoss; HarvestSmartMessage2; HarvestSmartMessage3; HarvestSmartMessage4; HarvestSmartMessage5; HarvestSmartMessage6; SetpointInfoAckResonseHarvesterSetpointAdjust";
CM_ BO_ 2499803686 "AutoDeckPlateSensorAndDisplayCommand; FlexWingFloatSystemDisplayInteractions; GrainQualityAndLossFiltered; GrainQualityAndLossOptions; GrainQualityAndLossUserDefined; GSAPredictionSourceRMSEvalues1; GSAPredictionSourceRMSEvalues2; GSASettingsAndStatus; MapBasedFarmingStatus; MassFlowFiltered";
CM_ BO_ 2365585958 "AutomationLimitingFactors; Vehicle_Leveling_Roll";
CM_ BO_ 2499804158 "AutomationUtilization; CropProcessingPowerCommands; CropProcessingPowerStatus; CropProcessingPowerTargets; GSAData; HeaderToDisplay_1; HeaderToDisplay_2; HeaderToDisplay_3; ReelAutomationStatus";
CM_ BO_ 2566913574 "AutoQuadStatusAndSettings; CropInformation; HarvesterSmartFeedrateSetting2; RotorDrivePressure";
CM_ BO_ 2566911230 "AutoTrac_State_for_Vehicle; Guidance_Machine_Status_J_D_Extended; Local_Error_Sensor_Status; VehicleStateforRowSense";
CM_ BO_ 2566912603 "BoostPowerMeterThresholds; EnginePowerParameters; JD_Configurable_Lighting_Status_Left_Hand_Work_Lights; JD_Configurable_Lighting_Status_Right_Hand_Work_Lights";
CM_ BO_ 2566913585 "CabClimate1";
CM_ BO_ 2565864446 "Camera_Connection_Quality_1; Camera_Connection_Quality_3; ImageControllerStatus";
CM_ BO_ 2565865470 "Camera_Connection_Quality_1; Camera_Connection_Quality_3; EngineDPFRegenerationStatistics; Engine_Derate_Status; EngineSCRCleaningStatistics; Engine_Starting_Shutdown_Status; HeaderAuxiliaryFunctionstoFrontEndDomain; HeaderLowPriorityStatus; ImageControllerStatus; IO_Expander_Input_Pin_Measurement_Message_1; IO_Expander_Output_Pin_Control_Request_Message_1; IO_Expander_Output_Pin_State_Message_1; JDEngineControlMessage16; JDEngineFunctionalTest; ScheduledPowerReduction";
CM_ BO_ 2365584177 "ClosedSystemPgnA18JDHWAutoShiftParameters";
CM_ BO_ 2566913770 "Combine_Network_Health_Data; Combine_Network_Health_Data_2";
CM_ BO_ 2566913771 "Combine_Network_Health_Data; Combine_Network_Health_Data_2";
CM_ BO_ 2566913627 "Combine_Network_Health_Data; Combine_Network_Health_Data_2; MachineSetup";
CM_ BO_ 2566912200 "ControllerDisplay_Power_Management_3";
CM_ BO_ 2566912234 "ControllerDisplay_Power_Management_3; HeaderHeightDisplayData3";
CM_ BO_ 2566912235 "ControllerDisplay_Power_Management_3; VideoCameraDisplay";
CM_ BO_ 2566912091 "ControllerDisplay_Power_Management_3";
CM_ BO_ 2498756586 "ControllerDisplayPowerManagementCommands2; FrontEndDomainMiscellaneousStatus";
CM_ BO_ 2498756587 "ControllerDisplayPowerManagementCommands2; HarvestingDomainGrainTankStatus; HarvestingDomainThreshingStatus2; HarvestingDomainCommand1; HarvestingDomainHours1; HarvestingDomainShaftSpeed1; HarvestingDomainShaftSpeed2; HarvestingDomainShaftSpeed3; HarvestingDomainShaftSpeed4; HarvestingDomainShoeStatus";
CM_ BO_ 2498756443 "ControllerDisplayPowerManagementCommands2; PowertrainDomainMiscellaneousHighPriority";
CM_ BO_ 2632974171 "Controller_Data_Message; Controller_Data_Message_0xAD01; Controller_Data_Message_0xAD02; Controller_Data_Message_0xAD03; Controller_Data_Message_0xAD04; Controller_Data_Message_0xAD05; Controller_Data_Message_0xAD06; Controller_Data_Message_0xAD07; Controller_Data_Message_0xAD08; Controller_Data_Message_0xAD09; Controller_Data_Message_0xAD0A; Controller_Data_Message_0xAD0B; Controller_Data_Message_0xAD0C; Controller_Data_Message_0xAD0D; Controller_Data_Message_0xAD0E; Controller_Data_Message_0xAD0F; Controller_Data_Message_0xAD10; Controller_Data_Message_0xAD11; Controller_Data_Message_0xAD12; Controller_Data_Message_0xAD13; Controller_Data_Message_0xAD14; Controller_Data_Message_0xAD15; Controller_Data_Message_0xAD16; Controller_Data_Message_0xAD17; Controller_Data_Message_0xAD18; Controller_Data_Message_0xAD19; Controller_Data_Message_0xAD1A; Controller_Data_Message_0xAD1B; Controller_Data_Message_0xAD1C; Controller_Data_Message_0xAD1D; Controller_Data_Message_0xAD1E; Controller_Data_Message_0xAD1F; Controller_Data_Message_0xAD20; Controller_Data_Message_0xAD21; Controller_Data_Message_0xAD22; Controller_Data_Message_0xAD23; Controller_Data_Message_0xAD24; Controller_Data_Message_0xAD25; Controller_Data_Message_0xAD26; Controller_Data_Message_0xAD27; Controller_Data_Message_0xAD28; Controller_Data_Message_0xAD29; Controller_Data_Message_0xAD2A; Controller_Data_Message_0xAD2B; Controller_Data_Message_0xAD2C; Controller_Data_Message_0xAD2D; Controller_Data_Message_0xAD2E; Data_Request_Message_0xAC01; Data_Request_Message_0xAC02; Data_Request_Message_0xAC03; Data_Request_Message_0xAC04; Data_Request_Message_0xAC05; Data_Request_Message_0xAC06; Data_Request_Message_0xAC07; Data_Request_Message_0xAC08; Data_Request_Message_0xAC09; Data_Request_Message_0xAC0A; Data_Request_Message_0xAC0B; Data_Request_Message_0xAC0C; Data_Request_Message_0xAC0D; Data_Request_Message_0xAC0E; Data_Request_Message_0xAC0F; Data_Request_Message_0xAC10; Data_Request_Message_0xAC11; Data_Request_Message_0xAC12; Data_Request_Message_0xAC13; Data_Request_Message_0xAC14; Data_Request_Message_0xAC15; Data_Request_Message_0xAC16; Data_Request_Message_0xAC17; Data_Request_Message_0xAC18; Data_Request_Message_0xAC19; Data_Request_Message_0xAC1A; Data_Request_Message_0xAC1B; Data_Request_Message_0xAC1C; Data_Request_Message_0xAC1D; Data_Request_Message_0xAC1E; Data_Request_Message_0xAC1F; Data_Request_Message_0xAC20; Data_Request_Message_0xAC21; Data_Request_Message_0xAC22; Data_Request_Message_0xAC23; Data_Request_Message_0xAC24; Data_Request_Message_0xAC25; Data_Request_Message_0xAC26; Data_Request_Message_0xAC27; Data_Request_Message_0xAC28; Data_Request_Message_0xAC29; Data_Request_Message_0xAC2A; Data_Request_Message; PowertrainDomaintoDriveTrainOptions";
CM_ BO_ 2634021610 "ControllerHealthInfo";
CM_ BO_ 2634021611 "ControllerHealthInfo";
CM_ BO_ 2634021416 "ControllerHealthInfo";
CM_ BO_ 2634021467 "ControllerHealthInfo; GroundSpeedAutomationCommand2";
CM_ BO_ 2632974314 "Data_Request_Message_0xAC01; Data_Request_Message_0xAC02; Data_Request_Message_0xAC03; Data_Request_Message_0xAC04; Data_Request_Message_0xAC05; Data_Request_Message_0xAC06; Data_Request_Message_0xAC07; Data_Request_Message_0xAC08; Data_Request_Message_0xAC09; Data_Request_Message_0xAC0A; Data_Request_Message_0xAC0B; Data_Request_Message_0xAC0C; Data_Request_Message_0xAC0D; Data_Request_Message_0xAC0E; Data_Request_Message_0xAC0F; Data_Request_Message_0xAC10; Data_Request_Message_0xAC11; Data_Request_Message_0xAC12; Data_Request_Message_0xAC13; Data_Request_Message_0xAC14; Data_Request_Message_0xAC15; Data_Request_Message_0xAC16; Data_Request_Message_0xAC17; Data_Request_Message_0xAC18; Data_Request_Message_0xAC19; Data_Request_Message_0xAC1A; Data_Request_Message_0xAC1B; Data_Request_Message_0xAC1C; Data_Request_Message_0xAC1D; Data_Request_Message_0xAC1E; Data_Request_Message_0xAC1F; Data_Request_Message_0xAC20; Data_Request_Message_0xAC21; Data_Request_Message_0xAC22; Data_Request_Message_0xAC23; Data_Request_Message_0xAC24; Data_Request_Message_0xAC25; Data_Request_Message_0xAC26; Data_Request_Message_0xAC27; Data_Request_Message_0xAC28; Data_Request_Message_0xAC29; Data_Request_Message_0xAC2A; Data_Request_Message";
CM_ BO_ 2632974315 "Data_Request_Message_0xAC01; Data_Request_Message_0xAC02; Data_Request_Message_0xAC03; Data_Request_Message_0xAC04; Data_Request_Message_0xAC05; Data_Request_Message_0xAC06; Data_Request_Message_0xAC07; Data_Request_Message_0xAC08; Data_Request_Message_0xAC09; Data_Request_Message_0xAC0A; Data_Request_Message_0xAC0B; Data_Request_Message_0xAC0C; Data_Request_Message_0xAC0D; Data_Request_Message_0xAC0E; Data_Request_Message_0xAC0F; Data_Request_Message_0xAC10; Data_Request_Message_0xAC11; Data_Request_Message_0xAC12; Data_Request_Message_0xAC13; Data_Request_Message_0xAC14; Data_Request_Message_0xAC15; Data_Request_Message_0xAC16; Data_Request_Message_0xAC17; Data_Request_Message_0xAC18; Data_Request_Message_0xAC19; Data_Request_Message_0xAC1A; Data_Request_Message_0xAC1B; Data_Request_Message_0xAC1C; Data_Request_Message_0xAC1D; Data_Request_Message_0xAC1E; Data_Request_Message_0xAC1F; Data_Request_Message_0xAC20; Data_Request_Message_0xAC21; Data_Request_Message_0xAC22; Data_Request_Message_0xAC23; Data_Request_Message_0xAC24; Data_Request_Message_0xAC25; Data_Request_Message_0xAC26; Data_Request_Message_0xAC27; Data_Request_Message_0xAC28; Data_Request_Message_0xAC29; Data_Request_Message_0xAC2A; Data_Request_Message";
CM_ BO_ 2632974330 "Data_Request_Message_0xAC01; Data_Request_Message_0xAC02; Data_Request_Message_0xAC03; Data_Request_Message_0xAC04; Data_Request_Message_0xAC05; Data_Request_Message_0xAC06; Data_Request_Message_0xAC07; Data_Request_Message_0xAC08; Data_Request_Message_0xAC09; Data_Request_Message_0xAC0A; Data_Request_Message_0xAC0B; Data_Request_Message_0xAC0C; Data_Request_Message_0xAC0D; Data_Request_Message_0xAC0E; Data_Request_Message_0xAC0F; Data_Request_Message_0xAC10; Data_Request_Message_0xAC11; Data_Request_Message_0xAC12; Data_Request_Message_0xAC13; Data_Request_Message_0xAC14; Data_Request_Message_0xAC15; Data_Request_Message_0xAC16; Data_Request_Message_0xAC17; Data_Request_Message_0xAC18; Data_Request_Message_0xAC19; Data_Request_Message_0xAC1A; Data_Request_Message_0xAC1B; Data_Request_Message_0xAC1C; Data_Request_Message_0xAC1D; Data_Request_Message_0xAC1E; Data_Request_Message_0xAC1F; Data_Request_Message_0xAC20; Data_Request_Message_0xAC21; Data_Request_Message_0xAC22; Data_Request_Message_0xAC23; Data_Request_Message_0xAC24; Data_Request_Message_0xAC25; Data_Request_Message_0xAC26; Data_Request_Message_0xAC27; Data_Request_Message_0xAC28; Data_Request_Message_0xAC29; Data_Request_Message_0xAC2A; Data_Request_Message";
CM_ BO_ 2632969194 "Data_Request_Message; Data_Request_Message_0xAC01; Data_Request_Message_0xAC02; Data_Request_Message_0xAC03; Data_Request_Message_0xAC04; Data_Request_Message_0xAC05; Data_Request_Message_0xAC06; Data_Request_Message_0xAC07; Data_Request_Message_0xAC08; Data_Request_Message_0xAC09; Data_Request_Message_0xAC0A; Data_Request_Message_0xAC0B; Data_Request_Message_0xAC0C; Data_Request_Message_0xAC0D; Data_Request_Message_0xAC0E; Data_Request_Message_0xAC0F; Data_Request_Message_0xAC10; Data_Request_Message_0xAC11; Data_Request_Message_0xAC12; Data_Request_Message_0xAC13; Data_Request_Message_0xAC14; Data_Request_Message_0xAC15; Data_Request_Message_0xAC16; Data_Request_Message_0xAC17; Data_Request_Message_0xAC18; Data_Request_Message_0xAC19; Data_Request_Message_0xAC1A; Data_Request_Message_0xAC1B; Data_Request_Message_0xAC1C; Data_Request_Message_0xAC1D; Data_Request_Message_0xAC1E; Data_Request_Message_0xAC1F; Data_Request_Message_0xAC20; Data_Request_Message_0xAC21; Data_Request_Message_0xAC22; Data_Request_Message_0xAC23; Data_Request_Message_0xAC24; Data_Request_Message_0xAC25; Data_Request_Message_0xAC26; Data_Request_Message_0xAC27; Data_Request_Message_0xAC28; Data_Request_Message_0xAC29; Data_Request_Message_0xAC2A";
CM_ BO_ 2632932330 "Data_Request_Message; Data_Request_Message_0xAC01; Data_Request_Message_0xAC02; Data_Request_Message_0xAC03; Data_Request_Message_0xAC04; Data_Request_Message_0xAC05; Data_Request_Message_0xAC06; Data_Request_Message_0xAC07; Data_Request_Message_0xAC08; Data_Request_Message_0xAC09; Data_Request_Message_0xAC0A; Data_Request_Message_0xAC0B; Data_Request_Message_0xAC0C; Data_Request_Message_0xAC0D; Data_Request_Message_0xAC0E; Data_Request_Message_0xAC0F; Data_Request_Message_0xAC10; Data_Request_Message_0xAC11; Data_Request_Message_0xAC12; Data_Request_Message_0xAC13; Data_Request_Message_0xAC14; Data_Request_Message_0xAC15; Data_Request_Message_0xAC16; Data_Request_Message_0xAC17; Data_Request_Message_0xAC18; Data_Request_Message_0xAC19; Data_Request_Message_0xAC1A; Data_Request_Message_0xAC1B; Data_Request_Message_0xAC1C; Data_Request_Message_0xAC1D; Data_Request_Message_0xAC1E; Data_Request_Message_0xAC1F; Data_Request_Message_0xAC20; Data_Request_Message_0xAC21; Data_Request_Message_0xAC22; Data_Request_Message_0xAC23; Data_Request_Message_0xAC24; Data_Request_Message_0xAC25; Data_Request_Message_0xAC26; Data_Request_Message_0xAC27; Data_Request_Message_0xAC28; Data_Request_Message_0xAC29; Data_Request_Message_0xAC2A";
CM_ BO_ 2632968939 "Data_Request_Message; Data_Request_Message_0xAC01; Data_Request_Message_0xAC02; Data_Request_Message_0xAC03; Data_Request_Message_0xAC04; Data_Request_Message_0xAC05; Data_Request_Message_0xAC06; Data_Request_Message_0xAC07; Data_Request_Message_0xAC08; Data_Request_Message_0xAC09; Data_Request_Message_0xAC0A; Data_Request_Message_0xAC0B; Data_Request_Message_0xAC0C; Data_Request_Message_0xAC0D; Data_Request_Message_0xAC0E; Data_Request_Message_0xAC0F; Data_Request_Message_0xAC10; Data_Request_Message_0xAC11; Data_Request_Message_0xAC12; Data_Request_Message_0xAC13; Data_Request_Message_0xAC14; Data_Request_Message_0xAC15; Data_Request_Message_0xAC16; Data_Request_Message_0xAC17; Data_Request_Message_0xAC18; Data_Request_Message_0xAC19; Data_Request_Message_0xAC1A; Data_Request_Message_0xAC1B; Data_Request_Message_0xAC1C; Data_Request_Message_0xAC1D; Data_Request_Message_0xAC1E; Data_Request_Message_0xAC1F; Data_Request_Message_0xAC20; Data_Request_Message_0xAC21; Data_Request_Message_0xAC22; Data_Request_Message_0xAC23; Data_Request_Message_0xAC24; Data_Request_Message_0xAC25; Data_Request_Message_0xAC26; Data_Request_Message_0xAC27; Data_Request_Message_0xAC28; Data_Request_Message_0xAC29; Data_Request_Message_0xAC2A";
CM_ BO_ 2632932331 "Data_Request_Message; Data_Request_Message_0xAC01; Data_Request_Message_0xAC02; Data_Request_Message_0xAC03; Data_Request_Message_0xAC04; Data_Request_Message_0xAC05; Data_Request_Message_0xAC06; Data_Request_Message_0xAC07; Data_Request_Message_0xAC08; Data_Request_Message_0xAC09; Data_Request_Message_0xAC0A; Data_Request_Message_0xAC0B; Data_Request_Message_0xAC0C; Data_Request_Message_0xAC0D; Data_Request_Message_0xAC0E; Data_Request_Message_0xAC0F; Data_Request_Message_0xAC10; Data_Request_Message_0xAC11; Data_Request_Message_0xAC12; Data_Request_Message_0xAC13; Data_Request_Message_0xAC14; Data_Request_Message_0xAC15; Data_Request_Message_0xAC16; Data_Request_Message_0xAC17; Data_Request_Message_0xAC18; Data_Request_Message_0xAC19; Data_Request_Message_0xAC1A; Data_Request_Message_0xAC1B; Data_Request_Message_0xAC1C; Data_Request_Message_0xAC1D; Data_Request_Message_0xAC1E; Data_Request_Message_0xAC1F; Data_Request_Message_0xAC20; Data_Request_Message_0xAC21; Data_Request_Message_0xAC22; Data_Request_Message_0xAC23; Data_Request_Message_0xAC24; Data_Request_Message_0xAC25; Data_Request_Message_0xAC26; Data_Request_Message_0xAC27; Data_Request_Message_0xAC28; Data_Request_Message_0xAC29; Data_Request_Message_0xAC2A";
CM_ BO_ 2632968954 "Data_Request_Message; Data_Request_Message_0xAC01; Data_Request_Message_0xAC02; Data_Request_Message_0xAC03; Data_Request_Message_0xAC04; Data_Request_Message_0xAC05; Data_Request_Message_0xAC06; Data_Request_Message_0xAC07; Data_Request_Message_0xAC08; Data_Request_Message_0xAC09; Data_Request_Message_0xAC0A; Data_Request_Message_0xAC0B; Data_Request_Message_0xAC0C; Data_Request_Message_0xAC0D; Data_Request_Message_0xAC0E; Data_Request_Message_0xAC0F; Data_Request_Message_0xAC10; Data_Request_Message_0xAC11; Data_Request_Message_0xAC12; Data_Request_Message_0xAC13; Data_Request_Message_0xAC14; Data_Request_Message_0xAC15; Data_Request_Message_0xAC16; Data_Request_Message_0xAC17; Data_Request_Message_0xAC18; Data_Request_Message_0xAC19; Data_Request_Message_0xAC1A; Data_Request_Message_0xAC1B; Data_Request_Message_0xAC1C; Data_Request_Message_0xAC1D; Data_Request_Message_0xAC1E; Data_Request_Message_0xAC1F; Data_Request_Message_0xAC20; Data_Request_Message_0xAC21; Data_Request_Message_0xAC22; Data_Request_Message_0xAC23; Data_Request_Message_0xAC24; Data_Request_Message_0xAC25; Data_Request_Message_0xAC26; Data_Request_Message_0xAC27; Data_Request_Message_0xAC28; Data_Request_Message_0xAC29; Data_Request_Message_0xAC2A";
CM_ BO_ 2632969210 "Data_Request_Message; Data_Request_Message_0xAC01; Data_Request_Message_0xAC02; Data_Request_Message_0xAC03; Data_Request_Message_0xAC04; Data_Request_Message_0xAC05; Data_Request_Message_0xAC06; Data_Request_Message_0xAC07; Data_Request_Message_0xAC08; Data_Request_Message_0xAC09; Data_Request_Message_0xAC0A; Data_Request_Message_0xAC0B; Data_Request_Message_0xAC0C; Data_Request_Message_0xAC0D; Data_Request_Message_0xAC0E; Data_Request_Message_0xAC0F; Data_Request_Message_0xAC10; Data_Request_Message_0xAC11; Data_Request_Message_0xAC12; Data_Request_Message_0xAC13; Data_Request_Message_0xAC14; Data_Request_Message_0xAC15; Data_Request_Message_0xAC16; Data_Request_Message_0xAC17; Data_Request_Message_0xAC18; Data_Request_Message_0xAC19; Data_Request_Message_0xAC1A; Data_Request_Message_0xAC1B; Data_Request_Message_0xAC1C; Data_Request_Message_0xAC1D; Data_Request_Message_0xAC1E; Data_Request_Message_0xAC1F; Data_Request_Message_0xAC20; Data_Request_Message_0xAC21; Data_Request_Message_0xAC22; Data_Request_Message_0xAC23; Data_Request_Message_0xAC24; Data_Request_Message_0xAC25; Data_Request_Message_0xAC26; Data_Request_Message_0xAC27; Data_Request_Message_0xAC28; Data_Request_Message_0xAC29; Data_Request_Message_0xAC2A";
CM_ BO_ 2632932346 "Data_Request_Message; Data_Request_Message_0xAC01; Data_Request_Message_0xAC02; Data_Request_Message_0xAC03; Data_Request_Message_0xAC04; Data_Request_Message_0xAC05; Data_Request_Message_0xAC06; Data_Request_Message_0xAC07; Data_Request_Message_0xAC08; Data_Request_Message_0xAC09; Data_Request_Message_0xAC0A; Data_Request_Message_0xAC0B; Data_Request_Message_0xAC0C; Data_Request_Message_0xAC0D; Data_Request_Message_0xAC0E; Data_Request_Message_0xAC0F; Data_Request_Message_0xAC10; Data_Request_Message_0xAC11; Data_Request_Message_0xAC12; Data_Request_Message_0xAC13; Data_Request_Message_0xAC14; Data_Request_Message_0xAC15; Data_Request_Message_0xAC16; Data_Request_Message_0xAC17; Data_Request_Message_0xAC18; Data_Request_Message_0xAC19; Data_Request_Message_0xAC1A; Data_Request_Message_0xAC1B; Data_Request_Message_0xAC1C; Data_Request_Message_0xAC1D; Data_Request_Message_0xAC1E; Data_Request_Message_0xAC1F; Data_Request_Message_0xAC20; Data_Request_Message_0xAC21; Data_Request_Message_0xAC22; Data_Request_Message_0xAC23; Data_Request_Message_0xAC24; Data_Request_Message_0xAC25; Data_Request_Message_0xAC26; Data_Request_Message_0xAC27; Data_Request_Message_0xAC28; Data_Request_Message_0xAC29; Data_Request_Message_0xAC2A";
CM_ BO_ 2632968795 "Data_Request_Message; Data_Request_Message_0xAC01; Data_Request_Message_0xAC02; Data_Request_Message_0xAC03; Data_Request_Message_0xAC04; Data_Request_Message_0xAC05; Data_Request_Message_0xAC06; Data_Request_Message_0xAC07; Data_Request_Message_0xAC08; Data_Request_Message_0xAC09; Data_Request_Message_0xAC0A; Data_Request_Message_0xAC0B; Data_Request_Message_0xAC0C; Data_Request_Message_0xAC0D; Data_Request_Message_0xAC0E; Data_Request_Message_0xAC0F; Data_Request_Message_0xAC10; Data_Request_Message_0xAC11; Data_Request_Message_0xAC12; Data_Request_Message_0xAC13; Data_Request_Message_0xAC14; Data_Request_Message_0xAC15; Data_Request_Message_0xAC16; Data_Request_Message_0xAC17; Data_Request_Message_0xAC18; Data_Request_Message_0xAC19; Data_Request_Message_0xAC1A; Data_Request_Message_0xAC1B; Data_Request_Message_0xAC1C; Data_Request_Message_0xAC1D; Data_Request_Message_0xAC1E; Data_Request_Message_0xAC1F; Data_Request_Message_0xAC20; Data_Request_Message_0xAC21; Data_Request_Message_0xAC22; Data_Request_Message_0xAC23; Data_Request_Message_0xAC24; Data_Request_Message_0xAC25; Data_Request_Message_0xAC26; Data_Request_Message_0xAC27; Data_Request_Message_0xAC28; Data_Request_Message_0xAC29; Data_Request_Message_0xAC2A";
CM_ BO_ 2632969051 "Data_Request_Message; Data_Request_Message_0xAC01; Data_Request_Message_0xAC02; Data_Request_Message_0xAC03; Data_Request_Message_0xAC04; Data_Request_Message_0xAC05; Data_Request_Message_0xAC06; Data_Request_Message_0xAC07; Data_Request_Message_0xAC08; Data_Request_Message_0xAC09; Data_Request_Message_0xAC0A; Data_Request_Message_0xAC0B; Data_Request_Message_0xAC0C; Data_Request_Message_0xAC0D; Data_Request_Message_0xAC0E; Data_Request_Message_0xAC0F; Data_Request_Message_0xAC10; Data_Request_Message_0xAC11; Data_Request_Message_0xAC12; Data_Request_Message_0xAC13; Data_Request_Message_0xAC14; Data_Request_Message_0xAC15; Data_Request_Message_0xAC16; Data_Request_Message_0xAC17; Data_Request_Message_0xAC18; Data_Request_Message_0xAC19; Data_Request_Message_0xAC1A; Data_Request_Message_0xAC1B; Data_Request_Message_0xAC1C; Data_Request_Message_0xAC1D; Data_Request_Message_0xAC1E; Data_Request_Message_0xAC1F; Data_Request_Message_0xAC20; Data_Request_Message_0xAC21; Data_Request_Message_0xAC22; Data_Request_Message_0xAC23; Data_Request_Message_0xAC24; Data_Request_Message_0xAC25; Data_Request_Message_0xAC26; Data_Request_Message_0xAC27; Data_Request_Message_0xAC28; Data_Request_Message_0xAC29; Data_Request_Message_0xAC2A";
CM_ BO_ 2499803942 "DisplayToHeader_1; DisplayToHeader_2; DisplayToHeader_3; HeaderHeightControlAutomationCommands; Operator_System_Enable_States";
CM_ BO_ 2649751345 "DTC_Query_Request; DTC_Query_Response";
CM_ BO_ 2649751496 "DTC_Query_Request; DTC_Query_Response";
CM_ BO_ 2649751530 "DTC_Query_Request; DTC_Query_Response";
CM_ BO_ 2649751531 "DTC_Query_Request; DTC_Query_Response";
CM_ BO_ 2649751387 "DTC_Query_Request; DTC_Query_Response";
CM_ BO_ 2649737265 "DTC_Query_Response";
CM_ BO_ 2649745969 "DTC_Query_Response";
CM_ BO_ 2649746225 "DTC_Query_Response";
CM_ BO_ 2649709361 "DTC_Query_Response";
CM_ BO_ 2649698760 "DTC_Query_Response";
CM_ BO_ 2649746120 "DTC_Query_Response";
CM_ BO_ 2649746376 "DTC_Query_Response";
CM_ BO_ 2649709512 "DTC_Query_Response";
CM_ BO_ 2649698794 "DTC_Query_Response";
CM_ BO_ 2649737450 "DTC_Query_Response";
CM_ BO_ 2649746410 "DTC_Query_Response";
CM_ BO_ 2649709546 "DTC_Query_Response";
CM_ BO_ 2649698795 "DTC_Query_Response";
CM_ BO_ 2649737451 "DTC_Query_Response";
CM_ BO_ 2649746155 "DTC_Query_Response";
CM_ BO_ 2649709547 "DTC_Query_Response";
CM_ BO_ 2649698651 "DTC_Query_Response";
CM_ BO_ 2649737307 "DTC_Query_Response";
CM_ BO_ 2649746011 "DTC_Query_Response";
CM_ BO_ 2649746267 "DTC_Query_Response";
CM_ BO_ 2298477310 "EASEventDetectionInformation";
CM_ BO_ 2565865265 "EgressConfigurableLightingCommand; EngineStartControl; EngineStartingShutdownRequest; Field1ConfigurableLightingCommand; Field2ConfigurableLightingCommand; JD_ACKnowledgement; LightingSupervisorCommandMessage1; LightingSupervisorFlashRateMessage1; LightingSupervisorPriorityMessage1; OperatorControlsA1Command; OperatorControlsB2Command; OperatorControlsB3Command; OperatorControlsB5Command; OperatorControlsB6Command; Prop_Request_PGN_Dual_Cmd_Byte; Prop_Request_PGN_Single_Cmd_Byte; SyncSignalsMessage";
BA_DEF_ SG_ "SigType" ENUM "Default", "Range", "RangeSigned", "ASCII", "Discrete", "Control", "ReferencePGN", "DTC", "StringDelimiter", "StringLength", "StringLengthControl", "MessageCounter", "MessageChecksum";
BA_DEF_ SG_ "GenSigSendType" ENUM "Cyclic", "OnWrite", "OnWriteWithRepetition", "OnChange", "OnChangeWithRepetition", "IfActive", "IfActiveWithRepetition", "NoSigSendType";
BA_DEF_ SG_ "GenSigTimeoutTime_ECU" INT 0 3600000;
BA_DEF_ SG_ "GenSigILSupport" ENUM "Yes", "No";
BA_DEF_ SG_ "GenSigEVName" STRING ;
BA_DEF_ BO_ "GenMsgILSupport" ENUM "Yes", "No";
BA_DEF_ BO_ "GenMsgSendType" ENUM "cyclic", "reserved", "cyclicIfActive", "reserved", "reserved", "reserved", "reserved", "reserved", "NoMsgSendType";
BA_DEF_ BO_ "VFrameFormat" ENUM "StandardCAN", "ExtendedCAN", "reserved", "J1939PG";
BA_DEF_ BO_ "SingleFrame" INT 0 1;
BA_DEF_ BO_ "GenMsgCycleTime" INT 0 3600000;
BA_DEF_ BO_ "GenMsgCycleTimeFast" INT 0 3600000;
BA_DEF_DEF_ "SigType" "Default";
BA_DEF_DEF_ "GenSigSendType" "NoSigSendType";
BA_DEF_DEF_ "GenSigTimeoutTime_ECU" 0;
BA_DEF_DEF_ "GenSigILSupport" "Yes";
BA_DEF_DEF_ "GenSigEVName" "Env@Nodename_@Signame";
BA_DEF_DEF_ "GenMsgILSupport" "Yes";
BA_DEF_DEF_ "GenMsgSendType" "NoMsgSendType";
BA_DEF_DEF_ "VFrameFormat" "J1939PG";
BA_DEF_DEF_ "SingleFrame" 0;
BA_DEF_DEF_ "GenMsgCycleTime" 0;
BA_DEF_DEF_ "GenMsgCycleTimeFast" 0;
BA_ "GenSigTimeoutTime_ECU" SG_ 2566912550 CmdBytePGN65530_VTV 25000;
BA_ "GenSigTimeoutTime_ECU" SG_ 2566912550 GSAEngineSpeedDelta 25000;
BA_ "GenSigSendType" SG_ 2566912550 GSAEngineSpeedDelta 0;
BA_ "GenSigTimeoutTime_ECU" SG_ 2566912550 GSADeltaValue 25000;
BA_ "GenSigSendType" SG_ 2566912550 GSADeltaValue 0;
BA_ "GenSigTimeoutTime_ECU" SG_ 2566912550 GSAEffectiveTargetEnginePower 25000;
BA_ "GenSigSendType" SG_ 2566912550 GSAEffectiveTargetEnginePower 0;
BA_ "GenSigTimeoutTime_ECU" SG_ 2566912550 GSAMaxGroundSpeed 25000;
BA_ "GenSigSendType" SG_ 2566912550 GSAMaxGroundSpeed 0;
BA_ "GenSigTimeoutTime_ECU" SG_ 2566912550 GSATargetEnginePower 25000;
BA_ "GenSigSendType" SG_ 2566912550 GSATargetEnginePower 0;
BA_ "GenSigTimeoutTime_ECU" SG_ 2566912550 AutoUnloadAugerEngmtCmd 25000;
BA_ "GenSigSendType" SG_ 2566912550 AutoUnloadAugerEngmtCmd 0;
BA_ "GenSigTimeoutTime_ECU" SG_ 2566912550 HdrAutomationFeaturesReset 25000;
BA_ "GenSigSendType" SG_ 2566912550 HdrAutomationFeaturesReset 0;
BA_ "GenSigTimeoutTime_ECU" SG_ 2566912550 ShoeAreaLoss 25000;
BA_ "GenSigSendType" SG_ 2566912550 ShoeAreaLoss 0;
BA_ "GenSigTimeoutTime_ECU" SG_ 2566912550 SepAreaLoss 25000;
BA_ "GenSigSendType" SG_ 2566912550 SepAreaLoss 0;
BA_ "GenSigTimeoutTime_ECU" SG_ 2566912550 ShoePercentLoss 25000;
BA_ "GenSigSendType" SG_ 2566912550 ShoePercentLoss 0;
BA_ "GenSigTimeoutTime_ECU" SG_ 2566912550 SepPercentLoss 25000;
BA_ "GenSigSendType" SG_ 2566912550 SepPercentLoss 0;
BA_ "GenSigTimeoutTime_ECU" SG_ 2566912550 GrainLossScaleFactor 25000;
BA_ "GenSigSendType" SG_ 2566912550 GrainLossScaleFactor 0;
BA_ "GenSigTimeoutTime_ECU" SG_ 2566912550 HarvSetpInfoAckRespB1 25000;
BA_ "GenSigTimeoutTime_ECU" SG_ 2499803686 CmdBytePGN65530_VTV 5000;
BA_ "GenSigTimeoutTime_ECU" SG_ 2499803686 HdrGndSetg 5000;
BA_ "GenSigSendType" SG_ 2499803686 HdrGndSetg 0;
BA_ "GenSigTimeoutTime_ECU" SG_ 2499803686 FlexWingTunRatRstToDft 5000;
BA_ "GenSigSendType" SG_ 2499803686 FlexWingTunRatRstToDft 0;
BA_ "GenSigTimeoutTime_ECU" SG_ 2499803686 GSAflpRMSE 5000;
BA_ "GenSigSendType" SG_ 2499803686 GSAflpRMSE 0;
BA_ "GenSigTimeoutTime_ECU" SG_ 2499803686 GSAmbfRMSE 5000;
BA_ "GenSigSendType" SG_ 2499803686 GSAmbfRMSE 0;
BA_ "GenSigTimeoutTime_ECU" SG_ 2499803686 GSAfusedRMSE 5000;
BA_ "GenSigSendType" SG_ 2499803686 GSAfusedRMSE 0;
BA_ "GenSigTimeoutTime_ECU" SG_ 2499803686 GSACoverageMapRMSE 5000;
BA_ "GenSigSendType" SG_ 2499803686 GSACoverageMapRMSE 0;
BA_ "GenSigTimeoutTime_ECU" SG_ 2499803686 GSAConstantRMSE 5000;
BA_ "GenSigSendType" SG_ 2499803686 GSAConstantRMSE 0;
BA_ "GenSigTimeoutTime_ECU" SG_ 2499803686 GSAActivePredictionSource 5000;
BA_ "GenSigSendType" SG_ 2499803686 GSAActivePredictionSource 0;
BA_ "GenSigTimeoutTime_ECU" SG_ 2499803686 GSAActiveControlMode 5000;
BA_ "GenSigSendType" SG_ 2499803686 GSAActiveControlMode 0;
BA_ "GenSigTimeoutTime_ECU" SG_ 2499803686 GSAActiveUnloadingOnTheGoMode 5000;
BA_ "GenSigSendType" SG_ 2499803686 GSAActiveUnloadingOnTheGoMode 0;
BA_ "GenSigTimeoutTime_ECU" SG_ 2499803686 GSATerrainCompensationEnabled 5000;
BA_ "GenSigSendType" SG_ 2499803686 GSATerrainCompensationEnabled 0;
BA_ "GenSigTimeoutTime_ECU" SG_ 2499803686 GSADownCropEnabled 5000;
BA_ "GenSigSendType" SG_ 2499803686 GSADownCropEnabled 0;
BA_ "GenSigTimeoutTime_ECU" SG_ 2499803686 GSADownCropSensitivity 5000;
BA_ "GenSigSendType" SG_ 2499803686 GSADownCropSensitivity 0;
BA_ "GenSigTimeoutTime_ECU" SG_ 2499803686 GSADownCropMaxSpeed 5000;
BA_ "GenSigSendType" SG_ 2499803686 GSADownCropMaxSpeed 0;
BA_ "GenSigTimeoutTime_ECU" SG_ 2499803686 GSACropState 5000;
BA_ "GenSigSendType" SG_ 2499803686 GSACropState 0;
BA_ "GenSigTimeoutTime_ECU" SG_ 2499803686 MBFHealthStatus 5000;
BA_ "GenSigSendType" SG_ 2499803686 MBFHealthStatus 0;
BA_ "GenSigTimeoutTime_ECU" SG_ 2499803686 AutoDeckPlateToggleRequest 5000;
BA_ "GenSigSendType" SG_ 2499803686 AutoDeckPlateToggleRequest 0;
BA_ "GenSigTimeoutTime_ECU" SG_ 2499803686 AutoDeckPlateTightnessLevel 5000;
BA_ "GenSigSendType" SG_ 2499803686 AutoDeckPlateTightnessLevel 0;
BA_ "GenSigTimeoutTime_ECU" SG_ 2499803686 SlipClutchDetectionToggleRequest 5000;
BA_ "GenSigSendType" SG_ 2499803686 SlipClutchDetectionToggleRequest 0;
BA_ "GenSigTimeoutTime_ECU" SG_ 2499803686 TotalBrokenGrainFilter1 5000;
BA_ "GenSigSendType" SG_ 2499803686 TotalBrokenGrainFilter1 0;
BA_ "GenSigTimeoutTime_ECU" SG_ 2499803686 TotalForeignMaterialFilter1 5000;
BA_ "GenSigSendType" SG_ 2499803686 TotalForeignMaterialFilter1 0;
BA_ "GenSigTimeoutTime_ECU" SG_ 2499803686 TotalGrainLossFilter1 5000;
BA_ "GenSigSendType" SG_ 2499803686 TotalGrainLossFilter1 0;
BA_ "GenSigTimeoutTime_ECU" SG_ 2499803686 MassFlowRateFilter1 5000;
BA_ "GenSigSendType" SG_ 2499803686 MassFlowRateFilter1 0;
BA_ "GenSigTimeoutTime_ECU" SG_ 2499803686 MassFlowRateFilter2 5000;
BA_ "GenSigSendType" SG_ 2499803686 MassFlowRateFilter2 0;
BA_ "GenSigTimeoutTime_ECU" SG_ 2499803686 TotalBrokenGrainUserDefinedLimit 5000;
BA_ "GenSigSendType" SG_ 2499803686 TotalBrokenGrainUserDefinedLimit 0;
BA_ "GenSigTimeoutTime_ECU" SG_ 2499803686 TotaForeMateUserDefiLimi 5000;
BA_ "GenSigSendType" SG_ 2499803686 TotaForeMateUserDefiLimi 0;
BA_ "GenSigTimeoutTime_ECU" SG_ 2499803686 TotalGrainLossUserDefinedLimit 5000;
BA_ "GenSigSendType" SG_ 2499803686 TotalGrainLossUserDefinedLimit 0;
BA_ "GenSigTimeoutTime_ECU" SG_ 2499803686 GrainLossDispOpt 5000;
BA_ "GenSigSendType" SG_ 2499803686 GrainLossDispOpt 0;
BA_ "GenSigTimeoutTime_ECU" SG_ 2365585958 CmdBytePGN65530_VTV 1000;
BA_ "GenSigTimeoutTime_ECU" SG_ 2365585958 VehRollAng 1000;
BA_ "GenSigSendType" SG_ 2365585958 VehRollAng 0;
BA_ "GenSigTimeoutTime_ECU" SG_ 2365585958 RollRateExtRange 1000;
BA_ "GenSigSendType" SG_ 2365585958 RollRateExtRange 0;
BA_ "GenSigTimeoutTime_ECU" SG_ 2365585958 GSALimitingFactor 1000;
BA_ "GenSigSendType" SG_ 2365585958 GSALimitingFactor 0;
BA_ "GenSigTimeoutTime_ECU" SG_ 2499804158 CmdBytePGN65531_Vector_XXX 5000;
BA_ "GenSigTimeoutTime_ECU" SG_ 2499804158 GSAStatus 5000;
BA_ "GenSigSendType" SG_ 2499804158 GSAStatus 0;
BA_ "GenSigTimeoutTime_ECU" SG_ 2499804158 GSAOperatorDesiredSpeed 5000;
BA_ "GenSigSendType" SG_ 2499804158 GSAOperatorDesiredSpeed 0;
BA_ "GenSigTimeoutTime_ECU" SG_ 2499804158 GSAMinVehSpdLim 5000;
BA_ "GenSigSendType" SG_ 2499804158 GSAMinVehSpdLim 0;
BA_ "GenSigTimeoutTime_ECU" SG_ 2499804158 ReelAutomationAutoActivation 5000;
BA_ "GenSigSendType" SG_ 2499804158 ReelAutomationAutoActivation 0;
BA_ "GenSigTimeoutTime_ECU" SG_ 2499804158 ReelAutomationManualActivation 5000;
BA_ "GenSigSendType" SG_ 2499804158 ReelAutomationManualActivation 0;
BA_ "GenSigTimeoutTime_ECU" SG_ 2499804158 ReelAutomationPseudoResume 5000;
BA_ "GenSigSendType" SG_ 2499804158 ReelAutomationPseudoResume 0;
BA_ "GenSigTimeoutTime_ECU" SG_ 2499804158 HSAUtilization 5000;
BA_ "GenSigSendType" SG_ 2499804158 HSAUtilization 0;
BA_ "GenSigTimeoutTime_ECU" SG_ 2499804158 GSAUtilization 5000;
BA_ "GenSigSendType" SG_ 2499804158 GSAUtilization 0;
BA_ "GenSigTimeoutTime_ECU" SG_ 2499804158 TSAUtilization 5000;
BA_ "GenSigSendType" SG_ 2499804158 TSAUtilization 0;
BA_ "GenSigTimeoutTime_ECU" SG_ 2499804158 ReelAutomationUtilization 5000;
BA_ "GenSigSendType" SG_ 2499804158 ReelAutomationUtilization 0;
BA_ "GenSigTimeoutTime_ECU" SG_ 2499804158 DownCropReelAutoUtil 5000;
BA_ "GenSigSendType" SG_ 2499804158 DownCropReelAutoUtil 0;
BA_ "GenSigTimeoutTime_ECU" SG_ 2499804158 TerrFollAutoUtil 5000;
BA_ "GenSigSendType" SG_ 2499804158 TerrFollAutoUtil 0;
BA_ "GenSigTimeoutTime_ECU" SG_ 2499804158 CurrentCropProcessingPower 5000;
BA_ "GenSigSendType" SG_ 2499804158 CurrentCropProcessingPower 0;
BA_ "GenSigTimeoutTime_ECU" SG_ 2499804158 LossCropProcessingPowerTarget 5000;
BA_ "GenSigSendType" SG_ 2499804158 LossCropProcessingPowerTarget 0;
BA_ "GenSigTimeoutTime_ECU" SG_ 2499804158 TerrainCropProcessingPowerTarget 5000;
BA_ "GenSigSendType" SG_ 2499804158 TerrainCropProcessingPowerTarget 0;
BA_ "GenSigTimeoutTime_ECU" SG_ 2499804158 CropProcessingPowerTarget 5000;
BA_ "GenSigSendType" SG_ 2499804158 CropProcessingPowerTarget 0;
BA_ "GenSigTimeoutTime_ECU" SG_ 2499804158 MaxCropProcessingTarget 5000;
BA_ "GenSigSendType" SG_ 2499804158 MaxCropProcessingTarget 0;
BA_ "GenSigTimeoutTime_ECU" SG_ 2499804158 EstimatedUnloadingPowerPercent 5000;
BA_ "GenSigSendType" SG_ 2499804158 EstimatedUnloadingPowerPercent 0;
BA_ "GenSigTimeoutTime_ECU" SG_ 2499804158 MinCropProcessingTarget 5000;
BA_ "GenSigSendType" SG_ 2499804158 MinCropProcessingTarget 0;
BA_ "GenSigTimeoutTime_ECU" SG_ 2499804158 CropProcPoweInteStat 5000;
BA_ "GenSigSendType" SG_ 2499804158 CropProcPoweInteStat 0;
BA_ "GenSigTimeoutTime_ECU" SG_ 2499804158 CropProcPoweInteTargValu 5000;
BA_ "GenSigSendType" SG_ 2499804158 CropProcPoweInteTargValu 0;
BA_ "GenSigTimeoutTime_ECU" SG_ 2499804158 CropProcPoweInteCommStat 5000;
BA_ "GenSigSendType" SG_ 2499804158 CropProcPoweInteCommStat 0;
BA_ "GenSigTimeoutTime_ECU" SG_ 2499804158 ActiEarSaveLeftActuPosi 5000;
BA_ "GenSigSendType" SG_ 2499804158 ActiEarSaveLeftActuPosi 0;
BA_ "GenSigTimeoutTime_ECU" SG_ 2499804158 ActiEarSaveRighActuPosi 5000;
BA_ "GenSigSendType" SG_ 2499804158 ActiEarSaveRighActuPosi 0;
BA_ "GenSigTimeoutTime_ECU" SG_ 2499804158 ActiEarSaveMoveInteAchi 5000;
BA_ "GenSigSendType" SG_ 2499804158 ActiEarSaveMoveInteAchi 0;
BA_ "GenSigTimeoutTime_ECU" SG_ 2499804158 ActiveEarSaversLeftActuatorValid 5000;
BA_ "GenSigSendType" SG_ 2499804158 ActiveEarSaversLeftActuatorValid 0;
BA_ "GenSigTimeoutTime_ECU" SG_ 2499804158 ActiEarSaveRighActuVali 5000;
BA_ "GenSigSendType" SG_ 2499804158 ActiEarSaveRighActuVali 0;
BA_ "GenSigTimeoutTime_ECU" SG_ 2499804158 ActiEarSaveLinkUnliEnabStat 5000;
BA_ "GenSigSendType" SG_ 2499804158 ActiEarSaveLinkUnliEnabStat 0;
BA_ "GenSigTimeoutTime_ECU" SG_ 2499804158 ActiveEarSaversOptionInstalled 5000;
BA_ "GenSigSendType" SG_ 2499804158 ActiveEarSaversOptionInstalled 0;
BA_ "GenSigTimeoutTime_ECU" SG_ 2499804158 ActiEarSaveHighCurrDete 5000;
BA_ "GenSigSendType" SG_ 2499804158 ActiEarSaveHighCurrDete 0;
BA_ "GenSigTimeoutTime_ECU" SG_ 2499804158 LeftActiveEarSaversEnabled 5000;
BA_ "GenSigSendType" SG_ 2499804158 LeftActiveEarSaversEnabled 0;
BA_ "GenSigTimeoutTime_ECU" SG_ 2499804158 RightActiveEarSaversEnabled 5000;
BA_ "GenSigSendType" SG_ 2499804158 RightActiveEarSaversEnabled 0;
BA_ "GenSigTimeoutTime_ECU" SG_ 2499804158 WingFoldInterlockOverlayBm 5000;
BA_ "GenSigSendType" SG_ 2499804158 WingFoldInterlockOverlayBm 0;
BA_ "GenSigTimeoutTime_ECU" SG_ 2499804158 WingFoldUnfoldCmdActive 5000;
BA_ "GenSigSendType" SG_ 2499804158 WingFoldUnfoldCmdActive 0;
BA_ "GenSigTimeoutTime_ECU" SG_ 2499804158 TerrFollAutoToggComm 5000;
BA_ "GenSigSendType" SG_ 2499804158 TerrFollAutoToggComm 0;
BA_ "GenSigTimeoutTime_ECU" SG_ 2499804158 TerrainFollowingAutomationMode 5000;
BA_ "GenSigSendType" SG_ 2499804158 TerrainFollowingAutomationMode 0;
BA_ "GenSigTimeoutTime_ECU" SG_ 2499804158 ReelExtendRetractSensorStatus 5000;
BA_ "GenSigSendType" SG_ 2499804158 ReelExtendRetractSensorStatus 0;
BA_ "GenSigTimeoutTime_ECU" SG_ 2499804158 ReelRaiseLowerSensorStatus 5000;
BA_ "GenSigSendType" SG_ 2499804158 ReelRaiseLowerSensorStatus 0;
BA_ "GenSigTimeoutTime_ECU" SG_ 2499804158 ReelPositionResumeEnabled 5000;
BA_ "GenSigSendType" SG_ 2499804158 ReelPositionResumeEnabled 0;
BA_ "GenSigTimeoutTime_ECU" SG_ 2499804158 HeaderWeightCalEnabled 5000;
BA_ "GenSigSendType" SG_ 2499804158 HeaderWeightCalEnabled 0;
BA_ "GenSigTimeoutTime_ECU" SG_ 2499804158 AutoDPSensorStuckWSBm 5000;
BA_ "GenSigSendType" SG_ 2499804158 AutoDPSensorStuckWSBm 0;
BA_ "GenSigTimeoutTime_ECU" SG_ 2499804158 CuttAutoLockConfEnabStatBm 5000;
BA_ "GenSigSendType" SG_ 2499804158 CuttAutoLockConfEnabStatBm 0;
BA_ "GenSigTimeoutTime_ECU" SG_ 2499804158 CuttAutoLockUIConfEnabBm 5000;
BA_ "GenSigSendType" SG_ 2499804158 CuttAutoLockUIConfEnabBm 0;
BA_ "GenSigTimeoutTime_ECU" SG_ 2566913574 CmdBytePGN65534_VTV 5000;
BA_ "GenSigTimeoutTime_ECU" SG_ 2566913574 FeedFrwdSpeed 5000;
BA_ "GenSigSendType" SG_ 2566913574 FeedFrwdSpeed 0;
BA_ "GenSigTimeoutTime_ECU" SG_ 2566913574 CropTypeID 5000;
BA_ "GenSigSendType" SG_ 2566913574 CropTypeID 0;
BA_ "GenSigTimeoutTime_ECU" SG_ 2566913574 HarvSepRotrPressState 5000;
BA_ "GenSigSendType" SG_ 2566913574 HarvSepRotrPressState 0;
BA_ "GenSigTimeoutTime_ECU" SG_ 2566913574 ProdMassFlowState 5000;
BA_ "GenSigSendType" SG_ 2566913574 ProdMassFlowState 0;
BA_ "GenSigTimeoutTime_ECU" SG_ 2566913574 GSALossMaintainEnable 5000;
BA_ "GenSigSendType" SG_ 2566913574 GSALossMaintainEnable 0;
BA_ "GenSigTimeoutTime_ECU" SG_ 2566911230 CmdBytePGN65524_Vector_XXX 500;
BA_ "GenSigTimeoutTime_ECU" SG_ 2566911230 CrvtrCntrlATState_ATSV 500;
BA_ "GenSigSendType" SG_ 2566911230 CrvtrCntrlATState_ATSV 0;
BA_ "GenSigTimeoutTime_ECU" SG_ 2566911230 SteeredWheelAngle 500;
BA_ "GenSigSendType" SG_ 2566911230 SteeredWheelAngle 0;
BA_ "GenSigTimeoutTime_ECU" SG_ 2566911230 RedSteerWarnLightRequest 500;
BA_ "GenSigSendType" SG_ 2566911230 RedSteerWarnLightRequest 0;
BA_ "GenSigTimeoutTime_ECU" SG_ 2566911230 Heartbeat 500;
BA_ "GenSigSendType" SG_ 2566911230 Heartbeat 0;
BA_ "GenSigTimeoutTime_ECU" SG_ 2566911230 AT2ExitCode_GMSJDE 500;
BA_ "GenSigSendType" SG_ 2566911230 AT2ExitCode_GMSJDE 0;
BA_ "GenSigTimeoutTime_ECU" SG_ 2566911230 WheelBasedVehicleSpeed_GMSJDE 500;
BA_ "GenSigSendType" SG_ 2566911230 WheelBasedVehicleSpeed_GMSJDE 0;
BA_ "GenSigTimeoutTime_ECU" SG_ 2566911230 VehDirection 500;
BA_ "GenSigSendType" SG_ 2566911230 VehDirection 0;
BA_ "GenSigTimeoutTime_ECU" SG_ 2566911230 AutoTracSystemState 500;
BA_ "GenSigSendType" SG_ 2566911230 AutoTracSystemState 0;
BA_ "GenSigTimeoutTime_ECU" SG_ 2566911230 StarfireFwdCfg_GMSJDE 500;
BA_ "GenSigSendType" SG_ 2566911230 StarfireFwdCfg_GMSJDE 0;
BA_ "GenSigTimeoutTime_ECU" SG_ 2566911230 ActivateGuidanceRequest 500;
BA_ "GenSigSendType" SG_ 2566911230 ActivateGuidanceRequest 0;
BA_ "GenSigTimeoutTime_ECU" SG_ 2566911230 AuxiliarySteerMode 500;
BA_ "GenSigSendType" SG_ 2566911230 AuxiliarySteerMode 0;
BA_ "GenSigTimeoutTime_ECU" SG_ 2566911230 Heartbeat 500;
BA_ "GenSigSendType" SG_ 2566911230 Heartbeat 0;
BA_ "GenSigTimeoutTime_ECU" SG_ 2566911230 SensorType_LESS 500;
BA_ "GenSigSendType" SG_ 2566911230 SensorType_LESS 0;
BA_ "GenSigTimeoutTime_ECU" SG_ 2566911230 CalProgress_LESS 500;
BA_ "GenSigSendType" SG_ 2566911230 CalProgress_LESS 0;
BA_ "GenSigTimeoutTime_ECU" SG_ 2566911230 SensorVoltageLeft_LESS 500;
BA_ "GenSigSendType" SG_ 2566911230 SensorVoltageLeft_LESS 0;
BA_ "GenSigTimeoutTime_ECU" SG_ 2566911230 SensorVoltageRight_LESS 500;
BA_ "GenSigSendType" SG_ 2566911230 SensorVoltageRight_LESS 0;
BA_ "GenSigTimeoutTime_ECU" SG_ 2566911230 SensorBias_LESS 500;
BA_ "GenSigSendType" SG_ 2566911230 SensorBias_LESS 0;
BA_ "GenSigTimeoutTime_ECU" SG_ 2566911230 CalState_LESS 500;
BA_ "GenSigSendType" SG_ 2566911230 CalState_LESS 0;
BA_ "GenSigTimeoutTime_ECU" SG_ 2566911230 CalPage_LESS 500;
BA_ "GenSigSendType" SG_ 2566911230 CalPage_LESS 0;
BA_ "GenSigTimeoutTime_ECU" SG_ 2566911230 SensorType_VSRS 500;
BA_ "GenSigSendType" SG_ 2566911230 SensorType_VSRS 0;
BA_ "GenSigTimeoutTime_ECU" SG_ 2566911230 TransmissionState_VSRS 500;
BA_ "GenSigSendType" SG_ 2566911230 TransmissionState_VSRS 0;
BA_ "GenSigTimeoutTime_ECU" SG_ 2566911230 WheelBasedVehicleSpeed_VSRS 500;
BA_ "GenSigSendType" SG_ 2566911230 WheelBasedVehicleSpeed_VSRS 0;
BA_ "GenSigTimeoutTime_ECU" SG_ 2566911230 AntennaLocationXaxis 500;
BA_ "GenSigSendType" SG_ 2566911230 AntennaLocationXaxis 0;
BA_ "GenSigTimeoutTime_ECU" SG_ 2566911230 SensorShift 500;
BA_ "GenSigSendType" SG_ 2566911230 SensorShift 0;
BA_ "GenSigTimeoutTime_ECU" SG_ 2566912603 CmdBytePGN65530_POD 25000;
BA_ "GenSigTimeoutTime_ECU" SG_ 2566912603 RatedPower 25000;
BA_ "GenSigSendType" SG_ 2566912603 RatedPower 0;
BA_ "GenSigTimeoutTime_ECU" SG_ 2566912603 PeakPower 25000;
BA_ "GenSigSendType" SG_ 2566912603 PeakPower 0;
BA_ "GenSigTimeoutTime_ECU" SG_ 2566912603 TransmissionPowerPercent 25000;
BA_ "GenSigSendType" SG_ 2566912603 TransmissionPowerPercent 0;
BA_ "GenSigTimeoutTime_ECU" SG_ 2566912603 BoostPowerMeterStartYellowC 25000;
BA_ "GenSigSendType" SG_ 2566912603 BoostPowerMeterStartYellowC 0;
BA_ "GenSigTimeoutTime_ECU" SG_ 2566912603 BoostPowerMeterStartRedD 25000;
BA_ "GenSigSendType" SG_ 2566912603 BoostPowerMeterStartRedD 0;
BA_ "GenSigTimeoutTime_ECU" SG_ 2566912603 BoostPowerMeterStartRedE 25000;
BA_ "GenSigSendType" SG_ 2566912603 BoostPowerMeterStartRedE 0;
BA_ "GenSigTimeoutTime_ECU" SG_ 2566912603 WorkLight13LeftStatus 25000;
BA_ "GenSigSendType" SG_ 2566912603 WorkLight13LeftStatus 0;
BA_ "GenSigTimeoutTime_ECU" SG_ 2566912603 WorkLight13RightStatus 25000;
BA_ "GenSigSendType" SG_ 2566912603 WorkLight13RightStatus 0;
BA_ "GenSigTimeoutTime_ECU" SG_ 2566913585 CmdBytePGN65534_CAB 5000;
BA_ "GenSigTimeoutTime_ECU" SG_ 2566913585 CabACRefCmprsrOutPress 5000;
BA_ "GenSigSendType" SG_ 2566913585 CabACRefCmprsrOutPress 0;
BA_ "GenSigTimeoutTime_ECU" SG_ 2565864446 CmdBytePGN61184_Vector_XXX 25000;
BA_ "GenSigTimeoutTime_ECU" SG_ 2565864446 ForwardEyeOpeningPort1 25000;
BA_ "GenSigSendType" SG_ 2565864446 ForwardEyeOpeningPort1 0;
BA_ "GenSigTimeoutTime_ECU" SG_ 2565864446 ForwardLinkMarginPort1 25000;
BA_ "GenSigSendType" SG_ 2565864446 ForwardLinkMarginPort1 0;
BA_ "GenSigTimeoutTime_ECU" SG_ 2565864446 ReverseLinkMarginPort1 25000;
BA_ "GenSigSendType" SG_ 2565864446 ReverseLinkMarginPort1 0;
BA_ "GenSigTimeoutTime_ECU" SG_ 2565864446 CurrentDrawPort1 25000;
BA_ "GenSigSendType" SG_ 2565864446 CurrentDrawPort1 0;
BA_ "GenSigTimeoutTime_ECU" SG_ 2565864446 ForwardEyeOpeningPort3 25000;
BA_ "GenSigSendType" SG_ 2565864446 ForwardEyeOpeningPort3 0;
BA_ "GenSigTimeoutTime_ECU" SG_ 2565864446 ForwardLinkMarginPort3 25000;
BA_ "GenSigSendType" SG_ 2565864446 ForwardLinkMarginPort3 0;
BA_ "GenSigTimeoutTime_ECU" SG_ 2565864446 ReverseLinkMarginPort3 25000;
BA_ "GenSigSendType" SG_ 2565864446 ReverseLinkMarginPort3 0;
BA_ "GenSigTimeoutTime_ECU" SG_ 2565864446 CurrentDrawPort3 25000;
BA_ "GenSigSendType" SG_ 2565864446 CurrentDrawPort3 0;
BA_ "GenSigTimeoutTime_ECU" SG_ 2565864446 EthernetStatus 25000;
BA_ "GenSigSendType" SG_ 2565864446 EthernetStatus 0;
BA_ "GenSigTimeoutTime_ECU" SG_ 2565864446 WatchdogReason 25000;
BA_ "GenSigSendType" SG_ 2565864446 WatchdogReason 0;
BA_ "GenSigTimeoutTime_ECU" SG_ 2565864446 ControllerTemperature 25000;
BA_ "GenSigSendType" SG_ 2565864446 ControllerTemperature 0;
BA_ "GenSigTimeoutTime_ECU" SG_ 2565864446 WatchdogCount 25000;
BA_ "GenSigSendType" SG_ 2565864446 WatchdogCount 0;
BA_ "GenSigTimeoutTime_ECU" SG_ 2565865470 CmdBytePGN61184_Vector_XXX 25000;
BA_ "GenSigTimeoutTime_ECU" SG_ 2565865470 CompressionTest 25000;
BA_ "GenSigSendType" SG_ 2565865470 CompressionTest 0;
BA_ "GenSigTimeoutTime_ECU" SG_ 2565865470 CylinderDiagnostics 25000;
BA_ "GenSigSendType" SG_ 2565865470 CylinderDiagnostics 0;
BA_ "GenSigTimeoutTime_ECU" SG_ 2565865470 CylinderCutoutTest 25000;
BA_ "GenSigSendType" SG_ 2565865470 CylinderCutoutTest 0;
BA_ "GenSigTimeoutTime_ECU" SG_ 2565865470 CylinderDiagnosticsTrigger 25000;
BA_ "GenSigSendType" SG_ 2565865470 CylinderDiagnosticsTrigger 0;
BA_ "GenSigTimeoutTime_ECU" SG_ 2565865470 ActuatorDriverTest 25000;
BA_ "GenSigSendType" SG_ 2565865470 ActuatorDriverTest 0;
BA_ "GenSigTimeoutTime_ECU" SG_ 2565865470 EngiOverShutTestEnab 25000;
BA_ "GenSigSendType" SG_ 2565865470 EngiOverShutTestEnab 0;
BA_ "GenSigTimeoutTime_ECU" SG_ 2565865470 CompressionTestState 25000;
BA_ "GenSigSendType" SG_ 2565865470 CompressionTestState 0;
BA_ "GenSigTimeoutTime_ECU" SG_ 2565865470 CylinderDiagnosticsState 25000;
BA_ "GenSigSendType" SG_ 2565865470 CylinderDiagnosticsState 0;
BA_ "GenSigTimeoutTime_ECU" SG_ 2565865470 CylinderCutoutCylinderNumber 25000;
BA_ "GenSigSendType" SG_ 2565865470 CylinderCutoutCylinderNumber 0;
BA_ "GenSigTimeoutTime_ECU" SG_ 2565865470 ActuatorTestIndex 25000;
BA_ "GenSigSendType" SG_ 2565865470 ActuatorTestIndex 0;
BA_ "GenSigTimeoutTime_ECU" SG_ 2565865470 ActuatorTestType 25000;
BA_ "GenSigSendType" SG_ 2565865470 ActuatorTestType 0;
BA_ "GenSigTimeoutTime_ECU" SG_ 2565865470 ActuatorOutputValue 25000;
BA_ "GenSigSendType" SG_ 2565865470 ActuatorOutputValue 0;
BA_ "GenSigTimeoutTime_ECU" SG_ 2565865470 AftrNmbrSulfDepCleaEven 25000;
BA_ "GenSigSendType" SG_ 2565865470 AftrNmbrSulfDepCleaEven 0;
BA_ "GenSigTimeoutTime_ECU" SG_ 2565865470 AftrNmbrNOxCnvrEffnRcovEven 25000;
BA_ "GenSigSendType" SG_ 2565865470 AftrNmbrNOxCnvrEffnRcovEven 0;
BA_ "GenSigTimeoutTime_ECU" SG_ 2565865470 AftrtrtmntNmbrUreaDepCleanEvent 25000;
BA_ "GenSigSendType" SG_ 2565865470 AftrtrtmntNmbrUreaDepCleanEvent 0;
BA_ "GenSigTimeoutTime_ECU" SG_ 2565865470 JDPresEngCtrlMode 25000;
BA_ "GenSigSendType" SG_ 2565865470 JDPresEngCtrlMode 0;
BA_ "GenSigTimeoutTime_ECU" SG_ 2565865470 EngOpStateFromEcu 25000;
BA_ "GenSigSendType" SG_ 2565865470 EngOpStateFromEcu 0;
BA_ "GenSigTimeoutTime_ECU" SG_ 2565865470 EngWaitToStartLamp 25000;
BA_ "GenSigSendType" SG_ 2565865470 EngWaitToStartLamp 0;
BA_ "GenSigTimeoutTime_ECU" SG_ 2565865470 EngProtectSysHasShtdwnEng 25000;
BA_ "GenSigSendType" SG_ 2565865470 EngProtectSysHasShtdwnEng 0;
BA_ "GenSigTimeoutTime_ECU" SG_ 2565865470 RemainingStartingAidTime 25000;
BA_ "GenSigSendType" SG_ 2565865470 RemainingStartingAidTime 0;
BA_ "GenSigTimeoutTime_ECU" SG_ 2565865470 EngStrCooldwnTimer 25000;
BA_ "GenSigSendType" SG_ 2565865470 EngStrCooldwnTimer 0;
BA_ "GenSigTimeoutTime_ECU" SG_ 2565865470 MngdEngShutdwnCooldwnTimer 25000;
BA_ "GenSigSendType" SG_ 2565865470 MngdEngShutdwnCooldwnTimer 0;
BA_ "GenSigTimeoutTime_ECU" SG_ 2565865470 EngTorqueDerateSetpnt 25000;
BA_ "GenSigSendType" SG_ 2565865470 EngTorqueDerateSetpnt 0;
BA_ "GenSigTimeoutTime_ECU" SG_ 2565865470 DPFTtlNmbrOfActRegen 25000;
BA_ "GenSigSendType" SG_ 2565865470 DPFTtlNmbrOfActRegen 0;
BA_ "GenSigTimeoutTime_ECU" SG_ 2565865470 DPFTtlNmbrOfAbrtdRegen 25000;
BA_ "GenSigSendType" SG_ 2565865470 DPFTtlNmbrOfAbrtdRegen 0;
BA_ "GenSigTimeoutTime_ECU" SG_ 2565865470 DPFPresNmbrAbortRegen 25000;
BA_ "GenSigSendType" SG_ 2565865470 DPFPresNmbrAbortRegen 0;
BA_ "GenSigTimeoutTime_ECU" SG_ 2565865470 SPRMaxTorque 25000;
BA_ "GenSigSendType" SG_ 2565865470 SPRMaxTorque 0;
BA_ "GenSigTimeoutTime_ECU" SG_ 2565865470 SPRActiveFlag 25000;
BA_ "GenSigSendType" SG_ 2565865470 SPRActiveFlag 0;
BA_ "GenSigTimeoutTime_ECU" SG_ 2565865470 HeadOffGrouContModeAllo 25000;
BA_ "GenSigSendType" SG_ 2565865470 HeadOffGrouContModeAllo 0;
BA_ "GenSigTimeoutTime_ECU" SG_ 2565865470 HeadOnGrouContModeAllo 25000;
BA_ "GenSigSendType" SG_ 2565865470 HeadOnGrouContModeAllo 0;
BA_ "GenSigTimeoutTime_ECU" SG_ 2565865470 ForwardEyeOpeningPort1 25000;
BA_ "GenSigSendType" SG_ 2565865470 ForwardEyeOpeningPort1 0;
BA_ "GenSigTimeoutTime_ECU" SG_ 2565865470 ForwardLinkMarginPort1 25000;
BA_ "GenSigSendType" SG_ 2565865470 ForwardLinkMarginPort1 0;
BA_ "GenSigTimeoutTime_ECU" SG_ 2565865470 ReverseLinkMarginPort1 25000;
BA_ "GenSigSendType" SG_ 2565865470 ReverseLinkMarginPort1 0;
BA_ "GenSigTimeoutTime_ECU" SG_ 2565865470 CurrentDrawPort1 25000;
BA_ "GenSigSendType" SG_ 2565865470 CurrentDrawPort1 0;
BA_ "GenSigTimeoutTime_ECU" SG_ 2565865470 HeaderAuxIconEnbld 25000;
BA_ "GenSigSendType" SG_ 2565865470 HeaderAuxIconEnbld 0;
BA_ "GenSigTimeoutTime_ECU" SG_ 2565865470 ForwardEyeOpeningPort3 25000;
BA_ "GenSigSendType" SG_ 2565865470 ForwardEyeOpeningPort3 0;
BA_ "GenSigTimeoutTime_ECU" SG_ 2565865470 ForwardLinkMarginPort3 25000;
BA_ "GenSigSendType" SG_ 2565865470 ForwardLinkMarginPort3 0;
BA_ "GenSigTimeoutTime_ECU" SG_ 2565865470 ReverseLinkMarginPort3 25000;
BA_ "GenSigSendType" SG_ 2565865470 ReverseLinkMarginPort3 0;
BA_ "GenSigTimeoutTime_ECU" SG_ 2565865470 CurrentDrawPort3 25000;
BA_ "GenSigSendType" SG_ 2565865470 CurrentDrawPort3 0;
BA_ "GenSigTimeoutTime_ECU" SG_ 2565865470 EthernetStatus 25000;
BA_ "GenSigSendType" SG_ 2565865470 EthernetStatus 0;
BA_ "GenSigTimeoutTime_ECU" SG_ 2565865470 WatchdogReason 25000;
BA_ "GenSigSendType" SG_ 2565865470 WatchdogReason 0;
BA_ "GenSigTimeoutTime_ECU" SG_ 2565865470 ControllerTemperature 25000;
BA_ "GenSigSendType" SG_ 2565865470 ControllerTemperature 0;
BA_ "GenSigTimeoutTime_ECU" SG_ 2565865470 WatchdogCount 25000;
BA_ "GenSigSendType" SG_ 2565865470 WatchdogCount 0;
BA_ "GenSigTimeoutTime_ECU" SG_ 2365584177 CmdBytePGN65523_CAB 200;
BA_ "GenSigTimeoutTime_ECU" SG_ 2365584177 HydroHndlPstn 200;
BA_ "GenSigSendType" SG_ 2365584177 HydroHndlPstn 0;
BA_ "GenSigTimeoutTime_ECU" SG_ 2365584177 ParkBrakeReq 200;
BA_ "GenSigSendType" SG_ 2365584177 ParkBrakeReq 0;
BA_ "GenSigTimeoutTime_ECU" SG_ 2365584177 HydHndlState 200;
BA_ "GenSigSendType" SG_ 2365584177 HydHndlState 0;
BA_ "GenSigTimeoutTime_ECU" SG_ 2566913770 CmdBytePGN65534_FED 60000;
BA_ "GenSigTimeoutTime_ECU" SG_ 2566913771 CmdBytePGN65534_HAD 60000;
BA_ "GenSigTimeoutTime_ECU" SG_ 2566913627 CmdBytePGN65534_POD 60000;
BA_ "GenSigTimeoutTime_ECU" SG_ 2566913627 EngType 60000;
BA_ "GenSigSendType" SG_ 2566913627 EngType 0;
BA_ "GenSigTimeoutTime_ECU" SG_ 2566912200 CmdBytePGN65528_DC1 60000;
BA_ "GenSigTimeoutTime_ECU" SG_ 2566912234 CmdBytePGN65528_FED 60000;
BA_ "GenSigTimeoutTime_ECU" SG_ 2566912234 CutterBarPstn 60000;
BA_ "GenSigSendType" SG_ 2566912234 CutterBarPstn 0;
BA_ "GenSigTimeoutTime_ECU" SG_ 2566912235 CmdBytePGN65528_HAD 60000;
BA_ "GenSigTimeoutTime_ECU" SG_ 2566912235 SeparatorEngagedVideoTrigger 60000;
BA_ "GenSigSendType" SG_ 2566912235 SeparatorEngagedVideoTrigger 0;
BA_ "GenSigTimeoutTime_ECU" SG_ 2566912235 AugerEngagedVideoTrigger 60000;
BA_ "GenSigSendType" SG_ 2566912235 AugerEngagedVideoTrigger 0;
BA_ "GenSigTimeoutTime_ECU" SG_ 2566912235 GrainTank_3_4_VideoTrigger 60000;
BA_ "GenSigSendType" SG_ 2566912235 GrainTank_3_4_VideoTrigger 0;
BA_ "GenSigTimeoutTime_ECU" SG_ 2566912235 GrainTankFullVideoTrigger 60000;
BA_ "GenSigSendType" SG_ 2566912235 GrainTankFullVideoTrigger 0;
BA_ "GenSigTimeoutTime_ECU" SG_ 2566912235 SepaEngaReveVideTrig 60000;
BA_ "GenSigSendType" SG_ 2566912235 SepaEngaReveVideTrig 0;
BA_ "GenSigTimeoutTime_ECU" SG_ 2566912235 SepaDisEngaReveVideTrig 60000;
BA_ "GenSigSendType" SG_ 2566912235 SepaDisEngaReveVideTrig 0;
BA_ "GenSigTimeoutTime_ECU" SG_ 2566912235 AugerSwungOutVideoTrigger 60000;
BA_ "GenSigSendType" SG_ 2566912235 AugerSwungOutVideoTrigger 0;
BA_ "GenSigTimeoutTime_ECU" SG_ 2566912235 RoadTransportVideoTrigger 60000;
BA_ "GenSigSendType" SG_ 2566912235 RoadTransportVideoTrigger 0;
BA_ "GenSigTimeoutTime_ECU" SG_ 2566912091 CmdBytePGN65528_POD 60000;
BA_ "GenSigTimeoutTime_ECU" SG_ 2498756586 CmdBytePGN61184_FED 5000;
BA_ "GenSigTimeoutTime_ECU" SG_ 2498756586 CtlrDispPwrStateCmd 5000;
BA_ "GenSigSendType" SG_ 2498756586 CtlrDispPwrStateCmd 0;
BA_ "GenSigTimeoutTime_ECU" SG_ 2498756586 FdrhseRaiseLwrSysState 5000;
BA_ "GenSigSendType" SG_ 2498756586 FdrhseRaiseLwrSysState 0;
BA_ "GenSigTimeoutTime_ECU" SG_ 2498756586 FdrhseLatTiltSysState 5000;
BA_ "GenSigSendType" SG_ 2498756586 FdrhseLatTiltSysState 0;
BA_ "GenSigTimeoutTime_ECU" SG_ 2498756586 MachineHarvestingState 5000;
BA_ "GenSigSendType" SG_ 2498756586 MachineHarvestingState 0;
BA_ "GenSigTimeoutTime_ECU" SG_ 2498756586 HeaderDrive 5000;
BA_ "GenSigSendType" SG_ 2498756586 HeaderDrive 0;
BA_ "GenSigTimeoutTime_ECU" SG_ 2498756586 HdrType 5000;
BA_ "GenSigSendType" SG_ 2498756586 HdrType 0;
BA_ "GenSigTimeoutTime_ECU" SG_ 2498756586 HdrTiltAng 5000;
BA_ "GenSigSendType" SG_ 2498756586 HdrTiltAng 0;
BA_ "GenSigTimeoutTime_ECU" SG_ 2498756586 ReelSpeedSystemMode 5000;
BA_ "GenSigSendType" SG_ 2498756586 ReelSpeedSystemMode 0;
BA_ "GenSigTimeoutTime_ECU" SG_ 2498756586 ValidHeadConnectionStatus 5000;
BA_ "GenSigSendType" SG_ 2498756586 ValidHeadConnectionStatus 0;
BA_ "GenSigTimeoutTime_ECU" SG_ 2498756586 FrntEndPreEngmtChecksPassd 5000;
BA_ "GenSigSendType" SG_ 2498756586 FrntEndPreEngmtChecksPassd 0;
BA_ "GenSigTimeoutTime_ECU" SG_ 2498756586 LateralTiltOptn 5000;
BA_ "GenSigSendType" SG_ 2498756586 LateralTiltOptn 0;
BA_ "GenSigTimeoutTime_ECU" SG_ 2498756587 CmdBytePGN61184_HAD 5000;
BA_ "GenSigTimeoutTime_ECU" SG_ 2498756587 RoadFieldMode 5000;
BA_ "GenSigSendType" SG_ 2498756587 RoadFieldMode 0;
BA_ "GenSigTimeoutTime_ECU" SG_ 2498756587 AutoBeaconLightsCmd 5000;
BA_ "GenSigSendType" SG_ 2498756587 AutoBeaconLightsCmd 0;
BA_ "GenSigTimeoutTime_ECU" SG_ 2498756587 EstimdRoadFieldMode 5000;
BA_ "GenSigSendType" SG_ 2498756587 EstimdRoadFieldMode 0;
BA_ "GenSigTimeoutTime_ECU" SG_ 2498756587 CtlrDispPwrStateCmd 5000;
BA_ "GenSigSendType" SG_ 2498756587 CtlrDispPwrStateCmd 0;
BA_ "GenSigTimeoutTime_ECU" SG_ 2498756587 UnldngAugerPstn 5000;
BA_ "GenSigSendType" SG_ 2498756587 UnldngAugerPstn 0;
BA_ "GenSigTimeoutTime_ECU" SG_ 2498756587 GrainTankFillLvl 5000;
BA_ "GenSigSendType" SG_ 2498756587 GrainTankFillLvl 0;
BA_ "GenSigTimeoutTime_ECU" SG_ 2498756587 UnldgAugBootPstn 5000;
BA_ "GenSigSendType" SG_ 2498756587 UnldgAugBootPstn 0;
BA_ "GenSigTimeoutTime_ECU" SG_ 2498756587 GrainTankCoversState 5000;
BA_ "GenSigSendType" SG_ 2498756587 GrainTankCoversState 0;
BA_ "GenSigTimeoutTime_ECU" SG_ 2498756587 FoldingUnloadingAugerState 5000;
BA_ "GenSigSendType" SG_ 2498756587 FoldingUnloadingAugerState 0;
BA_ "GenSigTimeoutTime_ECU" SG_ 2498756587 FountainLdngAugState 5000;
BA_ "GenSigSendType" SG_ 2498756587 FountainLdngAugState 0;
BA_ "GenSigTimeoutTime_ECU" SG_ 2498756587 GrainTank34FullAlrm 5000;
BA_ "GenSigSendType" SG_ 2498756587 GrainTank34FullAlrm 0;
BA_ "GenSigTimeoutTime_ECU" SG_ 2498756587 GrainTankFullAlrm 5000;
BA_ "GenSigSendType" SG_ 2498756587 GrainTankFullAlrm 0;
BA_ "GenSigTimeoutTime_ECU" SG_ 2498756587 UnloadingAugerDrive 5000;
BA_ "GenSigSendType" SG_ 2498756587 UnloadingAugerDrive 0;
BA_ "GenSigTimeoutTime_ECU" SG_ 2498756587 UnldgAugBootCleanoutState 5000;
BA_ "GenSigSendType" SG_ 2498756587 UnldgAugBootCleanoutState 0;
BA_ "GenSigTimeoutTime_ECU" SG_ 2498756587 FeedAccelSpd 5000;
BA_ "GenSigSendType" SG_ 2498756587 FeedAccelSpd 0;
BA_ "GenSigTimeoutTime_ECU" SG_ 2498756587 ShoeSpd 5000;
BA_ "GenSigSendType" SG_ 2498756587 ShoeSpd 0;
BA_ "GenSigTimeoutTime_ECU" SG_ 2498756587 CleanGrainElevSpd 5000;
BA_ "GenSigSendType" SG_ 2498756587 CleanGrainElevSpd 0;
BA_ "GenSigTimeoutTime_ECU" SG_ 2498756587 TailingsSpd 5000;
BA_ "GenSigSendType" SG_ 2498756587 TailingsSpd 0;
BA_ "GenSigTimeoutTime_ECU" SG_ 2498756587 SpreaderSpd 5000;
BA_ "GenSigSendType" SG_ 2498756587 SpreaderSpd 0;
BA_ "GenSigTimeoutTime_ECU" SG_ 2498756587 LoadingAugSpd 5000;
BA_ "GenSigSendType" SG_ 2498756587 LoadingAugSpd 0;
BA_ "GenSigTimeoutTime_ECU" SG_ 2498756587 FrontCrossAugSpd 5000;
BA_ "GenSigSendType" SG_ 2498756587 FrontCrossAugSpd 0;
BA_ "GenSigTimeoutTime_ECU" SG_ 2498756587 ChopperSpd 5000;
BA_ "GenSigSendType" SG_ 2498756587 ChopperSpd 0;
BA_ "GenSigTimeoutTime_ECU" SG_ 2498756587 RearCrossAugSpd 5000;
BA_ "GenSigSendType" SG_ 2498756587 RearCrossAugSpd 0;
BA_ "GenSigTimeoutTime_ECU" SG_ 2498756587 ProdFanSpd 5000;
BA_ "GenSigSendType" SG_ 2498756587 ProdFanSpd 0;
BA_ "GenSigTimeoutTime_ECU" SG_ 2498756587 ChafferPstn 5000;
BA_ "GenSigSendType" SG_ 2498756587 ChafferPstn 0;
BA_ "GenSigTimeoutTime_ECU" SG_ 2498756587 SievePstn 5000;
BA_ "GenSigSendType" SG_ 2498756587 SievePstn 0;
BA_ "GenSigTimeoutTime_ECU" SG_ 2498756587 TotalSeparatorHours 5000;
BA_ "GenSigSendType" SG_ 2498756587 TotalSeparatorHours 0;
BA_ "GenSigTimeoutTime_ECU" SG_ 2498756587 ThreshingPressure 5000;
BA_ "GenSigSendType" SG_ 2498756587 ThreshingPressure 0;
BA_ "GenSigTimeoutTime_ECU" SG_ 2498756587 ThreshingPressureStatus 5000;
BA_ "GenSigSendType" SG_ 2498756587 ThreshingPressureStatus 0;
BA_ "GenSigTimeoutTime_ECU" SG_ 2498756587 TineSepGratePstn 5000;
BA_ "GenSigSendType" SG_ 2498756587 TineSepGratePstn 0;
BA_ "GenSigTimeoutTime_ECU" SG_ 2498756443 CmdBytePGN61184_POD 5000;
BA_ "GenSigTimeoutTime_ECU" SG_ 2498756443 CtlrDispPwrStateCmd 5000;
BA_ "GenSigSendType" SG_ 2498756443 CtlrDispPwrStateCmd 0;
BA_ "GenSigTimeoutTime_ECU" SG_ 2498756443 AirCompEngageState 5000;
BA_ "GenSigSendType" SG_ 2498756443 AirCompEngageState 0;
BA_ "GenSigTimeoutTime_ECU" SG_ 2498756443 LoBattVoltAlrm 5000;
BA_ "GenSigSendType" SG_ 2498756443 LoBattVoltAlrm 0;
BA_ "GenSigTimeoutTime_ECU" SG_ 2498756443 AltRegultrStateAlrm 5000;
BA_ "GenSigSendType" SG_ 2498756443 AltRegultrStateAlrm 0;
BA_ "GenSigTimeoutTime_ECU" SG_ 2498756443 EngRun 5000;
BA_ "GenSigSendType" SG_ 2498756443 EngRun 0;
BA_ "GenSigTimeoutTime_ECU" SG_ 2498756443 EngThrottleState 5000;
BA_ "GenSigSendType" SG_ 2498756443 EngThrottleState 0;
BA_ "GenSigTimeoutTime_ECU" SG_ 2498756443 EnginePowerPercent 5000;
BA_ "GenSigSendType" SG_ 2498756443 EnginePowerPercent 0;
BA_ "GenSigTimeoutTime_ECU" SG_ 2498756443 VehicleMovingState 5000;
BA_ "GenSigSendType" SG_ 2498756443 VehicleMovingState 0;
BA_ "GenSigTimeoutTime_ECU" SG_ 2498756443 FlexpowerStatusToVeh 5000;
BA_ "GenSigSendType" SG_ 2498756443 FlexpowerStatusToVeh 0;
BA_ "GenSigTimeoutTime_ECU" SG_ 2632974171 CmdBytePGN61184_POD 60000;
BA_ "GenSigTimeoutTime_ECU" SG_ 2632974171 Opt4WD 60000;
BA_ "GenSigSendType" SG_ 2632974171 Opt4WD 0;
BA_ "GenSigTimeoutTime_ECU" SG_ 2632974171 EngSpdInRoadMode 60000;
BA_ "GenSigSendType" SG_ 2632974171 EngSpdInRoadMode 0;
BA_ "GenSigTimeoutTime_ECU" SG_ 2632974171 OptType4WD 60000;
BA_ "GenSigSendType" SG_ 2632974171 OptType4WD 0;
BA_ "GenSigTimeoutTime_ECU" SG_ 2632974171 TracksOption 60000;
BA_ "GenSigSendType" SG_ 2632974171 TracksOption 0;
BA_ "GenSigTimeoutTime_ECU" SG_ 2634021610 CmdBytePGN65530_FED 5000;
BA_ "GenSigTimeoutTime_ECU" SG_ 2634021610 ControllerInfoFrame 5000;
BA_ "GenSigTimeoutTime_ECU" SG_ 2634021611 CmdBytePGN65530_HAD 5000;
BA_ "GenSigTimeoutTime_ECU" SG_ 2634021611 ControllerInfoFrame 5000;
BA_ "GenSigTimeoutTime_ECU" SG_ 2634021416 CmdBytePGN65530_PDU 5000;
BA_ "GenSigTimeoutTime_ECU" SG_ 2634021416 ControllerInfoFrame 5000;
BA_ "GenSigTimeoutTime_ECU" SG_ 2634021467 CmdBytePGN65530_POD 5000;
BA_ "GenSigTimeoutTime_ECU" SG_ 2634021467 ControllerInfoFrame 5000;
BA_ "GenSigTimeoutTime_ECU" SG_ 2634021467 GrouSpeeAutoMaxGrouSpdDec 5000;
BA_ "GenSigSendType" SG_ 2634021467 GrouSpeeAutoMaxGrouSpdDec 0;
BA_ "GenSigTimeoutTime_ECU" SG_ 2634021467 GrouSpeeAutoMaxGrouSpdInc 5000;
BA_ "GenSigSendType" SG_ 2634021467 GrouSpeeAutoMaxGrouSpdInc 0;
BA_ "GenSigTimeoutTime_ECU" SG_ 2632974314 CmdBytePGN61184_FED 60000;
BA_ "GenSigTimeoutTime_ECU" SG_ 2632974315 CmdBytePGN61184_HAD 60000;
BA_ "GenSigTimeoutTime_ECU" SG_ 2632974330 CmdBytePGN61184_OBT_FA 60000;
BA_ "GenSigTimeoutTime_ECU" SG_ 2632969194 CmdBytePGN61184_FED 60000;
BA_ "GenSigTimeoutTime_ECU" SG_ 2632932330 CmdBytePGN61184_FED 60000;
BA_ "GenSigTimeoutTime_ECU" SG_ 2632968939 CmdBytePGN61184_HAD 60000;
BA_ "GenSigTimeoutTime_ECU" SG_ 2632932331 CmdBytePGN61184_HAD 60000;
BA_ "GenSigTimeoutTime_ECU" SG_ 2632968954 CmdBytePGN61184_OBT_FA 60000;
BA_ "GenSigTimeoutTime_ECU" SG_ 2632969210 CmdBytePGN61184_OBT_FA 60000;
BA_ "GenSigTimeoutTime_ECU" SG_ 2632932346 CmdBytePGN61184_OBT_FA 60000;
BA_ "GenSigTimeoutTime_ECU" SG_ 2632968795 CmdBytePGN61184_POD 60000;
BA_ "GenSigTimeoutTime_ECU" SG_ 2632969051 CmdBytePGN61184_POD 60000;
BA_ "GenSigTimeoutTime_ECU" SG_ 2499803942 CmdBytePGN65531_VTV 60000;
BA_ "GenSigTimeoutTime_ECU" SG_ 2499803942 HeadRaisLoweEngaContComm 60000;
BA_ "GenSigSendType" SG_ 2499803942 HeadRaisLoweEngaContComm 0;
BA_ "GenSigTimeoutTime_ECU" SG_ 2499803942 LadderAutomationState 60000;
BA_ "GenSigSendType" SG_ 2499803942 LadderAutomationState 0;
BA_ "GenSigTimeoutTime_ECU" SG_ 2499803942 ActiEarSaveLeftActuPosiSetpReq 60000;
BA_ "GenSigSendType" SG_ 2499803942 ActiEarSaveLeftActuPosiSetpReq 0;
BA_ "GenSigTimeoutTime_ECU" SG_ 2499803942 ActiEarSaveRighActuPosiSetpReq 60000;
BA_ "GenSigSendType" SG_ 2499803942 ActiEarSaveRighActuPosiSetpReq 0;
BA_ "GenSigTimeoutTime_ECU" SG_ 2499803942 ActiEarSaveLinkUnliToggReq 60000;
BA_ "GenSigSendType" SG_ 2499803942 ActiEarSaveLinkUnliToggReq 0;
BA_ "GenSigTimeoutTime_ECU" SG_ 2499803942 LeftActiEarSaveEnabFromDisp 60000;
BA_ "GenSigSendType" SG_ 2499803942 LeftActiEarSaveEnabFromDisp 0;
BA_ "GenSigTimeoutTime_ECU" SG_ 2499803942 RighActiEarSaveEnabFromDisp 60000;
BA_ "GenSigSendType" SG_ 2499803942 RighActiEarSaveEnabFromDisp 0;
BA_ "GenSigTimeoutTime_ECU" SG_ 2499803942 MinimumDeckPlateSpacing 60000;
BA_ "GenSigSendType" SG_ 2499803942 MinimumDeckPlateSpacing 0;
BA_ "GenSigTimeoutTime_ECU" SG_ 2499803942 TerrFollAutoEnabStat 60000;
BA_ "GenSigSendType" SG_ 2499803942 TerrFollAutoEnabStat 0;
BA_ "GenSigTimeoutTime_ECU" SG_ 2499803942 TerrFollAutoSens 60000;
BA_ "GenSigSendType" SG_ 2499803942 TerrFollAutoSens 0;
BA_ "GenSigTimeoutTime_ECU" SG_ 2499803942 OpCtrlPreset2 60000;
BA_ "GenSigSendType" SG_ 2499803942 OpCtrlPreset2 0;
BA_ "GenSigTimeoutTime_ECU" SG_ 2499803942 OpCtrlPreset3 60000;
BA_ "GenSigSendType" SG_ 2499803942 OpCtrlPreset3 0;
BA_ "GenSigTimeoutTime_ECU" SG_ 2499803942 FLPFrontAxleToGroundDistance 60000;
BA_ "GenSigSendType" SG_ 2499803942 FLPFrontAxleToGroundDistance 0;
BA_ "GenSigTimeoutTime_ECU" SG_ 2499803942 CutterbarAutoLockConfigRequestBm 60000;
BA_ "GenSigSendType" SG_ 2499803942 CutterbarAutoLockConfigRequestBm 0;
BA_ "GenSigTimeoutTime_ECU" SG_ 2649751345 CmdBytePGN126720_CAB 60000;
BA_ "GenSigTimeoutTime_ECU" SG_ 2649751496 CmdBytePGN126720_DC1 60000;
BA_ "GenSigTimeoutTime_ECU" SG_ 2649751530 CmdBytePGN126720_FED 60000;
BA_ "GenSigTimeoutTime_ECU" SG_ 2649751531 CmdBytePGN126720_HAD 60000;
BA_ "GenSigTimeoutTime_ECU" SG_ 2649751387 CmdBytePGN126720_POD 60000;
BA_ "GenSigTimeoutTime_ECU" SG_ 2649737265 CmdBytePGN126720_CAB 60000;
BA_ "GenSigTimeoutTime_ECU" SG_ 2649745969 CmdBytePGN126720_CAB 60000;
BA_ "GenSigTimeoutTime_ECU" SG_ 2649746225 CmdBytePGN126720_CAB 60000;
BA_ "GenSigTimeoutTime_ECU" SG_ 2649709361 CmdBytePGN126720_CAB 60000;
BA_ "GenSigTimeoutTime_ECU" SG_ 2649698760 CmdBytePGN126720_DC1 60000;
BA_ "GenSigTimeoutTime_ECU" SG_ 2649746120 CmdBytePGN126720_DC1 60000;
BA_ "GenSigTimeoutTime_ECU" SG_ 2649746376 CmdBytePGN126720_DC1 60000;
BA_ "GenSigTimeoutTime_ECU" SG_ 2649709512 CmdBytePGN126720_DC1 60000;
BA_ "GenSigTimeoutTime_ECU" SG_ 2649698794 CmdBytePGN126720_FED 60000;
BA_ "GenSigTimeoutTime_ECU" SG_ 2649737450 CmdBytePGN126720_FED 60000;
BA_ "GenSigTimeoutTime_ECU" SG_ 2649746410 CmdBytePGN126720_FED 60000;
BA_ "GenSigTimeoutTime_ECU" SG_ 2649709546 CmdBytePGN126720_FED 60000;
BA_ "GenSigTimeoutTime_ECU" SG_ 2649698795 CmdBytePGN126720_HAD 60000;
BA_ "GenSigTimeoutTime_ECU" SG_ 2649737451 CmdBytePGN126720_HAD 60000;
BA_ "GenSigTimeoutTime_ECU" SG_ 2649746155 CmdBytePGN126720_HAD 60000;
BA_ "GenSigTimeoutTime_ECU" SG_ 2649709547 CmdBytePGN126720_HAD 60000;
BA_ "GenSigTimeoutTime_ECU" SG_ 2649698651 CmdBytePGN126720_POD 60000;
BA_ "GenSigTimeoutTime_ECU" SG_ 2649737307 CmdBytePGN126720_POD 60000;
BA_ "GenSigTimeoutTime_ECU" SG_ 2649746011 CmdBytePGN126720_POD 60000;
BA_ "GenSigTimeoutTime_ECU" SG_ 2649746267 CmdBytePGN126720_POD 60000;
BA_ "GenSigTimeoutTime_ECU" SG_ 2298477310 CmdBytePGN65530_Vector_XXX 500;
BA_ "GenSigTimeoutTime_ECU" SG_ 2298477310 EventDetectionStatus 500;
BA_ "GenSigSendType" SG_ 2298477310 EventDetectionStatus 0;
BA_ "GenSigTimeoutTime_ECU" SG_ 2565865265 CmdBytePGN61184_CAB 2000;
BA_ "GenSigTimeoutTime_ECU" SG_ 2565865265 PGNRqstProp 2000;
BA_ "GenSigTimeoutTime_ECU" SG_ 2565865265 REQPGNCMDBYTE1 2000;
BA_ "GenSigTimeoutTime_ECU" SG_ 2565865265 PGNRqstProp 2000;
BA_ "GenSigTimeoutTime_ECU" SG_ 2565865265 REQPGNCMDBYTE1 2000;
BA_ "GenSigTimeoutTime_ECU" SG_ 2565865265 REQPGNCMDBYTE2 2000;
BA_ "GenSigTimeoutTime_ECU" SG_ 2565865265 OpCtrlA1CmdByte3BitPair12 2000;
BA_ "GenSigSendType" SG_ 2565865265 OpCtrlA1CmdByte3BitPair12 0;
BA_ "GenSigTimeoutTime_ECU" SG_ 2565865265 OpCtrlA1CmdByte3BitPair56 2000;
BA_ "GenSigSendType" SG_ 2565865265 OpCtrlA1CmdByte3BitPair56 0;
BA_ "GenSigTimeoutTime_ECU" SG_ 2565865265 OpCtrlA1CmdByte4BitPair12 2000;
BA_ "GenSigSendType" SG_ 2565865265 OpCtrlA1CmdByte4BitPair12 0;
BA_ "GenSigTimeoutTime_ECU" SG_ 2565865265 OpCtrlA1CmdByte4BitPair34 2000;
BA_ "GenSigSendType" SG_ 2565865265 OpCtrlA1CmdByte4BitPair34 0;
BA_ "GenSigTimeoutTime_ECU" SG_ 2565865265 OpCtrlA1CmdByte4BitPair56 2000;
BA_ "GenSigSendType" SG_ 2565865265 OpCtrlA1CmdByte4BitPair56 0;
BA_ "GenSigTimeoutTime_ECU" SG_ 2565865265 OpCtrlA1CmdByte4BitPair78 2000;
BA_ "GenSigSendType" SG_ 2565865265 OpCtrlA1CmdByte4BitPair78 0;
BA_ "GenSigTimeoutTime_ECU" SG_ 2565865265 OpCtrlA1CmdByte5BitPair12 2000;
BA_ "GenSigSendType" SG_ 2565865265 OpCtrlA1CmdByte5BitPair12 0;
BA_ "GenSigTimeoutTime_ECU" SG_ 2565865265 OpCtrlA1CmdByte5BitPair34 2000;
BA_ "GenSigSendType" SG_ 2565865265 OpCtrlA1CmdByte5BitPair34 0;
BA_ "GenSigTimeoutTime_ECU" SG_ 2565865265 OpCtrlA1CmdByte5BitPair78 2000;
BA_ "GenSigSendType" SG_ 2565865265 OpCtrlA1CmdByte5BitPair78 0;
BA_ "GenSigTimeoutTime_ECU" SG_ 2565865265 OpCtrlA1CmdByte6BitPair12 2000;
BA_ "GenSigSendType" SG_ 2565865265 OpCtrlA1CmdByte6BitPair12 0;
BA_ "GenSigTimeoutTime_ECU" SG_ 2565865265 OpCtrlB2CmdByte3BitQuad14 2000;
BA_ "GenSigSendType" SG_ 2565865265 OpCtrlB2CmdByte3BitQuad14 0;
BA_ "GenSigTimeoutTime_ECU" SG_ 2565865265 OpCtrlB2CmdByte4BitQuad14 2000;
BA_ "GenSigSendType" SG_ 2565865265 OpCtrlB2CmdByte4BitQuad14 0;
BA_ "GenSigTimeoutTime_ECU" SG_ 2565865265 OpCtrlB2CmdByte4BitQuad58 2000;
BA_ "GenSigSendType" SG_ 2565865265 OpCtrlB2CmdByte4BitQuad58 0;
BA_ "GenSigTimeoutTime_ECU" SG_ 2565865265 OpCtrlB2CmdByte5BitQuad14 2000;
BA_ "GenSigSendType" SG_ 2565865265 OpCtrlB2CmdByte5BitQuad14 0;
BA_ "GenSigTimeoutTime_ECU" SG_ 2565865265 OpCtrlB2CmdByte5BitQuad58 2000;
BA_ "GenSigSendType" SG_ 2565865265 OpCtrlB2CmdByte5BitQuad58 0;
BA_ "GenSigTimeoutTime_ECU" SG_ 2565865265 OpCtrlB2CmdByte8BitQuad14 2000;
BA_ "GenSigSendType" SG_ 2565865265 OpCtrlB2CmdByte8BitQuad14 0;
BA_ "GenSigTimeoutTime_ECU" SG_ 2565865265 OpCtrlB2CmdByte8BitQuad58 2000;
BA_ "GenSigSendType" SG_ 2565865265 OpCtrlB2CmdByte8BitQuad58 0;
BA_ "GenSigTimeoutTime_ECU" SG_ 2565865265 OpCtrlB3CmdByte3BitQuad14 2000;
BA_ "GenSigSendType" SG_ 2565865265 OpCtrlB3CmdByte3BitQuad14 0;
BA_ "GenSigTimeoutTime_ECU" SG_ 2565865265 OpCtrlB3CmdByte3BitQuad58 2000;
BA_ "GenSigSendType" SG_ 2565865265 OpCtrlB3CmdByte3BitQuad58 0;
BA_ "GenSigTimeoutTime_ECU" SG_ 2565865265 OpCtrlB3CmdByte4BitQuad14 2000;
BA_ "GenSigSendType" SG_ 2565865265 OpCtrlB3CmdByte4BitQuad14 0;
BA_ "GenSigTimeoutTime_ECU" SG_ 2565865265 OpCtrlB3CmdByte4BitQuad58 2000;
BA_ "GenSigSendType" SG_ 2565865265 OpCtrlB3CmdByte4BitQuad58 0;
BA_ "GenSigTimeoutTime_ECU" SG_ 2565865265 OpCtrlB3CmdByte5BitQuad14 2000;
BA_ "GenSigSendType" SG_ 2565865265 OpCtrlB3CmdByte5BitQuad14 0;
BA_ "GenSigTimeoutTime_ECU" SG_ 2565865265 OpCtrlB3CmdByte6BitQuad14 2000;
BA_ "GenSigSendType" SG_ 2565865265 OpCtrlB3CmdByte6BitQuad14 0;
BA_ "GenSigTimeoutTime_ECU" SG_ 2565865265 OpCtrlB3CmdByte6BitQuad58 2000;
BA_ "GenSigSendType" SG_ 2565865265 OpCtrlB3CmdByte6BitQuad58 0;
BA_ "GenSigTimeoutTime_ECU" SG_ 2565865265 OpCtrlB3CmdByte7BitQuad14 2000;
BA_ "GenSigSendType" SG_ 2565865265 OpCtrlB3CmdByte7BitQuad14 0;
BA_ "GenSigTimeoutTime_ECU" SG_ 2565865265 OpCtrlB3CmdByte7BitQuad58 2000;
BA_ "GenSigSendType" SG_ 2565865265 OpCtrlB3CmdByte7BitQuad58 0;
BA_ "GenSigTimeoutTime_ECU" SG_ 2565865265 OpCtrlB3CmdByte8BitQuad14 2000;
BA_ "GenSigSendType" SG_ 2565865265 OpCtrlB3CmdByte8BitQuad14 0;
BA_ "GenSigTimeoutTime_ECU" SG_ 2565865265 OpCtrlB3CmdByte8BitQuad58 2000;
BA_ "GenSigSendType" SG_ 2565865265 OpCtrlB3CmdByte8BitQuad58 0;
BA_ "GenSigTimeoutTime_ECU" SG_ 2565865265 EngineDesiredOperatingState 2000;
BA_ "GenSigSendType" SG_ 2565865265 EngineDesiredOperatingState 0;
BA_ "GenSigTimeoutTime_ECU" SG_ 2565865265 EngStartCtrl 2000;
BA_ "GenSigSendType" SG_ 2565865265 EngStartCtrl 0;
BA_ "GenSigTimeoutTime_ECU" SG_ 2565865265 EngStarterStatus 2000;
BA_ "GenSigSendType" SG_ 2565865265 EngStarterStatus 0;
BA_ "GenSigTimeoutTime_ECU" SG_ 2565865265 OpCtrlB5CmdByte4BitQuad58 2000;
BA_ "GenSigSendType" SG_ 2565865265 OpCtrlB5CmdByte4BitQuad58 0;
BA_ "GenSigTimeoutTime_ECU" SG_ 2565865265 OpCtrlB5CmdByte5BitQuad14 2000;
BA_ "GenSigSendType" SG_ 2565865265 OpCtrlB5CmdByte5BitQuad14 0;
BA_ "GenSigTimeoutTime_ECU" SG_ 2565865265 OpCtrlB5CmdByte5BitQuad58 2000;
BA_ "GenSigSendType" SG_ 2565865265 OpCtrlB5CmdByte5BitQuad58 0;
BA_ "GenSigTimeoutTime_ECU" SG_ 2565865265 OpCtrlB5CmdByte6BitQuad14 2000;
BA_ "GenSigSendType" SG_ 2565865265 OpCtrlB5CmdByte6BitQuad14 0;
BA_ "GenSigTimeoutTime_ECU" SG_ 2565865265 OpCtrlB5CmdByte6BitQuad58 2000;
BA_ "GenSigSendType" SG_ 2565865265 OpCtrlB5CmdByte6BitQuad58 0;
BA_ "GenSigTimeoutTime_ECU" SG_ 2565865265 OpCtrlB5CmdByte7BitQuad14 2000;
BA_ "GenSigSendType" SG_ 2565865265 OpCtrlB5CmdByte7BitQuad14 0;
BA_ "GenSigTimeoutTime_ECU" SG_ 2565865265 OpCtrlB5CmdByte7BitQuad58 2000;
BA_ "GenSigSendType" SG_ 2565865265 OpCtrlB5CmdByte7BitQuad58 0;
BA_ "GenSigTimeoutTime_ECU" SG_ 2565865265 OpCtrlB5CmdByte8BitQuad14 2000;
BA_ "GenSigSendType" SG_ 2565865265 OpCtrlB5CmdByte8BitQuad14 0;
BA_ "GenSigTimeoutTime_ECU" SG_ 2565865265 OpCtrlB5CmdByte8BitQuad58 2000;
BA_ "GenSigSendType" SG_ 2565865265 OpCtrlB5CmdByte8BitQuad58 0;
BA_ "GenSigTimeoutTime_ECU" SG_ 2565865265 OpCtrlB6CmdByte3BitQuad14 2000;
BA_ "GenSigSendType" SG_ 2565865265 OpCtrlB6CmdByte3BitQuad14 0;
BA_ "GenSigTimeoutTime_ECU" SG_ 2565865265 BrakeLightsCommand 2000;
BA_ "GenSigSendType" SG_ 2565865265 BrakeLightsCommand 0;
BA_ "GenSigTimeoutTime_ECU" SG_ 2565865265 BeaconLightsCommand 2000;
BA_ "GenSigSendType" SG_ 2565865265 BeaconLightsCommand 0;
BA_ "GenSigTimeoutTime_ECU" SG_ 2565865265 LeftMarkerLightsCommand 2000;
BA_ "GenSigSendType" SG_ 2565865265 LeftMarkerLightsCommand 0;
BA_ "GenSigTimeoutTime_ECU" SG_ 2565865265 LeftFlasherLightsCommand 2000;
BA_ "GenSigSendType" SG_ 2565865265 LeftFlasherLightsCommand 0;
BA_ "GenSigTimeoutTime_ECU" SG_ 2565865265 RightFlasherLightsCommand 2000;
BA_ "GenSigSendType" SG_ 2565865265 RightFlasherLightsCommand 0;
BA_ "GenSigTimeoutTime_ECU" SG_ 2565865265 FlasherLightsFlashRate 2000;
BA_ "GenSigSendType" SG_ 2565865265 FlasherLightsFlashRate 0;
BA_ "GenSigTimeoutTime_ECU" SG_ 2565865265 FlasherLightsPriority 2000;
BA_ "GenSigSendType" SG_ 2565865265 FlasherLightsPriority 0;
BA_ "GenSigTimeoutTime_ECU" SG_ 2565865265 SyncSignal1 2000;
BA_ "GenSigSendType" SG_ 2565865265 SyncSignal1 0;
BA_ "GenSigTimeoutTime_ECU" SG_ 2565865265 GlobalTimer 2000;
BA_ "GenSigSendType" SG_ 2565865265 GlobalTimer 0;
BA_ "GenSigTimeoutTime_ECU" SG_ 2565865265 CANField1VehSpcFrontLight1 2000;
BA_ "GenSigSendType" SG_ 2565865265 CANField1VehSpcFrontLight1 0;
BA_ "GenSigTimeoutTime_ECU" SG_ 2565865265 CANField1VehSpcSideLight1 2000;
BA_ "GenSigSendType" SG_ 2565865265 CANField1VehSpcSideLight1 0;
BA_ "GenSigTimeoutTime_ECU" SG_ 2565865265 CANField1VehSpcRearLight1 2000;
BA_ "GenSigSendType" SG_ 2565865265 CANField1VehSpcRearLight1 0;
BA_ "GenSigTimeoutTime_ECU" SG_ 2565865265 CANField2VehSpcFrontLight1 2000;
BA_ "GenSigSendType" SG_ 2565865265 CANField2VehSpcFrontLight1 0;
BA_ "GenSigTimeoutTime_ECU" SG_ 2565865265 CANField2VehSpcSideLight1 2000;
BA_ "GenSigSendType" SG_ 2565865265 CANField2VehSpcSideLight1 0;
BA_ "GenSigTimeoutTime_ECU" SG_ 2565865265 CANField2VehSpcRearLight1 2000;
BA_ "GenSigSendType" SG_ 2565865265 CANField2VehSpcRearLight1 0;
BA_ "GenSigTimeoutTime_ECU" SG_ 2565865265 CANEgressVehSpcFrontLight1 2000;
BA_ "GenSigSendType" SG_ 2565865265 CANEgressVehSpcFrontLight1 0;
BA_ "GenSigTimeoutTime_ECU" SG_ 2565865265 CANEgressVehSpcSideLight1 2000;
BA_ "GenSigSendType" SG_ 2565865265 CANEgressVehSpcSideLight1 0;
BA_ "GenSigTimeoutTime_ECU" SG_ 2565865265 CANEgressVehSpcRearLight1 2000;
BA_ "GenSigSendType" SG_ 2565865265 CANEgressVehSpcRearLight1 0;
BA_ "GenMsgCycleTime" BO_ 2566912550 5000;
BA_ "GenMsgSendType" BO_ 2566912550 0;
BA_ "GenMsgCycleTimeFast" BO_ 2566912550 5000;
BA_ "SingleFrame" BO_ 2566912550 1;
BA_ "GenMsgCycleTime" BO_ 2499803686 1000;
BA_ "GenMsgSendType" BO_ 2499803686 0;
BA_ "GenMsgCycleTimeFast" BO_ 2499803686 100;
BA_ "SingleFrame" BO_ 2499803686 1;
BA_ "GenMsgCycleTime" BO_ 2365585958 200;
BA_ "GenMsgSendType" BO_ 2365585958 0;
BA_ "GenMsgCycleTimeFast" BO_ 2365585958 200;
BA_ "SingleFrame" BO_ 2365585958 1;
BA_ "GenMsgCycleTime" BO_ 2499804158 1000;
BA_ "GenMsgSendType" BO_ 2499804158 0;
BA_ "GenMsgCycleTimeFast" BO_ 2499804158 1000;
BA_ "SingleFrame" BO_ 2499804158 1;
BA_ "GenMsgCycleTime" BO_ 2566913574 1000;
BA_ "GenMsgSendType" BO_ 2566913574 0;
BA_ "GenMsgCycleTimeFast" BO_ 2566913574 1000;
BA_ "SingleFrame" BO_ 2566913574 1;
BA_ "GenMsgCycleTime" BO_ 2566911230 100;
BA_ "GenMsgSendType" BO_ 2566911230 0;
BA_ "GenMsgCycleTimeFast" BO_ 2566911230 100;
BA_ "SingleFrame" BO_ 2566911230 1;
BA_ "GenMsgCycleTime" BO_ 2566912603 5000;
BA_ "GenMsgSendType" BO_ 2566912603 0;
BA_ "GenMsgCycleTimeFast" BO_ 2566912603 250;
BA_ "SingleFrame" BO_ 2566912603 1;
BA_ "GenMsgCycleTime" BO_ 2566913585 1000;
BA_ "GenMsgSendType" BO_ 2566913585 0;
BA_ "GenMsgCycleTimeFast" BO_ 2566913585 1000;
BA_ "SingleFrame" BO_ 2566913585 1;
BA_ "GenMsgCycleTime" BO_ 2565864446 5000;
BA_ "GenMsgSendType" BO_ 2565864446 0;
BA_ "GenMsgCycleTimeFast" BO_ 2565864446 5000;
BA_ "SingleFrame" BO_ 2565864446 1;
BA_ "GenMsgCycleTime" BO_ 2565865470 5000;
BA_ "GenMsgSendType" BO_ 2565865470 0;
BA_ "GenMsgCycleTimeFast" BO_ 2565865470 5000;
BA_ "SingleFrame" BO_ 2565865470 1;
BA_ "GenMsgCycleTime" BO_ 2365584177 40;
BA_ "GenMsgSendType" BO_ 2365584177 0;
BA_ "GenMsgCycleTimeFast" BO_ 2365584177 40;
BA_ "SingleFrame" BO_ 2365584177 1;
BA_ "GenMsgCycleTime" BO_ 2566913770 60000;
BA_ "SingleFrame" BO_ 2566913770 1;
BA_ "GenMsgCycleTime" BO_ 2566913771 60000;
BA_ "SingleFrame" BO_ 2566913771 1;
BA_ "GenMsgCycleTime" BO_ 2566913627 60000;
BA_ "SingleFrame" BO_ 2566913627 1;
BA_ "GenMsgCycleTime" BO_ 2566912200 60000;
BA_ "SingleFrame" BO_ 2566912200 1;
BA_ "GenMsgCycleTime" BO_ 2566912234 60000;
BA_ "SingleFrame" BO_ 2566912234 1;
BA_ "GenMsgCycleTime" BO_ 2566912235 60000;
BA_ "SingleFrame" BO_ 2566912235 1;
BA_ "GenMsgCycleTime" BO_ 2566912091 60000;
BA_ "SingleFrame" BO_ 2566912091 1;
BA_ "GenMsgCycleTime" BO_ 2498756586 1000;
BA_ "GenMsgSendType" BO_ 2498756586 0;
BA_ "GenMsgCycleTimeFast" BO_ 2498756586 100;
BA_ "SingleFrame" BO_ 2498756586 1;
BA_ "GenMsgCycleTime" BO_ 2498756587 1000;
BA_ "GenMsgSendType" BO_ 2498756587 0;
BA_ "GenMsgCycleTimeFast" BO_ 2498756587 100;
BA_ "SingleFrame" BO_ 2498756587 1;
BA_ "GenMsgCycleTime" BO_ 2498756443 1000;
BA_ "GenMsgSendType" BO_ 2498756443 0;
BA_ "GenMsgCycleTimeFast" BO_ 2498756443 100;
BA_ "SingleFrame" BO_ 2498756443 1;
BA_ "GenMsgCycleTime" BO_ 2632974171 60000;
BA_ "SingleFrame" BO_ 2632974171 1;
BA_ "GenMsgCycleTime" BO_ 2634021610 1000;
BA_ "SingleFrame" BO_ 2634021610 1;
BA_ "GenMsgCycleTime" BO_ 2634021611 1000;
BA_ "SingleFrame" BO_ 2634021611 1;
BA_ "GenMsgCycleTime" BO_ 2634021416 1000;
BA_ "SingleFrame" BO_ 2634021416 1;
BA_ "GenMsgCycleTime" BO_ 2634021467 1000;
BA_ "SingleFrame" BO_ 2634021467 1;
BA_ "GenMsgCycleTime" BO_ 2632974314 60000;
BA_ "SingleFrame" BO_ 2632974314 1;
BA_ "GenMsgCycleTime" BO_ 2632974315 60000;
BA_ "SingleFrame" BO_ 2632974315 1;
BA_ "GenMsgCycleTime" BO_ 2632974330 60000;
BA_ "SingleFrame" BO_ 2632974330 1;
BA_ "GenMsgCycleTime" BO_ 2632969194 60000;
BA_ "SingleFrame" BO_ 2632969194 1;
BA_ "GenMsgCycleTime" BO_ 2632932330 60000;
BA_ "SingleFrame" BO_ 2632932330 1;
BA_ "GenMsgCycleTime" BO_ 2632968939 60000;
BA_ "SingleFrame" BO_ 2632968939 1;
BA_ "GenMsgCycleTime" BO_ 2632932331 60000;
BA_ "SingleFrame" BO_ 2632932331 1;
BA_ "GenMsgCycleTime" BO_ 2632968954 60000;
BA_ "SingleFrame" BO_ 2632968954 1;
BA_ "GenMsgCycleTime" BO_ 2632969210 60000;
BA_ "SingleFrame" BO_ 2632969210 1;
BA_ "GenMsgCycleTime" BO_ 2632932346 60000;
BA_ "SingleFrame" BO_ 2632932346 1;
BA_ "GenMsgCycleTime" BO_ 2632968795 60000;
BA_ "SingleFrame" BO_ 2632968795 1;
BA_ "GenMsgCycleTime" BO_ 2632969051 60000;
BA_ "SingleFrame" BO_ 2632969051 1;
BA_ "GenMsgCycleTime" BO_ 2499803942 60000;
BA_ "GenMsgSendType" BO_ 2499803942 0;
BA_ "GenMsgCycleTimeFast" BO_ 2499803942 40;
BA_ "SingleFrame" BO_ 2499803942 1;
BA_ "GenMsgCycleTime" BO_ 2649751345 60000;
BA_ "SingleFrame" BO_ 2649751345 1;
BA_ "GenMsgCycleTime" BO_ 2649751496 60000;
BA_ "SingleFrame" BO_ 2649751496 1;
BA_ "GenMsgCycleTime" BO_ 2649751530 60000;
BA_ "SingleFrame" BO_ 2649751530 1;
BA_ "GenMsgCycleTime" BO_ 2649751531 60000;
BA_ "SingleFrame" BO_ 2649751531 1;
BA_ "GenMsgCycleTime" BO_ 2649751387 60000;
BA_ "SingleFrame" BO_ 2649751387 1;
BA_ "GenMsgCycleTime" BO_ 2649737265 60000;
BA_ "SingleFrame" BO_ 2649737265 1;
BA_ "GenMsgCycleTime" BO_ 2649745969 60000;
BA_ "SingleFrame" BO_ 2649745969 1;
BA_ "GenMsgCycleTime" BO_ 2649746225 60000;
BA_ "SingleFrame" BO_ 2649746225 1;
BA_ "GenMsgCycleTime" BO_ 2649709361 60000;
BA_ "SingleFrame" BO_ 2649709361 1;
BA_ "GenMsgCycleTime" BO_ 2649698760 60000;
BA_ "SingleFrame" BO_ 2649698760 1;
BA_ "GenMsgCycleTime" BO_ 2649746120 60000;
BA_ "SingleFrame" BO_ 2649746120 1;
BA_ "GenMsgCycleTime" BO_ 2649746376 60000;
BA_ "SingleFrame" BO_ 2649746376 1;
BA_ "GenMsgCycleTime" BO_ 2649709512 60000;
BA_ "SingleFrame" BO_ 2649709512 1;
BA_ "GenMsgCycleTime" BO_ 2649698794 60000;
BA_ "SingleFrame" BO_ 2649698794 1;
BA_ "GenMsgCycleTime" BO_ 2649737450 60000;
BA_ "SingleFrame" BO_ 2649737450 1;
BA_ "GenMsgCycleTime" BO_ 2649746410 60000;
BA_ "SingleFrame" BO_ 2649746410 1;
BA_ "GenMsgCycleTime" BO_ 2649709546 60000;
BA_ "SingleFrame" BO_ 2649709546 1;
BA_ "GenMsgCycleTime" BO_ 2649698795 60000;
BA_ "SingleFrame" BO_ 2649698795 1;
BA_ "GenMsgCycleTime" BO_ 2649737451 60000;
BA_ "SingleFrame" BO_ 2649737451 1;
BA_ "GenMsgCycleTime" BO_ 2649746155 60000;
BA_ "SingleFrame" BO_ 2649746155 1;
BA_ "GenMsgCycleTime" BO_ 2649709547 60000;
BA_ "SingleFrame" BO_ 2649709547 1;
BA_ "GenMsgCycleTime" BO_ 2649698651 60000;
BA_ "SingleFrame" BO_ 2649698651 1;
BA_ "GenMsgCycleTime" BO_ 2649737307 60000;
BA_ "SingleFrame" BO_ 2649737307 1;
BA_ "GenMsgCycleTime" BO_ 2649746011 60000;
BA_ "SingleFrame" BO_ 2649746011 1;
BA_ "GenMsgCycleTime" BO_ 2649746267 60000;
BA_ "SingleFrame" BO_ 2649746267 1;
BA_ "GenMsgCycleTime" BO_ 2298477310 51;
BA_ "GenMsgSendType" BO_ 2298477310 0;
BA_ "GenMsgCycleTimeFast" BO_ 2298477310 100;
BA_ "SingleFrame" BO_ 2298477310 1;
BA_ "GenMsgCycleTime" BO_ 2565865265 400;
BA_ "GenMsgSendType" BO_ 2565865265 0;
BA_ "GenMsgCycleTimeFast" BO_ 2565865265 400;
BA_ "SingleFrame" BO_ 2565865265 1;
VAL_ 2566912550 CmdBytePGN65530_VTV 21249 "AutoDeckPlateParameters2 " 9216 "AutoUnloadOutputsToVehicle " 23040 "GrainAreaLoss " 25600 "GrainPercentLoss " 263 "HarvestSmartMessage2 " 519 "HarvestSmartMessage3 " 775 "HarvestSmartMessage4 " 1031 "HarvestSmartMessage5 " 1287 "HarvestSmartMessage6 " 35586 "SetpointInfoAckResonseHarvesterSetpointAdjust " ;
VAL_ 2566912550 AutoUnloadAugerEngmtCmd 0 " En_AutoUnldRqst_Inactive" 1 " En_AutoUnldRqst_OffNormal" 2 " En_AutoUnldRqst_OffSpill" 3 " En_AutoUnldRqst_On" 14 " En_AutoUnldRqst_Error" 15 " En_AutoUnldRqst_NotAvailable" ;
VAL_ 2566912550 HdrAutomationFeaturesReset 0 " Default" 1 " Custom" 2 " Invalid" 14 " Error" 31 " NotAvailable" ;
VAL_ 2566912550 HarvSetpInfoAckRespB1 0 " DEM_None" 1 " DEM_Absolute" 2 " DEM_offset" 14 " DEM_Error" 15 " DEM_Not_available_not_installed" ;
VAL_ 2499803686 CmdBytePGN65530_VTV 21761 "AutoDeckPlateSensorAndDisplayCommand " 4359 "FlexWingFloatSystemDisplayInteractions " 32771 "GrainQualityAndLossFiltered " 33539 "GrainQualityAndLossOptions " 33283 "GrainQualityAndLossUserDefined " 4871 "GSAPredictionSourceRMSEvalues1 " 5127 "GSAPredictionSourceRMSEvalues2 " 5383 "GSASettingsAndStatus " 5639 "MapBasedFarmingStatus " 33027 "MassFlowFiltered " ;
VAL_ 2499803686 HdrGndSetg 0 " En_HdrGndSetg_VerySoft" 1 " En_HdrGndSetg_Soft" 2 " En_HdrGndSetg_Typical" 3 " En_HdrGndSetg_Firm" 4 " En_HdrGndSetg_VeryFirm" 14 " En_HdrGndSetg_Error" 15 " En_HdrGndSetg_NotAvailable" ;
VAL_ 2499803686 FlexWingTunRatRstToDft 0 " En_OnOff2States_Off" 1 " En_OnOff2States_On" 2 " En_OnOff2States_Error" 3 " En_OnOff2States_NotAvailable" ;
VAL_ 2499803686 GSAActivePredictionSource 1 " Constant Prediction" 2 " FLP Prediction" 3 " MBF Prediction" 4 " Fused Prediction" 6 " Coverage Map Prediction" ;
VAL_ 2499803686 GSAActiveControlMode 0 " Engine Power Control" 1 " Throughput Power Control" 2 " Velocity Control" ;
VAL_ 2499803686 GSAActiveUnloadingOnTheGoMode 0 " Static With Slow Down" 1 " Dynamic" 2 " Static Speed Set" ;
VAL_ 2499803686 GSATerrainCompensationEnabled 0 " Disabled" 1 " On" ;
VAL_ 2499803686 GSADownCropEnabled 0 " Off" 1 " On" ;
VAL_ 2499803686 GSADownCropSensitivity 1 " 80% Threshold" 2 " 70% Threshold" 3 " 60% Threshold" 4 " 50% Threshold" 5 " 40% Threshold" 6 " 30% Threshold" 7 " 20% Threshold" ;
VAL_ 2499803686 GSACropState 0 " Invalid" 1 " Down" 2 " Standing" 3 " Stubble" 4 " Unclassified" ;
VAL_ 2499803686 MBFHealthStatus 0 " Okay" 1 " Fail" 2 " OK Collecting Data" ;
VAL_ 2499803686 AutoDeckPlateToggleRequest 0 " Off" 1 " On" 2 " Error" 3 " Not Available" ;
VAL_ 2499803686 AutoDeckPlateTightnessLevel 1 " Level1" 2 " Level2" 3 " Level3" 4 " Level4" 5 " Level5" 14 " Error" 15 " NotAvailable" ;
VAL_ 2499803686 SlipClutchDetectionToggleRequest 0 " Off" 1 " On" 254 " Error" 255 " Not Available" ;
VAL_ 2499803686 GrainLossDispOpt 0 " Time Based algorithm" 1 " Speed Based algorithm" 2 " Massflow Based algorithm" 3 " Relative" 4 " Percentage" 5 " Bu per ac" ;
VAL_ 2365585958 CmdBytePGN65530_VTV 17665 "AutomationLimitingFactors " 8224 "Vehicle_Leveling_Roll " ;
VAL_ 2365585958 GSALimitingFactor 0 " Not Limited" 1 " Unloading on the Go Limited" 2 " Engine Power Constrained" 3 " Grain Loss Constrained" 4 " Max Ground Speed Limited" 5 " Down Crop Max Speed Limited" 6 " Engine Power Limited" 7 " Grain Loss Limited" 8 " Terrain Limited" 9 " System Paused Limited" 10 " Transmission Max Speed Limited" 11 " Sharp Terrain Limited" 14 " Error" 15 " Not Available" ;
VAL_ 2499804158 CmdBytePGN65531_Vector_XXX 3579 "AutomationUtilization " 9715 "CropProcessingPowerCommands " 9459 "CropProcessingPowerStatus " 7675 "CropProcessingPowerTargets " 249 "GSAData " 29696 "HeaderToDisplay_#1 " 29952 "HeaderToDisplay_#2 " 30208 "HeaderToDisplay_#3 " 1571 "ReelAutomationStatus " ;
VAL_ 2499804158 GSAStatus 0 " DISABLED" 1 " READY" 2 " CONTROLLING" 3 " REJECTED" 4 " CONTROLLING_BUT_OVERRIDING" 5 " FAULTED" 6 " WAIT_FOR_ACK" 254 " Error" 255 " NotAvailable" ;
VAL_ 2499804158 HSAUtilization 0 " Unsupported Hardware" 1 " Unsupported Software" 2 " Unsupported Crop Type" 3 " Disabled" 4 " Ready not Harvesting" 5 " Ready not Steady State" 6 " Controlling" 14 " Error" 15 " Not Available or Not Installed" ;
VAL_ 2499804158 GSAUtilization 0 " Unsupported Hardware" 1 " Unsupported Software" 2 " Unsupported Crop Type" 3 " Disabled" 4 " Ready not Harvesting" 5 " Ready not Steady State" 6 " Controlling" 14 " Error" 15 " Not Available or Not Installed" ;
VAL_ 2499804158 TSAUtilization 0 " Unsupported Hardware" 1 " Unsupported Software" 2 " Unsupported Crop Type" 3 " Disabled" 4 " Ready not Harvesting" 5 " Ready not Steady State" 6 " Controlling" 14 " Error" 15 " Not Available or Not Installed" ;
VAL_ 2499804158 ReelAutomationUtilization 0 " Unsupported Hardware" 1 " Unsupported Software" 2 " Unsupported Crop Type" 3 " Disabled" 4 " Ready not Harvesting" 5 " Ready not Steady State" 6 " Controlling" 14 " Error" 15 " Not Available or Not Installed" ;
VAL_ 2499804158 DownCropReelAutoUtil 0 " Unsupported Hardware" 1 " Unsupported Software" 2 " Unsupported Crop Type" 3 " Disabled" 4 " Ready not Harvesting" 5 " Ready not Steady State" 6 " Controlling" 14 " Error" 15 " Not Available or Not Installed" ;
VAL_ 2499804158 TerrFollAutoUtil 0 " Unsupported Hardware" 1 " Unsupported Software" 2 " Unsupported Crop Type" 3 " Disabled" 4 " Ready not Harvesting" 5 " Ready not Steady State" 6 " Controlling" 14 " Error" 15 " Not Available or Not Installed" ;
VAL_ 2499804158 CropProcPoweInteStat 0 " Not Accepting Target" 1 " Receiving and Using Target" 2 " Receiving but not Using Target" 14 " Error" 15 " Not Available" ;
VAL_ 2499804158 CropProcPoweInteCommStat 0 " Disabled" 1 " Controlling" 14 " Error" 15 " Not Available" ;
VAL_ 2499804158 ActiEarSaveMoveInteAchi 0 " En_ExternalInterfaceBoolean_False" 1 " En_ExternalInterfaceBoolean_True" 2 " En_ExternalInterfaceBoolean_Error" 3 " En_ExternalInterfaceBoolean_NotAvailable" ;
VAL_ 2499804158 ActiveEarSaversLeftActuatorValid 0 " En_ExternalInterfaceBoolean_False" 1 " En_ExternalInterfaceBoolean_True" 2 " En_ExternalInterfaceBoolean_Error" 3 " En_ExternalInterfaceBoolean_NotAvailable" ;
VAL_ 2499804158 ActiEarSaveRighActuVali 0 " En_ExternalInterfaceBoolean_False" 1 " En_ExternalInterfaceBoolean_True" 2 " En_ExternalInterfaceBoolean_Error" 3 " En_ExternalInterfaceBoolean_NotAvailable" ;
VAL_ 2499804158 ActiEarSaveLinkUnliEnabStat 0 " En_OnOff2States_Off" 1 " En_OnOff2States_On" 2 " En_OnOff2States_Error" 3 " En_OnOff2States_NotAvailable" ;
VAL_ 2499804158 ActiveEarSaversOptionInstalled 0 " En_ExternalInterfaceBoolean_False" 1 " En_ExternalInterfaceBoolean_True" 2 " En_ExternalInterfaceBoolean_Error" 3 " En_ExternalInterfaceBoolean_NotAvailable" ;
VAL_ 2499804158 ActiEarSaveHighCurrDete 0 " En_ExternalInterfaceBoolean_False" 1 " En_ExternalInterfaceBoolean_True" 2 " En_ExternalInterfaceBoolean_Error" 3 " En_ExternalInterfaceBoolean_NotAvailable" ;
VAL_ 2499804158 LeftActiveEarSaversEnabled 0 " En_ExternalInterfaceBoolean_False" 1 " En_ExternalInterfaceBoolean_True" 2 " En_ExternalInterfaceBoolean_Error" 3 " En_ExternalInterfaceBoolean_NotAvailable" ;
VAL_ 2499804158 RightActiveEarSaversEnabled 0 " En_ExternalInterfaceBoolean_False" 1 " En_ExternalInterfaceBoolean_True" 2 " En_ExternalInterfaceBoolean_Error" 3 " En_ExternalInterfaceBoolean_NotAvailable" ;
VAL_ 2499804158 WingFoldUnfoldCmdActive 0 " En_ExternalInterfaceBoolean_False" 1 " En_ExternalInterfaceBoolean_True" 2 " En_ExternalInterfaceBoolean_Error" 3 " En_ExternalInterfaceBoolean_NotAvailable" ;
VAL_ 2499804158 TerrFollAutoToggComm 0 " Off" 1 " On" 2 " Error" 3 " NotAvailable" ;
VAL_ 2499804158 TerrainFollowingAutomationMode 0 " Disabled" 1 " Enabled" 2 " FeatureHide" 3 " FeatureError" 14 " Error" 15 " NotAvailable" ;
VAL_ 2499804158 ReelExtendRetractSensorStatus 0 " En_SensorStatus_InRange" 1 " En_SensorStatus_OutOfRangeLow" 2 " En_SensorStatus_OutOfRangeHigh" 3 " En_SensorStatus_OutOfUsableRangeLow" 4 " En_SensorStatus_OutOfUsableRangeHigh" 5 " En_SensorStatus_OutOfCalibratedRangeLow" 6 " En_SensorStatus_OutOfCalibratedRangeHigh" 7 " En_SensorStatus_SensorReferenceFault" 14 " En_SensorStatus_Error" 15 " En_SensorStatus_NotAvailable" ;
VAL_ 2499804158 ReelRaiseLowerSensorStatus 0 " En_SensorStatus_InRange" 1 " En_SensorStatus_OutOfRangeLow" 2 " En_SensorStatus_OutOfRangeHigh" 3 " En_SensorStatus_OutOfUsableRangeLow" 4 " En_SensorStatus_OutOfUsableRangeHigh" 5 " En_SensorStatus_OutOfCalibratedRangeLow" 6 " En_SensorStatus_OutOfCalibratedRangeHigh" 7 " En_SensorStatus_SensorReferenceFault" 14 " En_SensorStatus_Error" 15 " En_SensorStatus_NotAvailable" ;
VAL_ 2499804158 ReelPositionResumeEnabled 0 " En_OnOff2States_Off" 1 " En_OnOff2States_On" 2 " En_OnOff2States_Error" 3 " En_OnOff2States_NotAvailable" ;
VAL_ 2499804158 HeaderWeightCalEnabled 0 " En_ExternalInterfaceBoolean_False" 1 " En_ExternalInterfaceBoolean_True" 2 " En_ExternalInterfaceBoolean_Error" 3 " En_ExternalInterfaceBoolean_NotAvailable" ;
VAL_ 2566913574 CmdBytePGN65534_VTV 17 "AutoQuadStatusAndSettings " 51 "CropInformation " 196 "HarvesterSmartFeedrateSetting2 " 55 "RotorDrivePressure " ;
VAL_ 2566913574 CropTypeID 0 " En_CropType_None" 1 " En_CropType_Alfalfa" 2 " En_CropType_Barley" 3 " En_CropType_Canola" 4 " En_CropType_Dry_Corn" 5 " En_CropType_Edible_Beans" 6 " En_CropType_Flax" 7 " En_CropType_Grass_Seed" 8 " En_CropType_Lentils" 9 " En_CropType_Millet" 10 " En_CropType_Mustard" 11 " En_CropType_Navy_Beans" 12 " En_CropType_Oats" 13 " En_CropType_Black_Eyed_Peas" 14 " En_CropType_Field_Peas" 15 " En_CropType_Yellow_Popcorn" 16 " En_CropType_White_Popcorn" 17 " En_CropType_Rape_Seed" 18 " En_CropType_Long_Rice" 19 " En_CropType_Medium_Rice" 20 " En_CropType_Rye" 21 " En_CropType_Safflower" 22 " En_CropType_Sorghum" 23 " En_CropType_Soybeans" 24 " En_CropType_Oil_Sunflower" 25 " En_CropType_Striped_Sunflower" 26 " En_CropType_Durum_Wheat" 27 " En_CropType_Hard_Red_Spring_Wheat" 28 " En_CropType_Hard_Red_Winter_Wheat" 29 " En_CropType_Soft_Red_Winter_Wheat" 30 " En_CropType_White_Wheat" 31 " En_CropType_European_Winter_Wheat" 32 " En_CropType_European_Feed_Wheat" 33 " En_CropType_European_Triticale" 34 " En_CropType_European_Ind_Sunflower" 35 " En_CropType_European_Oil_Sunflower" 36 " En_CropType_European_Rye" 37 " En_CropType_European_Ind_Rape_Seed" 38 " En_CropType_European_Oil_Rape_Seed" 39 " En_CropType_European_Peas" 40 " En_CropType_European_Oats" 41 " En_CropType_European_Dry_Or_Wet_Corn" 42 " En_CropType_European_Popcorn" 43 " En_CropType_European_Winter_Barley" 44 " En_CropType_European_Spring_Barley" 45 " En_CropType_European_6_Barley" 46 " En_CropType_Chickpeas" 47 " En_CropType_Lupins" 48 " En_CropType_Cotton" 49 " En_CropType_Corn_Silage" 50 " En_CropType_Corn_Cob_Mix" 51 " En_CropType_Elephant_Grass" 52 " En_CropType_Field_Meadow_Grass" 53 " En_CropType_Grass_Forage" 54 " En_CropType_Grassland" 55 " En_CropType_Hemp" 56 " En_CropType_Lucerne" 57 " En_CropType_Set_Aside" 58 " En_CropType_Boot_Stage_WCS" 59 " En_CropType_Small_Sugarbeets" 60 " En_CropType_Medium_Sugarbeets" 61 " En_CropType_Large_Sugarbeets" 62 " En_CropType_Sugarcane" 63 " En_CropType_Energycane" 64 " En_CropType_Peanuts" 65 " En_CropType_Alfalfa_Forage" 66 " En_CropType_Straw" 67 " En_CropType_Cane_Forage" 68 " En_CropType_Grain_Forage" 69 " En_CropType_Cornstalks" 70 " En_CropType_Sugarcane_Residue" 71 " En_CropType_Peanut_Variety_1_Hull" 72 " En_CropType_Peanut_Variety_1_Kernel" 73 " En_CropType_Variety_2_Hull" 74 " En_CropType_Peanut_Variety_2_Kernel" 75 " En_CropType_SweetCorn" 250 " En_CropType_LastValidCropType" 251 " En_CropType_Reserved1" 254 " En_CropType_Error" 255 " En_CropType_NotAvailable" ;
VAL_ 2566913574 HarvSepRotrPressState 0 " Rotor Empty" 1 " Harvesting Rotor Pressure Level Detected" 14 " Error" 15 " Not Available or Not Installed" ;
VAL_ 2566913574 ProdMassFlowState 0 " NoCropFlowDetected" 1 " CropFlowDetected" 2 " NextAvailableState" 3 " 2ndNextAvailableState" 14 " Error" 15 " NotAvailable" ;
VAL_ 2566913574 GSALossMaintainEnable 0 " Disabled" 1 " Enabled" 2 " Error" 3 " Not Available" ;
VAL_ 2566911230 CmdBytePGN65524_Vector_XXX 95 "AutoTrac_State_for_Vehicle " 99 "Guidance_Machine_Status_J_D_Extended " 101 "Local_Error_Sensor_Status " 108 "VehicleStateforRowSense " ;
VAL_ 2566911230 CrvtrCntrlATState_ATSV 0 " ATPS0" 1 " ATPS1" 2 " ATPS2" 3 " ATPS3" 4 " ATPS4" 14 " ATPSErr" 15 " ATPSUkwn" ;
VAL_ 2566911230 RedSteerWarnLightRequest 0 " EnTwoStNo" 1 " EnTwoStYes" 2 " EnTwoStErr" 3 " EnTwoStNotAvl" ;
VAL_ 2566911230 AT2ExitCode_GMSJDE 0 " ATECNoCode" 1 " ATECTransmissionInPark" 2 " ATECFICAFault" 3 " ATECWhlSpdSlow" 4 " ATECAltGuidanceActive" 5 " ATECIncorrectGear" 13 " ATECCmdMsdTimeout" 250 " ATECLastTransitionOk" 16 " ATECAuthDenied" 21 " ATECWhlSpdFast" 22 " ATECOilTempTooLow" 23 " ATECDiagMode" 24 " ATECCtrlState" 25 " ATECResumeNotPressed" 26 " ATECCurvatureNotMatched" 50 " ATECInvalidCommand" 51 " ATECNoOperatorPresence" 52 " ATECImpReleasedControl" 53 " ATECGlobalStop" 54 " ATECOperatorOverride" 62 " ATECECError" 63 " ATECECNotAvailable" 64 " ATECStartUp" 65 " ATECShutDown" 66 " ATECAutoTracShutdown" 67 " ATECEngineOff" 68 " ATECNotCalibrated" 69 " ATECVoltagenotStable" 70 " ATECOperatorPresenceDataBad" 71 " ATECResumeSwitchDataBad" 72 " ATECVehStateMsgMissing" 73 " ATECVehStateMsgBadData" 74 " ATECAdvGuidanceStatusMsgMissing" 75 " ATECAdvGuidanceStatusMsgBadData" 76 " ATECActiveInReverseTimeout" 77 " ATECGPSWheelSpeedMismatch" 78 " ATECNoValidTrack" 79 " ATECInvalidGPS" 80 " ATECShutdownStateFaulted" 81 " ATECGSDDataFaulted" 82 " ATECExtGuidanceStatusMsgFaulted" 83 " ATECExtGuidanceStatusExtendedMsgFaulted" 84 " ATECVehDirSpeedMsgFaulted" 85 " ATECVehRollYawMsgFaulted" 86 " ATECTCMMsgFaulted" 87 " ATECLateralError" 88 " ATECHeadingError" 89 " ATECTrackNumChanged" 90 " ATECTCMInactive" 91 " ATECRSGPSTransitionTooLarge" 92 " ATECRSOutOfRow" 93 " ATECRSGreenstarTrackingFault" 94 " ATECRSSensorFault" 95 " ATECRSGPSFault" 100 " ATECTransportMode" 101 " ATECAuxPumpOn" 102 " ATECBoomsFolded" 103 " ATECHeaderNotEngaged" 104 " ATECFourWheelSteerTimeout" 105 " ATECCrabSteering" 254 " ATECEC8BitError" 255 " ATECEC8BitNotAvailable" ;
VAL_ 2566911230 VehDirection 0 " EnMacDirStp" 1 " EnMacDirRvs" 2 " EnMacDirUnClr" 3 " EnMacDirFwd" 14 " EnMacDirErr" 15 " EnMacDirUkwn" ;
VAL_ 2566911230 AutoTracSystemState 5 " AutoTracSysSt_Actv" 1 " AutoTracSysSt_Disad" 3 " AutoTracSysSt_Enad" 14 " AutoTracSysSt_Err" 0 " AutoTracSysSt_None" 2 " AutoTracSysSt_RdyToEna" 8 " AutoTracSysSt_SrvModActv" 7 " AutoTracSysSt_SrvModEnad" 6 " AutoTracSysSt_SrvModReqd" 4 " AutoTracSysSt_TranToActv" 15 " AutoTracSysSt_Ukwn" ;
VAL_ 2566911230 StarfireFwdCfg_GMSJDE 0 " StarFireFwdCfgOff" 1 " StarFireFwdCfgCAN2ToCAN1" 2 " StarFireFwdCfgCAN2ToEth" 3 " StarFireFwdCfgEthToCAN1AndCan2" 6 " StarFireFwdCfgErr" 7 " StarFireFwdCfgUkwn" ;
VAL_ 2566911230 ActivateGuidanceRequest 0 " No" 1 " Yes" 2 " Error" 3 " NotAvailable" ;
VAL_ 2566911230 AuxiliarySteerMode 0 " ASM2WSFront" 1 " ASM2WSRear" 2 " ASM4WSCoordinated" 3 " ASM4WSCoordinatedLimited" 4 " ASM4WSCrabSteer" 5 " ASM4WSCrabSteerLimited" 6 " ASM4WSIndepdendent" 14 " ASM4BitError" 15 " ASM4BitNotAvailable" ;
VAL_ 2566911230 SensorType_LESS 0 " SnsrTyp_VisionRowGuid" 1 " SnsrTyp_Combine" 2 " SnsrTyp_Reichardt" 3 " SnsrTyp_ReichardtSplit" 4 " SnsrTyp_CottonPicker" 5 " SnsrTyp_ImpVisionRowGuid" 6 " SnsrTyp_CottonStripper" 14 " SnsrTyp_Err" 15 " SnsrTyp_Ukwn" ;
VAL_ 2566911230 CalState_LESS 0 " RSCalSt_NotCald" 1 " RSCalSt_StaticCalSuccess" 2 " RSCalSt_CalSuccess" 3 " RSCalSt_MacNotAligned" 4 " RSCalSt_CannotFindCropRow" 5 " RSCalSt_RowSpacingOOR" 6 " RSCalSt_SegmentationOOR" 7 " RSCalSt_ExcessiveRoll" 8 " RSCalSt_YawRateExceeded" 9 " RSCalSt_DeltaHeadingExceeded" 10 " RSCalSt_InProgress" 11 " RSCalSt_InvalidSpeed" 12 " RSCalSt_LeVoltageHi" 13 " RSCalSt_LeVoltageLow" 14 " RSCalSt_RiVoltageHi" 15 " RSCalSt_RiVoltageLow" ;
VAL_ 2566911230 CalPage_LESS 0 " CalPage_Instruction" 1 " CalPage_ParamEntry" 2 " CalPage_ParamProcessing" 3 " CalPage_VisualAlign" 4 " CalPage_StaticCal" 5 " CalPage_DynCal" 6 " CalPage_CalResult" 14 " CalPage_Err" 15 " CalPage_Ukwn" ;
VAL_ 2566911230 SensorType_VSRS 0 " SnsrTyp_VisionRowGuid" 1 " SnsrTyp_Combine" 2 " SnsrTyp_Reichardt" 3 " SnsrTyp_ReichardtSplit" 4 " SnsrTyp_CottonPicker" 5 " SnsrTyp_ImpVisionRowGuid" 6 " SnsrTyp_CottonStripper" 14 " SnsrTyp_Err" 15 " SnsrTyp_Ukwn" ;
VAL_ 2566911230 TransmissionState_VSRS 0 " TrsmStPark" 1 " TrsmStRvs" 2 " TrsmStNeut" 3 " TrsmStFwd" 14 " TrsmStErr" 15 " TrsmStUkwn" ;
VAL_ 2566911230 SensorShift 0 " SnsrShift_NoShift" 1 " SnsrShift_LeShift" 2 " SnsrShift_RiShift" 14 " SnsrShift_Err" 15 " SnsrShift_Ukwn" ;
VAL_ 2566912603 CmdBytePGN65530_POD 27136 "BoostPowerMeterThresholds " 518 "EnginePowerParameters " 29185 "JD_Configurable_Lighting_Status_-_Left_Hand_Work_Lights " 29441 "JD_Configurable_Lighting_Status_-_Right_Hand_Work_Lights " ;
VAL_ 2566912603 WorkLight13LeftStatus 0 " Deactivated" 1 " Activated" 2 " Fault_Detected" 3 " Not_Available" ;
VAL_ 2566912603 WorkLight13RightStatus 0 " Deactivated" 1 " Activated" 2 " Fault_Detected" 3 " Not_Available" ;
VAL_ 2566913585 CmdBytePGN65534_CAB 11 "CabClimate1 " ;
VAL_ 2565864446 CmdBytePGN61184_Vector_XXX 33018 "Camera_Connection_Quality_1 " 33530 "Camera_Connection_Quality_3 " 35066 "ImageControllerStatus " ;
VAL_ 2565864446 EthernetStatus 0 " Paused" 1 " Enabled" 2 " Error" 3 " Not Available or Not Installed" ;
VAL_ 2565864446 WatchdogReason 0 " No Shutdown Requested" 1 " DA6 Shutdown Request" 2 " Reprogramming Shutdown Request" 3 " Ignition Off Shutdown Request" 4 " Missed Both A53 and R5_1 Heartbeat Request" 5 " Missed A53 Heartbeat Shutdown Request" 6 " Missed R5_1 Heartbeat Shutdown Request" 7 " ISO CAN Shutdown Request" 8 " DA41 Boot Swap Request and Shutdown" 9 " Camera Fault Shutdown Request" 10 " Temperature Shutdown Request" 11 " NON ISO Key Switch Shutdown" 12 " Streaming Control Shutdown Request" 13 " A53SOC2 HB Missed" 14 " Both A53SOC2 and A53SOC1 HB Missed" 15 " Both A53SOC2 and R51 HB Missed" 16 " All A53SOC2 R51 HB Missed" ;
VAL_ 2565865470 CmdBytePGN61184_Vector_XXX 33018 "Camera_Connection_Quality_1 " 33530 "Camera_Connection_Quality_3 " 10993 "EngineDPFRegenerationStatistics " 9060 "Engine_Derate_Status " 1015 "EngineSCRCleaningStatistics " 8696 "Engine_Starting_Shutdown_Status " 33124 "HeaderAuxiliaryFunctionstoFrontEndDomain " 30564 "HeaderLowPriorityStatus " 35066 "ImageControllerStatus " 252 "IO_Expander_Input_Pin_Measurement_Message_#1 " 1276 "IO_Expander_Output_Pin_Control_Request_Message_#1 " 1532 "IO_Expander_Output_Pin_State_Message_#1 " 4196 "JDEngineControlMessage16 " 356 "JDEngineFunctionalTest " 21860 "ScheduledPowerReduction " ;
VAL_ 2565865470 CompressionTest 0 " Enabled" 1 " Disabled" ;
VAL_ 2565865470 CylinderDiagnostics 0 " Enabled" 1 " Disabled" ;
VAL_ 2565865470 CylinderCutoutTest 0 " Enabled" 1 " Disabled" ;
VAL_ 2565865470 CylinderDiagnosticsTrigger 0 " Enabled" 1 " Disabled" ;
VAL_ 2565865470 ActuatorDriverTest 0 " Enabled" 1 " Disabled" ;
VAL_ 2565865470 EngiOverShutTestEnab 0 " Inactive" 1 " Active" 2 " Reserved" 3 " TakeNoAction" ;
VAL_ 2565865470 CompressionTestState 0 " Disabled" 1 " Possible" 2 " Active" 3 " TemperatureError" 4 " EngineModeError" 5 " EngineSpeedError" 6 " CamCrankError" 7 " TooMuchTime" 8 " Cancelled" 9 " Successful" 254 " Error" 255 " NotAvailable" ;
VAL_ 2565865470 CylinderDiagnosticsState 0 " NeverActive" 1 " InProgress" 2 " TemperatureError" 3 " CamOrCrankFailure" 4 " ImproperEngineMode" 5 " Overspeed" 6 " ThrottleError" 7 " Timeout" 8 " Cancelled" 9 " SuccessfulCompletion" 10 " WaitingForTrigger" 254 " Error" 255 " NotAvailable" ;
VAL_ 2565865470 JDPresEngCtrlMode 0 " Control Mode 0" 1 " Control Mode 1" 2 " Control Mode 2" 3 " Control Mode Data equals the number" 249 " Control Mode 249" 250 " Control Mode 250" 254 " Rsrvd_Stds" 255 " Dont care take no action" ;
VAL_ 2565865470 EngOpStateFromEcu 0 " DEM_Engine_Stopped" 1 " DEM_PreStart" 2 " DEM_Starting" 3 " DEM_WarmUp" 4 " DEM_Running" 5 " DEM_Cooldown" 6 " DEM_Engine_Stopping" 7 " DEM_PostRun" 14 " DEM_RsrvdStds" 15 " DEM_Dont_caretake_no_action" ;
VAL_ 2565865470 EngWaitToStartLamp 0 " Off" 1 " On" 2 " Error" 3 " Not Available" ;
VAL_ 2565865470 EngProtectSysHasShtdwnEng 0 " EnBooleanFalse" 1 " EnBooleanTrue" 2 " EnBooleanError" 3 " EnBooleanNotAvailable" ;
VAL_ 2565865470 SPRActiveFlag 0 " Active" 1 " Not Active" 2 " Error" 3 " Not Available" ;
VAL_ 2565865470 HeadOffGrouContModeAllo 0 " En_HeaderModesAllowed_None" 1 " En_HeaderModesAllowed_HeightOnly" 2 " En_HeaderModesAllowed_HeightAndTilt" 3 " En_HeaderModesAllowed_HeightSensorsNotInstalled" 14 " En_HeaderModesAllowed_Error" 15 " En_HeaderModesAllowed_NotAvailable" ;
VAL_ 2565865470 HeadOnGrouContModeAllo 0 " En_HeaderModesAllowed_None" 1 " En_HeaderModesAllowed_HeightOnly" 2 " En_HeaderModesAllowed_HeightAndTilt" 3 " En_HeaderModesAllowed_HeightSensorsNotInstalled" 14 " En_HeaderModesAllowed_Error" 15 " En_HeaderModesAllowed_NotAvailable" ;
VAL_ 2565865470 HeaderAuxIconEnbld 0 " En_OnOff2States_Off" 1 " En_OnOff2States_On" 2 " En_OnOff2States_Error" 3 " En_OnOff2States_NotAvailable" ;
VAL_ 2565865470 EthernetStatus 0 " Paused" 1 " Enabled" 2 " Error" 3 " Not Available or Not Installed" ;
VAL_ 2565865470 WatchdogReason 0 " No Shutdown Requested" 1 " DA6 Shutdown Request" 2 " Reprogramming Shutdown Request" 3 " Ignition Off Shutdown Request" 4 " Missed Both A53 and R5_1 Heartbeat Request" 5 " Missed A53 Heartbeat Shutdown Request" 6 " Missed R5_1 Heartbeat Shutdown Request" 7 " ISO CAN Shutdown Request" 8 " DA41 Boot Swap Request and Shutdown" 9 " Camera Fault Shutdown Request" 10 " Temperature Shutdown Request" 11 " NON ISO Key Switch Shutdown" 12 " Streaming Control Shutdown Request" 13 " A53SOC2 HB Missed" 14 " Both A53SOC2 and A53SOC1 HB Missed" 15 " Both A53SOC2 and R51 HB Missed" 16 " All A53SOC2 R51 HB Missed" ;
VAL_ 2365584177 CmdBytePGN65523_CAB 49 "ClosedSystemPgnA18JDHWAutoShiftParameters " ;
VAL_ 2365584177 ParkBrakeReq 0 " DEM_Off" 1 " DEM_On" 2 " DEM_Error" 3 " DEM_Not_available_or_not_installed" ;
VAL_ 2365584177 HydHndlState 0 " DEM_Hydro_handle_in_NeutralZero_position" 1 " DEM_Hydro_handle_in_Forward_position" 2 " DEM_Hydro_handle_in_Reverse_position" 3 " DEM_Hydro_handle_in_Center_Position" 6 " DEM_RsrvdStds" 7 " DEM_Dont_caretake_no_action" ;
VAL_ 2566913770 CmdBytePGN65534_FED 150 "Combine_Network_Health_Data " 151 "Combine_Network_Health_Data_#2 " ;
VAL_ 2566913771 CmdBytePGN65534_HAD 150 "Combine_Network_Health_Data " 151 "Combine_Network_Health_Data_#2 " ;
VAL_ 2566913627 CmdBytePGN65534_POD 150 "Combine_Network_Health_Data " 151 "Combine_Network_Health_Data_#2 " 236 "MachineSetup " ;
VAL_ 2566913627 EngType 0 " DEM_NotInstalled" 1 " DEM_NineLiT4" 2 " DEM_NineLFT4" 3 " DEM_ThirteenPointFiveLFT4" ;
VAL_ 2566912200 CmdBytePGN65528_DC1 83 "Controller/Display_Power_Management_#3 " ;
VAL_ 2566912234 CmdBytePGN65528_FED 83 "Controller/Display_Power_Management_#3 " 118 "HeaderHeightDisplayData3 " ;
VAL_ 2566912235 CmdBytePGN65528_HAD 83 "Controller/Display_Power_Management_#3 " 239 "VideoCameraDisplay " ;
VAL_ 2566912235 SeparatorEngagedVideoTrigger 0 " EnOnOff2StatesOff" 1 " EnOnOff2StatesOn" 2 " EnOnOff2StatesError" 3 " EnOnOff2StatesNotAvailable" ;
VAL_ 2566912235 AugerEngagedVideoTrigger 0 " EnOnOff2StatesOff" 1 " EnOnOff2StatesOn" 2 " EnOnOff2StatesError" 3 " EnOnOff2StatesNotAvailable" ;
VAL_ 2566912235 GrainTank_3_4_VideoTrigger 0 " EnOnOff2StatesOff" 1 " EnOnOff2StatesOn" 2 " EnOnOff2StatesError" 3 " EnOnOff2StatesNotAvailable" ;
VAL_ 2566912235 GrainTankFullVideoTrigger 0 " EnOnOff2StatesOff" 1 " EnOnOff2StatesOn" 2 " EnOnOff2StatesError" 3 " EnOnOff2StatesNotAvailable" ;
VAL_ 2566912235 SepaEngaReveVideTrig 0 " EnOnOff2StatesOff" 1 " EnOnOff2StatesOn" 2 " EnOnOff2StatesError" 3 " EnOnOff2StatesNotAvailable" ;
VAL_ 2566912235 SepaDisEngaReveVideTrig 0 " EnOnOff2StatesOff" 1 " EnOnOff2StatesOn" 2 " EnOnOff2StatesError" 3 " EnOnOff2StatesNotAvailable" ;
VAL_ 2566912235 AugerSwungOutVideoTrigger 0 " EnOnOff2StatesOff" 1 " EnOnOff2StatesOn" 2 " EnOnOff2StatesError" 3 " EnOnOff2StatesNotAvailable" ;
VAL_ 2566912235 RoadTransportVideoTrigger 0 " EnOnOff2StatesOff" 1 " EnOnOff2StatesOn" 2 " EnOnOff2StatesError" 3 " EnOnOff2StatesNotAvailable" ;
VAL_ 2566912091 CmdBytePGN65528_POD 83 "Controller/Display_Power_Management_#3 " ;
VAL_ 2498756586 CmdBytePGN61184_FED 5876 "ControllerDisplayPowerManagementCommands2 " 29284 "FrontEndDomainMiscellaneousStatus " ;
VAL_ 2498756586 CtlrDispPwrStateCmd 0 " DEM_Maintain_powerstates_not_required" 1 " DEM_Maintain_power_required" 2 " DEM_Hibernate_state_required" 14 " DEM_RsrvdStds" 15 " DEM_Dont_caretake_no_action" ;
VAL_ 2498756586 FdrhseRaiseLwrSysState 0 " En_HeaderHeightLiftStates_Disabled" 1 " En_HeaderHeightLiftStates_Passive" 2 " En_HeaderHeightLiftStates_Manual" 3 " En_HeaderHeightLiftStates_Resume" 4 " En_HeaderHeightLiftStates_HeightSensingOffGround" 5 " En_HeaderHeightLiftStates_HeightSensingOnGround" 6 " En_HeaderHeightLiftStates_Float" 7 " En_HeaderHeightLiftStates_RoadFloat" 8 " En_HeaderHeightLiftStates_RoadDampening" 9 " En_HeaderHeightLiftStates_NumHeaderHeightLiftStates" 14 " En_HeaderHeightLiftStates_Error" 15 " En_HeaderHeightLiftStates_NotAvailable" ;
VAL_ 2498756586 FdrhseLatTiltSysState 0 " En_HeaderHeightTiltStates_Disabled" 1 " En_HeaderHeightTiltStates_Passive" 2 " En_HeaderHeightTiltStates_Manual" 3 " En_HeaderHeightTiltStates_ContourMaster" 4 " En_HeaderHeightTiltStates_AutoCenter" 5 " En_HeaderHeightTiltStates_TiltFloat" 6 " En_HeaderHeightTiltStates_NumHeaderHeightTiltStates" 14 " En_HeaderHeightTiltStates_Error" 15 " En_HeaderHeightTiltStates_NotAvailable" ;
VAL_ 2498756586 MachineHarvestingState 0 " DEM_Off" 1 " DEM_On" 2 " DEM_Error" 3 " DEM_Not_available_or_not_installed" ;
VAL_ 2498756586 HeaderDrive 0 " DEM_Disengaged" 1 " DEM_Engaged" 2 " DEM_EngagedReverse" 3 " DEM_Overridden" 14 " DEM_Error" 15 " DEM_Not_available" ;
VAL_ 2498756586 HdrType 0 " En_HeaderTypes_NoHeaderConnected" 1 " En_HeaderTypes_CornHeadChopping" 2 " En_HeaderTypes_RowCropWithCenterPot" 3 " En_HeaderTypes_Oxbo" 4 " En_HeaderTypes_CornHead" 5 " En_HeaderTypes_BeltPickupWith2Pots" 6 " En_HeaderTypes_BeltPickupWithPot" 7 " En_HeaderTypes_JDFoldingCornHead" 8 " En_HeaderTypes_Rigid" 9 " En_HeaderTypes_FlexibleDraper" 10 " En_HeaderTypes_Draper" 11 " En_HeaderTypes_DraperAdvanced" 12 " En_HeaderTypes_FlexWithPot" 13 " En_HeaderTypes_EuroDraper" 14 " En_HeaderTypes_Hydraflex" 15 " En_HeaderTypes_Vario" 16 " En_HeaderTypes_FlexWingDraper" 17 " En_HeaderTypes_NumHeads" 254 " En_HeaderTypes_Error" 255 " En_HeaderTypes_NotAvailable" ;
VAL_ 2498756586 ReelSpeedSystemMode 0 " En_ReelSpeedSystemMode_Disabled" 1 " En_ReelSpeedSystemMode_FixedSpeed" 2 " En_ReelSpeedSystemMode_DialASpeed" 3 " En_ReelSpeedSystemMode_Modulation" 14 " En_ReelSpeedSystemMode_Error" 15 " En_ReelSpeedSystemMode_NotAvailable" ;
VAL_ 2498756586 ValidHeadConnectionStatus 0 " En_ExternalInterfaceBoolean_False" 1 " En_ExternalInterfaceBoolean_True" 2 " En_ExternalInterfaceBoolean_Error" 3 " En_ExternalInterfaceBoolean_NotAvailable" ;
VAL_ 2498756586 FrntEndPreEngmtChecksPassd 0 " DEM_Disengaged" 1 " DEM_Engaged" 2 " DEM_EngagedReverse" 3 " DEM_Overridden" 14 " DEM_Error" 15 " DEM_Not_available" ;
VAL_ 2498756586 LateralTiltOptn 0 " En_ModeEnableStates_Disabled" 1 " En_ModeEnableStates_Enabled" 2 " En_ModeEnableStates_Error" 3 " En_ModeEnableStates_NotAvailable" ;
VAL_ 2498756587 CmdBytePGN61184_HAD 5876 "ControllerDisplayPowerManagementCommands2 " 17252 "HarvestingDomainGrainTankStatus " 38244 "HarvestingDomainThreshingStatus2 " 2808 "HarvestingDomainCommand1 " 21092 "HarvestingDomainHours1 " 17764 "HarvestingDomainShaftSpeed1 " 18020 "HarvestingDomainShaftSpeed2 " 18276 "HarvestingDomainShaftSpeed3 " 18788 "HarvestingDomainShaftSpeed4 " 19044 "HarvestingDomainShoeStatus " ;
VAL_ 2498756587 RoadFieldMode 0 " DEM_Field_mode" 1 " DEM_Road_mode" 2 " DEM_Error" 3 " DEM_Not_availablenot_installed" ;
VAL_ 2498756587 AutoBeaconLightsCmd 0 " DEM_Off" 1 " DEM_On" 2 " DEM_Error" 3 " DEM_Not_available_or_not_installed" ;
VAL_ 2498756587 EstimdRoadFieldMode 0 " DEM_Field_mode" 1 " DEM_Road_mode" 2 " DEM_Error" 3 " DEM_Not_availablenot_installed" ;
VAL_ 2498756587 CtlrDispPwrStateCmd 0 " DEM_Maintain_powerstates_not_required" 1 " DEM_Maintain_power_required" 2 " DEM_Hibernate_state_required" 14 " DEM_RsrvdStds" 15 " DEM_Dont_caretake_no_action" ;
VAL_ 2498756587 GrainTankCoversState 0 " DEM_Intermediate_Separator_Not_Allowed" 1 " DEM_Closed" 2 " DEM_Open" 3 " DEM_Intermediate_Separator_Allowed" 4 " DEM_Opening" 5 " DEM_Closing" 6 " DEM_Opening_with_Sensor_Error" 7 " DEM_Closing_with_Sensor_Error" 14 " DEM_Error" 15 " DEM_Not_availablenot_installed" ;
VAL_ 2498756587 FoldingUnloadingAugerState 0 " DEM_Disable" 1 " DEM_Position_Unknown" 2 " DEM_Folded" 3 " DEM_Unfolded" 4 " DEM_InCalibration" 5 " DEM_Folding" 6 " DEM_Unfolding" 7 " DEM_Partially_Unfolded" 13 " DEM_Not_Installed" 14 " DEM_Error" 15 " DEM_Not_Available" ;
VAL_ 2498756587 FountainLdngAugState 0 " DEM_Disabled" 1 " DEM_Indeterminate" 2 " DEM_Raised" 3 " DEM_Lowered" 4 " DEM_Raising" 5 " DEM_Lowering" 14 " DEM_Error" 15 " DEM_NotAvailable" ;
VAL_ 2498756587 GrainTank34FullAlrm 0 " DEM_Off" 1 " DEM_On" 2 " DEM_Error" 3 " DEM_Not_available_or_not_installed" ;
VAL_ 2498756587 GrainTankFullAlrm 0 " DEM_Off" 1 " DEM_On" 2 " DEM_Error" 3 " DEM_Not_available_or_not_installed" ;
VAL_ 2498756587 UnloadingAugerDrive 0 " DEM_Disengaged" 1 " DEM_Engaged" 2 " DEM_EngagedReverse" 3 " DEM_Overridden" 14 " DEM_Error" 15 " DEM_Not_available" ;
VAL_ 2498756587 UnldgAugBootCleanoutState 0 " DEM_Off" 1 " DEM_On" 2 " DEM_Error" 3 " DEM_Not_available_or_not_installed" ;
VAL_ 2498756587 ThreshingPressureStatus 0 " En_PressureSensorStatus_InRange" 1 " En_PressureSensorStatus_OutOfRangeLow" 2 " En_PressureSensorStatus_OutOfRangeHigh" 3 " En_PressureSensorStatus_LowLevelWarning" 4 " En_PressureSensorStatus_LowLevelFault" 5 " En_PressureSensorStatus_HighLevelWarning" 6 " En_PressureSensorStatus_HighLevelFault" 7 " En_PressureSensorStatus_SensorReferenceFault" 8 " En_PressureSensorStatus_SensorFailedFault" 14 " En_PressureSensorStatus_Error" 15 " En_PressureSensorStatus_NotAvailable" ;
VAL_ 2498756443 CmdBytePGN61184_POD 5876 "ControllerDisplayPowerManagementCommands2 " 21348 "PowertrainDomainMiscellaneousHighPriority " ;
VAL_ 2498756443 CtlrDispPwrStateCmd 0 " DEM_Maintain_powerstates_not_required" 1 " DEM_Maintain_power_required" 2 " DEM_Hibernate_state_required" 14 " DEM_RsrvdStds" 15 " DEM_Dont_caretake_no_action" ;
VAL_ 2498756443 AirCompEngageState 0 " DEM_Off" 1 " DEM_On" 2 " DEM_Error" 3 " DEM_Not_available_or_not_installed" ;
VAL_ 2498756443 LoBattVoltAlrm 0 " DEM_Off" 1 " DEM_On" 2 " DEM_Error" 3 " DEM_Not_available_or_not_installed" ;
VAL_ 2498756443 AltRegultrStateAlrm 0 " DEM_Off" 1 " DEM_On" 2 " DEM_Error" 3 " DEM_Not_available_or_not_installed" ;
VAL_ 2498756443 EngRun 0 " Not Running" 1 " Running" 2 " Error" 3 " NotAvailable" ;
VAL_ 2498756443 EngThrottleState 0 " DEM_No_Idle" 1 " DEM_Low_Idle" 2 " DEM_Mid_Idle" 3 " DEM_High_Idle" 4 " DEM_High_Idle_reduced_throttle" ;
VAL_ 2498756443 VehicleMovingState 0 " En_VehicleMovingSt_NotMoving" 1 " En_VehicleMovingSt_Moving" 2 " En_VehicleMovingSt_Undetermined" 14 " En_VehicleMovingSt_Error" 15 " En_VehicleMovingSt_NotAvailable" ;
VAL_ 2498756443 FlexpowerStatusToVeh 0 " FlexpowerActive" 2 " Error" 3 " NotAvailable" ;
VAL_ 2632974171 CmdBytePGN61184_POD 173 "Controller_Data_Message " 429 "Controller_Data_Message_0xAD01 " 685 "Controller_Data_Message_0xAD02 " 941 "Controller_Data_Message_0xAD03 " 1197 "Controller_Data_Message_0xAD04 " 1453 "Controller_Data_Message_0xAD05 " 1709 "Controller_Data_Message_0xAD06 " 1965 "Controller_Data_Message_0xAD07 " 2221 "Controller_Data_Message_0xAD08 " 2477 "Controller_Data_Message_0xAD09 " 2733 "Controller_Data_Message_0xAD0A " 2989 "Controller_Data_Message_0xAD0B " 3245 "Controller_Data_Message_0xAD0C " 3501 "Controller_Data_Message_0xAD0D " 3757 "Controller_Data_Message_0xAD0E " 4013 "Controller_Data_Message_0xAD0F " 4269 "Controller_Data_Message_0xAD10 " 4525 "Controller_Data_Message_0xAD11 " 4781 "Controller_Data_Message_0xAD12 " 5037 "Controller_Data_Message_0xAD13 " 5293 "Controller_Data_Message_0xAD14 " 5549 "Controller_Data_Message_0xAD15 " 5805 "Controller_Data_Message_0xAD16 " 6061 "Controller_Data_Message_0xAD17 " 6317 "Controller_Data_Message_0xAD18 " 6573 "Controller_Data_Message_0xAD19 " 6829 "Controller_Data_Message_0xAD1A " 7085 "Controller_Data_Message_0xAD1B " 7341 "Controller_Data_Message_0xAD1C " 7597 "Controller_Data_Message_0xAD1D " 7853 "Controller_Data_Message_0xAD1E " 8109 "Controller_Data_Message_0xAD1F " 8365 "Controller_Data_Message_0xAD20 " 8621 "Controller_Data_Message_0xAD21 " 8877 "Controller_Data_Message_0xAD22 " 9133 "Controller_Data_Message_0xAD23 " 9389 "Controller_Data_Message_0xAD24 " 9645 "Controller_Data_Message_0xAD25 " 9901 "Controller_Data_Message_0xAD26 " 10157 "Controller_Data_Message_0xAD27 " 10413 "Controller_Data_Message_0xAD28 " 10669 "Controller_Data_Message_0xAD29 " 10925 "Controller_Data_Message_0xAD2A " 11181 "Controller_Data_Message_0xAD2B " 11437 "Controller_Data_Message_0xAD2C " 11693 "Controller_Data_Message_0xAD2D " 11949 "Controller_Data_Message_0xAD2E " 428 "Data_Request_Message_0xAC01 " 684 "Data_Request_Message_0xAC02 " 940 "Data_Request_Message_0xAC03 " 1196 "Data_Request_Message_0xAC04 " 1452 "Data_Request_Message_0xAC05 " 1708 "Data_Request_Message_0xAC06 " 1964 "Data_Request_Message_0xAC07 " 2220 "Data_Request_Message_0xAC08 " 2476 "Data_Request_Message_0xAC09 " 2732 "Data_Request_Message_0xAC0A " 2988 "Data_Request_Message_0xAC0B " 3244 "Data_Request_Message_0xAC0C " 3500 "Data_Request_Message_0xAC0D " 3756 "Data_Request_Message_0xAC0E " 4012 "Data_Request_Message_0xAC0F " 4268 "Data_Request_Message_0xAC10 " 4524 "Data_Request_Message_0xAC11 " 4780 "Data_Request_Message_0xAC12 " 5036 "Data_Request_Message_0xAC13 " 5292 "Data_Request_Message_0xAC14 " 5548 "Data_Request_Message_0xAC15 " 5804 "Data_Request_Message_0xAC16 " 6060 "Data_Request_Message_0xAC17 " 6316 "Data_Request_Message_0xAC18 " 6572 "Data_Request_Message_0xAC19 " 6828 "Data_Request_Message_0xAC1A " 7084 "Data_Request_Message_0xAC1B " 7340 "Data_Request_Message_0xAC1C " 7596 "Data_Request_Message_0xAC1D " 7852 "Data_Request_Message_0xAC1E " 8108 "Data_Request_Message_0xAC1F " 8364 "Data_Request_Message_0xAC20 " 8620 "Data_Request_Message_0xAC21 " 8876 "Data_Request_Message_0xAC22 " 9132 "Data_Request_Message_0xAC23 " 9388 "Data_Request_Message_0xAC24 " 9644 "Data_Request_Message_0xAC25 " 9900 "Data_Request_Message_0xAC26 " 10156 "Data_Request_Message_0xAC27 " 10412 "Data_Request_Message_0xAC28 " 10668 "Data_Request_Message_0xAC29 " 10924 "Data_Request_Message_0xAC2A " 172 "Data_Request_Message " 22884 "PowertrainDomaintoDriveTrainOptions " ;
VAL_ 2632974171 Opt4WD 0 " Off" 1 " On" 2 " Error" 3 " NotAvailable" ;
VAL_ 2632974171 EngSpdInRoadMode 0 " Off" 1 " On" 2 " Error" 3 " NotAvailable" ;
VAL_ 2632974171 OptType4WD 0 " NotInstalled" 1 " FixedDisplacement_4WD" 2 " VariableDisplacement_4WD" 14 " Error" 15 " NotAvailable" ;
VAL_ 2632974171 TracksOption 0 " NotInstalled" 1 " Region2HarainTracks" 2 " Region4ATITracks" 3 " GlobalTracks" 14 " Error" 15 " NotAvailable" ;
VAL_ 2634021610 CmdBytePGN65530_FED 11520 "ControllerHealthInfo " ;
VAL_ 2634021611 CmdBytePGN65530_HAD 11520 "ControllerHealthInfo " ;
VAL_ 2634021416 CmdBytePGN65530_PDU 11520 "ControllerHealthInfo " ;
VAL_ 2634021467 CmdBytePGN65530_POD 11520 "ControllerHealthInfo " 34304 "GroundSpeedAutomationCommand2 " ;
VAL_ 2634021467 GrouSpeeAutoMaxGrouSpdDec 0 " Stop" 1 " Decrease" 2 " Error" 3 " NotAvailable" ;
VAL_ 2634021467 GrouSpeeAutoMaxGrouSpdInc 0 " Stop" 1 " Increase" 2 " Error" 3 " NotAvailable" ;
VAL_ 2632974314 CmdBytePGN61184_FED 428 "Data_Request_Message_0xAC01 " 684 "Data_Request_Message_0xAC02 " 940 "Data_Request_Message_0xAC03 " 1196 "Data_Request_Message_0xAC04 " 1452 "Data_Request_Message_0xAC05 " 1708 "Data_Request_Message_0xAC06 " 1964 "Data_Request_Message_0xAC07 " 2220 "Data_Request_Message_0xAC08 " 2476 "Data_Request_Message_0xAC09 " 2732 "Data_Request_Message_0xAC0A " 2988 "Data_Request_Message_0xAC0B " 3244 "Data_Request_Message_0xAC0C " 3500 "Data_Request_Message_0xAC0D " 3756 "Data_Request_Message_0xAC0E " 4012 "Data_Request_Message_0xAC0F " 4268 "Data_Request_Message_0xAC10 " 4524 "Data_Request_Message_0xAC11 " 4780 "Data_Request_Message_0xAC12 " 5036 "Data_Request_Message_0xAC13 " 5292 "Data_Request_Message_0xAC14 " 5548 "Data_Request_Message_0xAC15 " 5804 "Data_Request_Message_0xAC16 " 6060 "Data_Request_Message_0xAC17 " 6316 "Data_Request_Message_0xAC18 " 6572 "Data_Request_Message_0xAC19 " 6828 "Data_Request_Message_0xAC1A " 7084 "Data_Request_Message_0xAC1B " 7340 "Data_Request_Message_0xAC1C " 7596 "Data_Request_Message_0xAC1D " 7852 "Data_Request_Message_0xAC1E " 8108 "Data_Request_Message_0xAC1F " 8364 "Data_Request_Message_0xAC20 " 8620 "Data_Request_Message_0xAC21 " 8876 "Data_Request_Message_0xAC22 " 9132 "Data_Request_Message_0xAC23 " 9388 "Data_Request_Message_0xAC24 " 9644 "Data_Request_Message_0xAC25 " 9900 "Data_Request_Message_0xAC26 " 10156 "Data_Request_Message_0xAC27 " 10412 "Data_Request_Message_0xAC28 " 10668 "Data_Request_Message_0xAC29 " 10924 "Data_Request_Message_0xAC2A " 172 "Data_Request_Message " ;
VAL_ 2632974315 CmdBytePGN61184_HAD 428 "Data_Request_Message_0xAC01 " 684 "Data_Request_Message_0xAC02 " 940 "Data_Request_Message_0xAC03 " 1196 "Data_Request_Message_0xAC04 " 1452 "Data_Request_Message_0xAC05 " 1708 "Data_Request_Message_0xAC06 " 1964 "Data_Request_Message_0xAC07 " 2220 "Data_Request_Message_0xAC08 " 2476 "Data_Request_Message_0xAC09 " 2732 "Data_Request_Message_0xAC0A " 2988 "Data_Request_Message_0xAC0B " 3244 "Data_Request_Message_0xAC0C " 3500 "Data_Request_Message_0xAC0D " 3756 "Data_Request_Message_0xAC0E " 4012 "Data_Request_Message_0xAC0F " 4268 "Data_Request_Message_0xAC10 " 4524 "Data_Request_Message_0xAC11 " 4780 "Data_Request_Message_0xAC12 " 5036 "Data_Request_Message_0xAC13 " 5292 "Data_Request_Message_0xAC14 " 5548 "Data_Request_Message_0xAC15 " 5804 "Data_Request_Message_0xAC16 " 6060 "Data_Request_Message_0xAC17 " 6316 "Data_Request_Message_0xAC18 " 6572 "Data_Request_Message_0xAC19 " 6828 "Data_Request_Message_0xAC1A " 7084 "Data_Request_Message_0xAC1B " 7340 "Data_Request_Message_0xAC1C " 7596 "Data_Request_Message_0xAC1D " 7852 "Data_Request_Message_0xAC1E " 8108 "Data_Request_Message_0xAC1F " 8364 "Data_Request_Message_0xAC20 " 8620 "Data_Request_Message_0xAC21 " 8876 "Data_Request_Message_0xAC22 " 9132 "Data_Request_Message_0xAC23 " 9388 "Data_Request_Message_0xAC24 " 9644 "Data_Request_Message_0xAC25 " 9900 "Data_Request_Message_0xAC26 " 10156 "Data_Request_Message_0xAC27 " 10412 "Data_Request_Message_0xAC28 " 10668 "Data_Request_Message_0xAC29 " 10924 "Data_Request_Message_0xAC2A " 172 "Data_Request_Message " ;
VAL_ 2632974330 CmdBytePGN61184_OBT_FA 428 "Data_Request_Message_0xAC01 " 684 "Data_Request_Message_0xAC02 " 940 "Data_Request_Message_0xAC03 " 1196 "Data_Request_Message_0xAC04 " 1452 "Data_Request_Message_0xAC05 " 1708 "Data_Request_Message_0xAC06 " 1964 "Data_Request_Message_0xAC07 " 2220 "Data_Request_Message_0xAC08 " 2476 "Data_Request_Message_0xAC09 " 2732 "Data_Request_Message_0xAC0A " 2988 "Data_Request_Message_0xAC0B " 3244 "Data_Request_Message_0xAC0C " 3500 "Data_Request_Message_0xAC0D " 3756 "Data_Request_Message_0xAC0E " 4012 "Data_Request_Message_0xAC0F " 4268 "Data_Request_Message_0xAC10 " 4524 "Data_Request_Message_0xAC11 " 4780 "Data_Request_Message_0xAC12 " 5036 "Data_Request_Message_0xAC13 " 5292 "Data_Request_Message_0xAC14 " 5548 "Data_Request_Message_0xAC15 " 5804 "Data_Request_Message_0xAC16 " 6060 "Data_Request_Message_0xAC17 " 6316 "Data_Request_Message_0xAC18 " 6572 "Data_Request_Message_0xAC19 " 6828 "Data_Request_Message_0xAC1A " 7084 "Data_Request_Message_0xAC1B " 7340 "Data_Request_Message_0xAC1C " 7596 "Data_Request_Message_0xAC1D " 7852 "Data_Request_Message_0xAC1E " 8108 "Data_Request_Message_0xAC1F " 8364 "Data_Request_Message_0xAC20 " 8620 "Data_Request_Message_0xAC21 " 8876 "Data_Request_Message_0xAC22 " 9132 "Data_Request_Message_0xAC23 " 9388 "Data_Request_Message_0xAC24 " 9644 "Data_Request_Message_0xAC25 " 9900 "Data_Request_Message_0xAC26 " 10156 "Data_Request_Message_0xAC27 " 10412 "Data_Request_Message_0xAC28 " 10668 "Data_Request_Message_0xAC29 " 10924 "Data_Request_Message_0xAC2A " 172 "Data_Request_Message " ;
VAL_ 2632969194 CmdBytePGN61184_FED 172 "Data_Request_Message " 428 "Data_Request_Message_0xAC01 " 684 "Data_Request_Message_0xAC02 " 940 "Data_Request_Message_0xAC03 " 1196 "Data_Request_Message_0xAC04 " 1452 "Data_Request_Message_0xAC05 " 1708 "Data_Request_Message_0xAC06 " 1964 "Data_Request_Message_0xAC07 " 2220 "Data_Request_Message_0xAC08 " 2476 "Data_Request_Message_0xAC09 " 2732 "Data_Request_Message_0xAC0A " 2988 "Data_Request_Message_0xAC0B " 3244 "Data_Request_Message_0xAC0C " 3500 "Data_Request_Message_0xAC0D " 3756 "Data_Request_Message_0xAC0E " 4012 "Data_Request_Message_0xAC0F " 4268 "Data_Request_Message_0xAC10 " 4524 "Data_Request_Message_0xAC11 " 4780 "Data_Request_Message_0xAC12 " 5036 "Data_Request_Message_0xAC13 " 5292 "Data_Request_Message_0xAC14 " 5548 "Data_Request_Message_0xAC15 " 5804 "Data_Request_Message_0xAC16 " 6060 "Data_Request_Message_0xAC17 " 6316 "Data_Request_Message_0xAC18 " 6572 "Data_Request_Message_0xAC19 " 6828 "Data_Request_Message_0xAC1A " 7084 "Data_Request_Message_0xAC1B " 7340 "Data_Request_Message_0xAC1C " 7596 "Data_Request_Message_0xAC1D " 7852 "Data_Request_Message_0xAC1E " 8108 "Data_Request_Message_0xAC1F " 8364 "Data_Request_Message_0xAC20 " 8620 "Data_Request_Message_0xAC21 " 8876 "Data_Request_Message_0xAC22 " 9132 "Data_Request_Message_0xAC23 " 9388 "Data_Request_Message_0xAC24 " 9644 "Data_Request_Message_0xAC25 " 9900 "Data_Request_Message_0xAC26 " 10156 "Data_Request_Message_0xAC27 " 10412 "Data_Request_Message_0xAC28 " 10668 "Data_Request_Message_0xAC29 " 10924 "Data_Request_Message_0xAC2A " ;
VAL_ 2632932330 CmdBytePGN61184_FED 172 "Data_Request_Message " 428 "Data_Request_Message_0xAC01 " 684 "Data_Request_Message_0xAC02 " 940 "Data_Request_Message_0xAC03 " 1196 "Data_Request_Message_0xAC04 " 1452 "Data_Request_Message_0xAC05 " 1708 "Data_Request_Message_0xAC06 " 1964 "Data_Request_Message_0xAC07 " 2220 "Data_Request_Message_0xAC08 " 2476 "Data_Request_Message_0xAC09 " 2732 "Data_Request_Message_0xAC0A " 2988 "Data_Request_Message_0xAC0B " 3244 "Data_Request_Message_0xAC0C " 3500 "Data_Request_Message_0xAC0D " 3756 "Data_Request_Message_0xAC0E " 4012 "Data_Request_Message_0xAC0F " 4268 "Data_Request_Message_0xAC10 " 4524 "Data_Request_Message_0xAC11 " 4780 "Data_Request_Message_0xAC12 " 5036 "Data_Request_Message_0xAC13 " 5292 "Data_Request_Message_0xAC14 " 5548 "Data_Request_Message_0xAC15 " 5804 "Data_Request_Message_0xAC16 " 6060 "Data_Request_Message_0xAC17 " 6316 "Data_Request_Message_0xAC18 " 6572 "Data_Request_Message_0xAC19 " 6828 "Data_Request_Message_0xAC1A " 7084 "Data_Request_Message_0xAC1B " 7340 "Data_Request_Message_0xAC1C " 7596 "Data_Request_Message_0xAC1D " 7852 "Data_Request_Message_0xAC1E " 8108 "Data_Request_Message_0xAC1F " 8364 "Data_Request_Message_0xAC20 " 8620 "Data_Request_Message_0xAC21 " 8876 "Data_Request_Message_0xAC22 " 9132 "Data_Request_Message_0xAC23 " 9388 "Data_Request_Message_0xAC24 " 9644 "Data_Request_Message_0xAC25 " 9900 "Data_Request_Message_0xAC26 " 10156 "Data_Request_Message_0xAC27 " 10412 "Data_Request_Message_0xAC28 " 10668 "Data_Request_Message_0xAC29 " 10924 "Data_Request_Message_0xAC2A " ;
VAL_ 2632968939 CmdBytePGN61184_HAD 172 "Data_Request_Message " 428 "Data_Request_Message_0xAC01 " 684 "Data_Request_Message_0xAC02 " 940 "Data_Request_Message_0xAC03 " 1196 "Data_Request_Message_0xAC04 " 1452 "Data_Request_Message_0xAC05 " 1708 "Data_Request_Message_0xAC06 " 1964 "Data_Request_Message_0xAC07 " 2220 "Data_Request_Message_0xAC08 " 2476 "Data_Request_Message_0xAC09 " 2732 "Data_Request_Message_0xAC0A " 2988 "Data_Request_Message_0xAC0B " 3244 "Data_Request_Message_0xAC0C " 3500 "Data_Request_Message_0xAC0D " 3756 "Data_Request_Message_0xAC0E " 4012 "Data_Request_Message_0xAC0F " 4268 "Data_Request_Message_0xAC10 " 4524 "Data_Request_Message_0xAC11 " 4780 "Data_Request_Message_0xAC12 " 5036 "Data_Request_Message_0xAC13 " 5292 "Data_Request_Message_0xAC14 " 5548 "Data_Request_Message_0xAC15 " 5804 "Data_Request_Message_0xAC16 " 6060 "Data_Request_Message_0xAC17 " 6316 "Data_Request_Message_0xAC18 " 6572 "Data_Request_Message_0xAC19 " 6828 "Data_Request_Message_0xAC1A " 7084 "Data_Request_Message_0xAC1B " 7340 "Data_Request_Message_0xAC1C " 7596 "Data_Request_Message_0xAC1D " 7852 "Data_Request_Message_0xAC1E " 8108 "Data_Request_Message_0xAC1F " 8364 "Data_Request_Message_0xAC20 " 8620 "Data_Request_Message_0xAC21 " 8876 "Data_Request_Message_0xAC22 " 9132 "Data_Request_Message_0xAC23 " 9388 "Data_Request_Message_0xAC24 " 9644 "Data_Request_Message_0xAC25 " 9900 "Data_Request_Message_0xAC26 " 10156 "Data_Request_Message_0xAC27 " 10412 "Data_Request_Message_0xAC28 " 10668 "Data_Request_Message_0xAC29 " 10924 "Data_Request_Message_0xAC2A " ;
VAL_ 2632932331 CmdBytePGN61184_HAD 172 "Data_Request_Message " 428 "Data_Request_Message_0xAC01 " 684 "Data_Request_Message_0xAC02 " 940 "Data_Request_Message_0xAC03 " 1196 "Data_Request_Message_0xAC04 " 1452 "Data_Request_Message_0xAC05 " 1708 "Data_Request_Message_0xAC06 " 1964 "Data_Request_Message_0xAC07 " 2220 "Data_Request_Message_0xAC08 " 2476 "Data_Request_Message_0xAC09 " 2732 "Data_Request_Message_0xAC0A " 2988 "Data_Request_Message_0xAC0B " 3244 "Data_Request_Message_0xAC0C " 3500 "Data_Request_Message_0xAC0D " 3756 "Data_Request_Message_0xAC0E " 4012 "Data_Request_Message_0xAC0F " 4268 "Data_Request_Message_0xAC10 " 4524 "Data_Request_Message_0xAC11 " 4780 "Data_Request_Message_0xAC12 " 5036 "Data_Request_Message_0xAC13 " 5292 "Data_Request_Message_0xAC14 " 5548 "Data_Request_Message_0xAC15 " 5804 "Data_Request_Message_0xAC16 " 6060 "Data_Request_Message_0xAC17 " 6316 "Data_Request_Message_0xAC18 " 6572 "Data_Request_Message_0xAC19 " 6828 "Data_Request_Message_0xAC1A " 7084 "Data_Request_Message_0xAC1B " 7340 "Data_Request_Message_0xAC1C " 7596 "Data_Request_Message_0xAC1D " 7852 "Data_Request_Message_0xAC1E " 8108 "Data_Request_Message_0xAC1F " 8364 "Data_Request_Message_0xAC20 " 8620 "Data_Request_Message_0xAC21 " 8876 "Data_Request_Message_0xAC22 " 9132 "Data_Request_Message_0xAC23 " 9388 "Data_Request_Message_0xAC24 " 9644 "Data_Request_Message_0xAC25 " 9900 "Data_Request_Message_0xAC26 " 10156 "Data_Request_Message_0xAC27 " 10412 "Data_Request_Message_0xAC28 " 10668 "Data_Request_Message_0xAC29 " 10924 "Data_Request_Message_0xAC2A " ;
VAL_ 2632968954 CmdBytePGN61184_OBT_FA 172 "Data_Request_Message " 428 "Data_Request_Message_0xAC01 " 684 "Data_Request_Message_0xAC02 " 940 "Data_Request_Message_0xAC03 " 1196 "Data_Request_Message_0xAC04 " 1452 "Data_Request_Message_0xAC05 " 1708 "Data_Request_Message_0xAC06 " 1964 "Data_Request_Message_0xAC07 " 2220 "Data_Request_Message_0xAC08 " 2476 "Data_Request_Message_0xAC09 " 2732 "Data_Request_Message_0xAC0A " 2988 "Data_Request_Message_0xAC0B " 3244 "Data_Request_Message_0xAC0C " 3500 "Data_Request_Message_0xAC0D " 3756 "Data_Request_Message_0xAC0E " 4012 "Data_Request_Message_0xAC0F " 4268 "Data_Request_Message_0xAC10 " 4524 "Data_Request_Message_0xAC11 " 4780 "Data_Request_Message_0xAC12 " 5036 "Data_Request_Message_0xAC13 " 5292 "Data_Request_Message_0xAC14 " 5548 "Data_Request_Message_0xAC15 " 5804 "Data_Request_Message_0xAC16 " 6060 "Data_Request_Message_0xAC17 " 6316 "Data_Request_Message_0xAC18 " 6572 "Data_Request_Message_0xAC19 " 6828 "Data_Request_Message_0xAC1A " 7084 "Data_Request_Message_0xAC1B " 7340 "Data_Request_Message_0xAC1C " 7596 "Data_Request_Message_0xAC1D " 7852 "Data_Request_Message_0xAC1E " 8108 "Data_Request_Message_0xAC1F " 8364 "Data_Request_Message_0xAC20 " 8620 "Data_Request_Message_0xAC21 " 8876 "Data_Request_Message_0xAC22 " 9132 "Data_Request_Message_0xAC23 " 9388 "Data_Request_Message_0xAC24 " 9644 "Data_Request_Message_0xAC25 " 9900 "Data_Request_Message_0xAC26 " 10156 "Data_Request_Message_0xAC27 " 10412 "Data_Request_Message_0xAC28 " 10668 "Data_Request_Message_0xAC29 " 10924 "Data_Request_Message_0xAC2A " ;
VAL_ 2632969210 CmdBytePGN61184_OBT_FA 172 "Data_Request_Message " 428 "Data_Request_Message_0xAC01 " 684 "Data_Request_Message_0xAC02 " 940 "Data_Request_Message_0xAC03 " 1196 "Data_Request_Message_0xAC04 " 1452 "Data_Request_Message_0xAC05 " 1708 "Data_Request_Message_0xAC06 " 1964 "Data_Request_Message_0xAC07 " 2220 "Data_Request_Message_0xAC08 " 2476 "Data_Request_Message_0xAC09 " 2732 "Data_Request_Message_0xAC0A " 2988 "Data_Request_Message_0xAC0B " 3244 "Data_Request_Message_0xAC0C " 3500 "Data_Request_Message_0xAC0D " 3756 "Data_Request_Message_0xAC0E " 4012 "Data_Request_Message_0xAC0F " 4268 "Data_Request_Message_0xAC10 " 4524 "Data_Request_Message_0xAC11 " 4780 "Data_Request_Message_0xAC12 " 5036 "Data_Request_Message_0xAC13 " 5292 "Data_Request_Message_0xAC14 " 5548 "Data_Request_Message_0xAC15 " 5804 "Data_Request_Message_0xAC16 " 6060 "Data_Request_Message_0xAC17 " 6316 "Data_Request_Message_0xAC18 " 6572 "Data_Request_Message_0xAC19 " 6828 "Data_Request_Message_0xAC1A " 7084 "Data_Request_Message_0xAC1B " 7340 "Data_Request_Message_0xAC1C " 7596 "Data_Request_Message_0xAC1D " 7852 "Data_Request_Message_0xAC1E " 8108 "Data_Request_Message_0xAC1F " 8364 "Data_Request_Message_0xAC20 " 8620 "Data_Request_Message_0xAC21 " 8876 "Data_Request_Message_0xAC22 " 9132 "Data_Request_Message_0xAC23 " 9388 "Data_Request_Message_0xAC24 " 9644 "Data_Request_Message_0xAC25 " 9900 "Data_Request_Message_0xAC26 " 10156 "Data_Request_Message_0xAC27 " 10412 "Data_Request_Message_0xAC28 " 10668 "Data_Request_Message_0xAC29 " 10924 "Data_Request_Message_0xAC2A " ;
VAL_ 2632932346 CmdBytePGN61184_OBT_FA 172 "Data_Request_Message " 428 "Data_Request_Message_0xAC01 " 684 "Data_Request_Message_0xAC02 " 940 "Data_Request_Message_0xAC03 " 1196 "Data_Request_Message_0xAC04 " 1452 "Data_Request_Message_0xAC05 " 1708 "Data_Request_Message_0xAC06 " 1964 "Data_Request_Message_0xAC07 " 2220 "Data_Request_Message_0xAC08 " 2476 "Data_Request_Message_0xAC09 " 2732 "Data_Request_Message_0xAC0A " 2988 "Data_Request_Message_0xAC0B " 3244 "Data_Request_Message_0xAC0C " 3500 "Data_Request_Message_0xAC0D " 3756 "Data_Request_Message_0xAC0E " 4012 "Data_Request_Message_0xAC0F " 4268 "Data_Request_Message_0xAC10 " 4524 "Data_Request_Message_0xAC11 " 4780 "Data_Request_Message_0xAC12 " 5036 "Data_Request_Message_0xAC13 " 5292 "Data_Request_Message_0xAC14 " 5548 "Data_Request_Message_0xAC15 " 5804 "Data_Request_Message_0xAC16 " 6060 "Data_Request_Message_0xAC17 " 6316 "Data_Request_Message_0xAC18 " 6572 "Data_Request_Message_0xAC19 " 6828 "Data_Request_Message_0xAC1A " 7084 "Data_Request_Message_0xAC1B " 7340 "Data_Request_Message_0xAC1C " 7596 "Data_Request_Message_0xAC1D " 7852 "Data_Request_Message_0xAC1E " 8108 "Data_Request_Message_0xAC1F " 8364 "Data_Request_Message_0xAC20 " 8620 "Data_Request_Message_0xAC21 " 8876 "Data_Request_Message_0xAC22 " 9132 "Data_Request_Message_0xAC23 " 9388 "Data_Request_Message_0xAC24 " 9644 "Data_Request_Message_0xAC25 " 9900 "Data_Request_Message_0xAC26 " 10156 "Data_Request_Message_0xAC27 " 10412 "Data_Request_Message_0xAC28 " 10668 "Data_Request_Message_0xAC29 " 10924 "Data_Request_Message_0xAC2A " ;
VAL_ 2632968795 CmdBytePGN61184_POD 172 "Data_Request_Message " 428 "Data_Request_Message_0xAC01 " 684 "Data_Request_Message_0xAC02 " 940 "Data_Request_Message_0xAC03 " 1196 "Data_Request_Message_0xAC04 " 1452 "Data_Request_Message_0xAC05 " 1708 "Data_Request_Message_0xAC06 " 1964 "Data_Request_Message_0xAC07 " 2220 "Data_Request_Message_0xAC08 " 2476 "Data_Request_Message_0xAC09 " 2732 "Data_Request_Message_0xAC0A " 2988 "Data_Request_Message_0xAC0B " 3244 "Data_Request_Message_0xAC0C " 3500 "Data_Request_Message_0xAC0D " 3756 "Data_Request_Message_0xAC0E " 4012 "Data_Request_Message_0xAC0F " 4268 "Data_Request_Message_0xAC10 " 4524 "Data_Request_Message_0xAC11 " 4780 "Data_Request_Message_0xAC12 " 5036 "Data_Request_Message_0xAC13 " 5292 "Data_Request_Message_0xAC14 " 5548 "Data_Request_Message_0xAC15 " 5804 "Data_Request_Message_0xAC16 " 6060 "Data_Request_Message_0xAC17 " 6316 "Data_Request_Message_0xAC18 " 6572 "Data_Request_Message_0xAC19 " 6828 "Data_Request_Message_0xAC1A " 7084 "Data_Request_Message_0xAC1B " 7340 "Data_Request_Message_0xAC1C " 7596 "Data_Request_Message_0xAC1D " 7852 "Data_Request_Message_0xAC1E " 8108 "Data_Request_Message_0xAC1F " 8364 "Data_Request_Message_0xAC20 " 8620 "Data_Request_Message_0xAC21 " 8876 "Data_Request_Message_0xAC22 " 9132 "Data_Request_Message_0xAC23 " 9388 "Data_Request_Message_0xAC24 " 9644 "Data_Request_Message_0xAC25 " 9900 "Data_Request_Message_0xAC26 " 10156 "Data_Request_Message_0xAC27 " 10412 "Data_Request_Message_0xAC28 " 10668 "Data_Request_Message_0xAC29 " 10924 "Data_Request_Message_0xAC2A " ;
VAL_ 2632969051 CmdBytePGN61184_POD 172 "Data_Request_Message " 428 "Data_Request_Message_0xAC01 " 684 "Data_Request_Message_0xAC02 " 940 "Data_Request_Message_0xAC03 " 1196 "Data_Request_Message_0xAC04 " 1452 "Data_Request_Message_0xAC05 " 1708 "Data_Request_Message_0xAC06 " 1964 "Data_Request_Message_0xAC07 " 2220 "Data_Request_Message_0xAC08 " 2476 "Data_Request_Message_0xAC09 " 2732 "Data_Request_Message_0xAC0A " 2988 "Data_Request_Message_0xAC0B " 3244 "Data_Request_Message_0xAC0C " 3500 "Data_Request_Message_0xAC0D " 3756 "Data_Request_Message_0xAC0E " 4012 "Data_Request_Message_0xAC0F " 4268 "Data_Request_Message_0xAC10 " 4524 "Data_Request_Message_0xAC11 " 4780 "Data_Request_Message_0xAC12 " 5036 "Data_Request_Message_0xAC13 " 5292 "Data_Request_Message_0xAC14 " 5548 "Data_Request_Message_0xAC15 " 5804 "Data_Request_Message_0xAC16 " 6060 "Data_Request_Message_0xAC17 " 6316 "Data_Request_Message_0xAC18 " 6572 "Data_Request_Message_0xAC19 " 6828 "Data_Request_Message_0xAC1A " 7084 "Data_Request_Message_0xAC1B " 7340 "Data_Request_Message_0xAC1C " 7596 "Data_Request_Message_0xAC1D " 7852 "Data_Request_Message_0xAC1E " 8108 "Data_Request_Message_0xAC1F " 8364 "Data_Request_Message_0xAC20 " 8620 "Data_Request_Message_0xAC21 " 8876 "Data_Request_Message_0xAC22 " 9132 "Data_Request_Message_0xAC23 " 9388 "Data_Request_Message_0xAC24 " 9644 "Data_Request_Message_0xAC25 " 9900 "Data_Request_Message_0xAC26 " 10156 "Data_Request_Message_0xAC27 " 10412 "Data_Request_Message_0xAC28 " 10668 "Data_Request_Message_0xAC29 " 10924 "Data_Request_Message_0xAC2A " ;
VAL_ 2499803942 CmdBytePGN65531_VTV 39168 "DisplayToHeader_#1 " 39424 "DisplayToHeader_#2 " 39680 "DisplayToHeader_#3 " 1633 "HeaderHeightControlAutomationCommands " 11771 "Operator_System_Enable_States " ;
VAL_ 2499803942 HeadRaisLoweEngaContComm 0 " Engagement Control Undefined" 1 " Control Disengage" 2 " Control Engage" 14 " Error" 15 " Not Available" ;
VAL_ 2499803942 LadderAutomationState 0 " En_ExternalInterfaceBoolean_False" 1 " En_ExternalInterfaceBoolean_True" 2 " En_ExternalInterfaceBoolean_Error" 3 " En_ExternalInterfaceBoolean_NotAvailable" ;
VAL_ 2499803942 ActiEarSaveLinkUnliToggReq 0 " En_OnOff2States_Off" 1 " En_OnOff2States_On" 2 " En_OnOff2States_Error" 3 " En_OnOff2States_NotAvailable" ;
VAL_ 2499803942 LeftActiEarSaveEnabFromDisp 0 " En_ExternalInterfaceBoolean_False" 1 " En_ExternalInterfaceBoolean_True" 2 " En_ExternalInterfaceBoolean_Error" 3 " En_ExternalInterfaceBoolean_NotAvailable" ;
VAL_ 2499803942 RighActiEarSaveEnabFromDisp 0 " En_ExternalInterfaceBoolean_False" 1 " En_ExternalInterfaceBoolean_True" 2 " En_ExternalInterfaceBoolean_Error" 3 " En_ExternalInterfaceBoolean_NotAvailable" ;
VAL_ 2499803942 TerrFollAutoEnabStat 0 " En_OnOff2States_Off" 1 " En_OnOff2States_On" 2 " En_OnOff2States_Error" 3 " En_OnOff2States_NotAvailable" ;
VAL_ 2499803942 OpCtrlPreset2 0 " En_OnOff2States_Off" 1 " En_OnOff2States_On" 2 " En_OnOff2States_Error" 3 " En_OnOff2States_NotAvailable" ;
VAL_ 2499803942 OpCtrlPreset3 0 " En_OnOff2States_Off" 1 " En_OnOff2States_On" 2 " En_OnOff2States_Error" 3 " En_OnOff2States_NotAvailable" ;
VAL_ 2649751345 CmdBytePGN126720_CAB 5 "DTC_Query_Request " 4 "DTC_Query_Response " ;
VAL_ 2649751496 CmdBytePGN126720_DC1 5 "DTC_Query_Request " 4 "DTC_Query_Response " ;
VAL_ 2649751530 CmdBytePGN126720_FED 5 "DTC_Query_Request " 4 "DTC_Query_Response " ;
VAL_ 2649751531 CmdBytePGN126720_HAD 5 "DTC_Query_Request " 4 "DTC_Query_Response " ;
VAL_ 2649751387 CmdBytePGN126720_POD 5 "DTC_Query_Request " 4 "DTC_Query_Response " ;
VAL_ 2649737265 CmdBytePGN126720_CAB 4 "DTC_Query_Response " ;
VAL_ 2649745969 CmdBytePGN126720_CAB 4 "DTC_Query_Response " ;
VAL_ 2649746225 CmdBytePGN126720_CAB 4 "DTC_Query_Response " ;
VAL_ 2649709361 CmdBytePGN126720_CAB 4 "DTC_Query_Response " ;
VAL_ 2649698760 CmdBytePGN126720_DC1 4 "DTC_Query_Response " ;
VAL_ 2649746120 CmdBytePGN126720_DC1 4 "DTC_Query_Response " ;
VAL_ 2649746376 CmdBytePGN126720_DC1 4 "DTC_Query_Response " ;
VAL_ 2649709512 CmdBytePGN126720_DC1 4 "DTC_Query_Response " ;
VAL_ 2649698794 CmdBytePGN126720_FED 4 "DTC_Query_Response " ;
VAL_ 2649737450 CmdBytePGN126720_FED 4 "DTC_Query_Response " ;
VAL_ 2649746410 CmdBytePGN126720_FED 4 "DTC_Query_Response " ;
VAL_ 2649709546 CmdBytePGN126720_FED 4 "DTC_Query_Response " ;
VAL_ 2649698795 CmdBytePGN126720_HAD 4 "DTC_Query_Response " ;
VAL_ 2649737451 CmdBytePGN126720_HAD 4 "DTC_Query_Response " ;
VAL_ 2649746155 CmdBytePGN126720_HAD 4 "DTC_Query_Response " ;
VAL_ 2649709547 CmdBytePGN126720_HAD 4 "DTC_Query_Response " ;
VAL_ 2649698651 CmdBytePGN126720_POD 4 "DTC_Query_Response " ;
VAL_ 2649737307 CmdBytePGN126720_POD 4 "DTC_Query_Response " ;
VAL_ 2649746011 CmdBytePGN126720_POD 4 "DTC_Query_Response " ;
VAL_ 2649746267 CmdBytePGN126720_POD 4 "DTC_Query_Response " ;
VAL_ 2298477310 CmdBytePGN65530_Vector_XXX 22529 "EASEventDetectionInformation " ;
VAL_ 2298477310 EventDetectionStatus 0 " En_SlipDetection_NoEventDetected" 1 " En_SlipDetection_EventDetected" 254 " En_SlipDetection_Error" 255 " En_SlipDetection_NotAvailable" ;
VAL_ 2565865265 CmdBytePGN61184_CAB 41572 "EgressConfigurableLightingCommand " 9458 "EngineStartControl " 8440 "EngineStartingShutdownRequest " 41060 "Field1ConfigurableLightingCommand " 41316 "Field2ConfigurableLightingCommand " 7922 "JD_ACKnowledgement " 25956 "LightingSupervisorCommandMessage1 " 26212 "LightingSupervisorFlashRateMessage1 " 26468 "LightingSupervisorPriorityMessage1 " 752 "OperatorControlsA1Command " 2288 "OperatorControlsB2Command " 3312 "OperatorControlsB3Command " 13300 "OperatorControlsB5Command " 14324 "OperatorControlsB6Command " 241 "Prop_Request_PGN_Dual_Cmd_Byte " 219 "Prop_Request_PGN_Single_Cmd_Byte " 27236 "SyncSignalsMessage " ;
VAL_ 2565865265 OpCtrlA1CmdByte3BitPair12 0 " En_OnOff2States_Off" 1 " En_OnOff2States_On" 2 " En_OnOff2States_Error" 3 " En_OnOff2States_NotAvailable" ;
VAL_ 2565865265 OpCtrlA1CmdByte3BitPair56 0 " En_OnOff2States_Off" 1 " En_OnOff2States_On" 2 " En_OnOff2States_Error" 3 " En_OnOff2States_NotAvailable" ;
VAL_ 2565865265 OpCtrlA1CmdByte4BitPair12 0 " En_OnOff2States_Off" 1 " En_OnOff2States_On" 2 " En_OnOff2States_Error" 3 " En_OnOff2States_NotAvailable" ;
VAL_ 2565865265 OpCtrlA1CmdByte4BitPair34 0 " En_OnOff2States_Off" 1 " En_OnOff2States_On" 2 " En_OnOff2States_Error" 3 " En_OnOff2States_NotAvailable" ;
VAL_ 2565865265 OpCtrlA1CmdByte4BitPair56 0 " En_OnOff2States_Off" 1 " En_OnOff2States_On" 2 " En_OnOff2States_Error" 3 " En_OnOff2States_NotAvailable" ;
VAL_ 2565865265 OpCtrlA1CmdByte4BitPair78 0 " En_OnOff2States_Off" 1 " En_OnOff2States_On" 2 " En_OnOff2States_Error" 3 " En_OnOff2States_NotAvailable" ;
VAL_ 2565865265 OpCtrlA1CmdByte5BitPair12 0 " En_OnOff2States_Off" 1 " En_OnOff2States_On" 2 " En_OnOff2States_Error" 3 " En_OnOff2States_NotAvailable" ;
VAL_ 2565865265 OpCtrlA1CmdByte5BitPair34 0 " En_OnOff2States_Off" 1 " En_OnOff2States_On" 2 " En_OnOff2States_Error" 3 " En_OnOff2States_NotAvailable" ;
VAL_ 2565865265 OpCtrlA1CmdByte5BitPair78 0 " En_OnOff2States_Off" 1 " En_OnOff2States_On" 2 " En_OnOff2States_Error" 3 " En_OnOff2States_NotAvailable" ;
VAL_ 2565865265 OpCtrlA1CmdByte6BitPair12 0 " En_OnOff2States_Off" 1 " En_OnOff2States_On" 2 " En_OnOff2States_Error" 3 " En_OnOff2States_NotAvailable" ;
VAL_ 2565865265 OpCtrlB2CmdByte3BitQuad14 0 " DEM_bit_state_0" 1 " DEM_bit_state_1" 2 " DEM_bit_state_2" 3 " DEM_bit_state_3" 4 " DEM_bit_state_4" 5 " DEM_bit_state_5" 6 " DEM_bit_state_6" 7 " DEM_bit_state_7" 14 " DEM_Error" 15 " DEM_Not_available_or_not_installed" ;
VAL_ 2565865265 OpCtrlB2CmdByte4BitQuad14 0 " DEM_bit_state_0" 1 " DEM_bit_state_1" 2 " DEM_bit_state_2" 3 " DEM_bit_state_3" 4 " DEM_bit_state_4" 5 " DEM_bit_state_5" 6 " DEM_bit_state_6" 7 " DEM_bit_state_7" 14 " DEM_Error" 15 " DEM_Not_available_or_not_installed" ;
VAL_ 2565865265 OpCtrlB2CmdByte4BitQuad58 0 " DEM_bit_state_0" 1 " DEM_bit_state_1" 2 " DEM_bit_state_2" 3 " DEM_bit_state_3" 4 " DEM_bit_state_4" 5 " DEM_bit_state_5" 6 " DEM_bit_state_6" 7 " DEM_bit_state_7" 14 " DEM_Error" 15 " DEM_Not_available_or_not_installed" ;
VAL_ 2565865265 OpCtrlB2CmdByte5BitQuad14 0 " DEM_bit_state_0" 1 " DEM_bit_state_1" 2 " DEM_bit_state_2" 3 " DEM_bit_state_3" 4 " DEM_bit_state_4" 5 " DEM_bit_state_5" 6 " DEM_bit_state_6" 7 " DEM_bit_state_7" 14 " DEM_Error" 15 " DEM_Not_available_or_not_installed" ;
VAL_ 2565865265 OpCtrlB2CmdByte5BitQuad58 0 " DEM_bit_state_0" 1 " DEM_bit_state_1" 2 " DEM_bit_state_2" 3 " DEM_bit_state_3" 4 " DEM_bit_state_4" 5 " DEM_bit_state_5" 6 " DEM_bit_state_6" 7 " DEM_bit_state_7" 14 " DEM_Error" 15 " DEM_Not_available_or_not_installed" ;
VAL_ 2565865265 OpCtrlB2CmdByte8BitQuad14 0 " DEM_bit_state_0" 1 " DEM_bit_state_1" 2 " DEM_bit_state_2" 3 " DEM_bit_state_3" 4 " DEM_bit_state_4" 5 " DEM_bit_state_5" 6 " DEM_bit_state_6" 7 " DEM_bit_state_7" 14 " DEM_Error" 15 " DEM_Not_available_or_not_installed" ;
VAL_ 2565865265 OpCtrlB2CmdByte8BitQuad58 0 " DEM_bit_state_0" 1 " DEM_bit_state_1" 2 " DEM_bit_state_2" 3 " DEM_bit_state_3" 4 " DEM_bit_state_4" 5 " DEM_bit_state_5" 6 " DEM_bit_state_6" 7 " DEM_bit_state_7" 14 " DEM_Error" 15 " DEM_Not_available_or_not_installed" ;
VAL_ 2565865265 OpCtrlB3CmdByte3BitQuad14 0 " bit_state_0" 1 " bit_state_1" 2 " bit_state_2" 3 " bit_state_3" 4 " bit_state_4" 5 " bit_state_5" 6 " bit_state_6" 7 " bit_state_7" 8 " bit_state_8" 14 " Error" 15 " Not_available_or_not_installed" ;
VAL_ 2565865265 OpCtrlB3CmdByte3BitQuad58 0 " bit_state_0" 1 " bit_state_1" 2 " bit_state_2" 3 " bit_state_3" 4 " bit_state_4" 5 " bit_state_5" 6 " bit_state_6" 7 " bit_state_7" 8 " bit_state_8" 14 " Error" 15 " Not_available_or_not_installed" ;
VAL_ 2565865265 OpCtrlB3CmdByte4BitQuad14 0 " bit_state_0" 1 " bit_state_1" 2 " bit_state_2" 3 " bit_state_3" 4 " bit_state_4" 5 " bit_state_5" 6 " bit_state_6" 7 " bit_state_7" 8 " bit_state_8" 14 " Error" 15 " Not_available_or_not_installed" ;
VAL_ 2565865265 OpCtrlB3CmdByte4BitQuad58 0 " bit_state_0" 1 " bit_state_1" 2 " bit_state_2" 3 " bit_state_3" 4 " bit_state_4" 5 " bit_state_5" 6 " bit_state_6" 7 " bit_state_7" 8 " bit_state_8" 14 " Error" 15 " Not_available_or_not_installed" ;
VAL_ 2565865265 OpCtrlB3CmdByte5BitQuad14 0 " bit_state_0" 1 " bit_state_1" 2 " bit_state_2" 3 " bit_state_3" 4 " bit_state_4" 5 " bit_state_5" 6 " bit_state_6" 7 " bit_state_7" 8 " bit_state_8" 14 " Error" 15 " Not_available_or_not_installed" ;
VAL_ 2565865265 OpCtrlB3CmdByte6BitQuad14 0 " bit_state_0" 1 " bit_state_1" 2 " bit_state_2" 3 " bit_state_3" 4 " bit_state_4" 5 " bit_state_5" 6 " bit_state_6" 7 " bit_state_7" 8 " bit_state_8" 14 " Error" 15 " Not_available_or_not_installed" ;
VAL_ 2565865265 OpCtrlB3CmdByte6BitQuad58 0 " bit_state_0" 1 " bit_state_1" 2 " bit_state_2" 3 " bit_state_3" 4 " bit_state_4" 5 " bit_state_5" 6 " bit_state_6" 7 " bit_state_7" 8 " bit_state_8" 14 " Error" 15 " Not_available_or_not_installed" ;
VAL_ 2565865265 OpCtrlB3CmdByte7BitQuad14 0 " bit_state_0" 1 " bit_state_1" 2 " bit_state_2" 3 " bit_state_3" 4 " bit_state_4" 5 " bit_state_5" 6 " bit_state_6" 7 " bit_state_7" 8 " bit_state_8" 14 " Error" 15 " Not_available_or_not_installed" ;
VAL_ 2565865265 OpCtrlB3CmdByte7BitQuad58 0 " bit_state_0" 1 " bit_state_1" 2 " bit_state_2" 3 " bit_state_3" 4 " bit_state_4" 5 " bit_state_5" 6 " bit_state_6" 7 " bit_state_7" 8 " bit_state_8" 14 " Error" 15 " Not_available_or_not_installed" ;
VAL_ 2565865265 OpCtrlB3CmdByte8BitQuad14 0 " bit_state_0" 1 " bit_state_1" 2 " bit_state_2" 3 " bit_state_3" 4 " bit_state_4" 5 " bit_state_5" 6 " bit_state_6" 7 " bit_state_7" 8 " bit_state_8" 14 " Error" 15 " Not_available_or_not_installed" ;
VAL_ 2565865265 OpCtrlB3CmdByte8BitQuad58 0 " bit_state_0" 1 " bit_state_1" 2 " bit_state_2" 3 " bit_state_3" 4 " bit_state_4" 5 " bit_state_5" 6 " bit_state_6" 7 " bit_state_7" 8 " bit_state_8" 14 " Error" 15 " Not_available_or_not_installed" ;
VAL_ 2565865265 EngineDesiredOperatingState 0 " StopEngine" 1 " StartEngine" 2 " RunEngine" 3 " VehicleAutoStartStop" 4 " StarterTestMode" 14 " Reserved" 15 " NotAvailable" ;
VAL_ 2565865265 EngStartCtrl 0 " DEM_Off" 1 " DEM_On" 2 " DEM_Reserved__Stds" 3 " DEM_Dont_caretake_no_action" ;
VAL_ 2565865265 EngStarterStatus 0 " DEM_Start_not_requested" 1 " DEM_Starter_not_active_gear_not_engaged" 2 " DEM_Starter_active_gear_engaged" 3 " DEM_Start_finished" 4 " DEM_Starter_inhibited_due_to_engine_already_running" 5 " DEM_Starter_inhibited_due_to_engine_not_ready_for_start_preheating" 6 " DEM_Starter_inhibited_due_to_driveline_engaged_or_other_transmission_inhibit" 7 " DEM_Starter_inhibited_due_to_active_immobilizer" 8 " DEM_Start_inhibited_due_to_starter_overtemp" 9 " DEM_Not_defined_9" 10 " DEM_Not_defined_10" 11 " DEM_Not_defined_11" 12 " DEM_Starter_inhibited__reason_unknown" 13 " DEM_Error_legacy_implementation_only_use_1110_instead" 14 " DEM_Error" 15 " DEM_Not_available" ;
VAL_ 2565865265 OpCtrlB5CmdByte4BitQuad58 0 " DEM_bit_state_0" 1 " DEM_bit_state_1" 2 " DEM_bit_state_2" 3 " DEM_bit_state_3" 4 " DEM_bit_state_4" 5 " DEM_bit_state_5" 6 " DEM_bit_state_6" 7 " DEM_bit_state_7" 14 " DEM_Error" 15 " DEM_Not_available_or_not_installed" ;
VAL_ 2565865265 OpCtrlB5CmdByte5BitQuad14 0 " DEM_bit_state_0" 1 " DEM_bit_state_1" 2 " DEM_bit_state_2" 3 " DEM_bit_state_3" 4 " DEM_bit_state_4" 5 " DEM_bit_state_5" 6 " DEM_bit_state_6" 7 " DEM_bit_state_7" 14 " DEM_Error" 15 " DEM_Not_available_or_not_installed" ;
VAL_ 2565865265 OpCtrlB5CmdByte5BitQuad58 0 " DEM_bit_state_0" 1 " DEM_bit_state_1" 2 " DEM_bit_state_2" 3 " DEM_bit_state_3" 4 " DEM_bit_state_4" 5 " DEM_bit_state_5" 6 " DEM_bit_state_6" 7 " DEM_bit_state_7" 14 " DEM_Error" 15 " DEM_Not_available_or_not_installed" ;
VAL_ 2565865265 OpCtrlB5CmdByte6BitQuad14 0 " DEM_bit_state_0" 1 " DEM_bit_state_1" 2 " DEM_bit_state_2" 3 " DEM_bit_state_3" 4 " DEM_bit_state_4" 5 " DEM_bit_state_5" 6 " DEM_bit_state_6" 7 " DEM_bit_state_7" 14 " DEM_Error" 15 " DEM_Not_available_or_not_installed" ;
VAL_ 2565865265 OpCtrlB5CmdByte6BitQuad58 0 " DEM_bit_state_0" 1 " DEM_bit_state_1" 2 " DEM_bit_state_2" 3 " DEM_bit_state_3" 4 " DEM_bit_state_4" 5 " DEM_bit_state_5" 6 " DEM_bit_state_6" 7 " DEM_bit_state_7" 14 " DEM_Error" 15 " DEM_Not_available_or_not_installed" ;
VAL_ 2565865265 OpCtrlB5CmdByte7BitQuad14 0 " DEM_bit_state_0" 1 " DEM_bit_state_1" 2 " DEM_bit_state_2" 3 " DEM_bit_state_3" 4 " DEM_bit_state_4" 5 " DEM_bit_state_5" 6 " DEM_bit_state_6" 7 " DEM_bit_state_7" 14 " DEM_Error" 15 " DEM_Not_available_or_not_installed" ;
VAL_ 2565865265 OpCtrlB5CmdByte7BitQuad58 0 " DEM_bit_state_0" 1 " DEM_bit_state_1" 2 " DEM_bit_state_2" 3 " DEM_bit_state_3" 4 " DEM_bit_state_4" 5 " DEM_bit_state_5" 6 " DEM_bit_state_6" 7 " DEM_bit_state_7" 14 " DEM_Error" 15 " DEM_Not_available_or_not_installed" ;
VAL_ 2565865265 OpCtrlB5CmdByte8BitQuad14 0 " DEM_bit_state_0" 1 " DEM_bit_state_1" 2 " DEM_bit_state_2" 3 " DEM_bit_state_3" 4 " DEM_bit_state_4" 5 " DEM_bit_state_5" 6 " DEM_bit_state_6" 7 " DEM_bit_state_7" 14 " DEM_Error" 15 " DEM_Not_available_or_not_installed" ;
VAL_ 2565865265 OpCtrlB5CmdByte8BitQuad58 0 " DEM_bit_state_0" 1 " DEM_bit_state_1" 2 " DEM_bit_state_2" 3 " DEM_bit_state_3" 4 " DEM_bit_state_4" 5 " DEM_bit_state_5" 6 " DEM_bit_state_6" 7 " DEM_bit_state_7" 14 " DEM_Error" 15 " DEM_Not_available_or_not_installed" ;
VAL_ 2565865265 OpCtrlB6CmdByte3BitQuad14 0 " DEM_bit_state_0" 1 " DEM_bit_state_1" 2 " DEM_bit_state_2" 3 " DEM_bit_state_3" 4 " DEM_bit_state_4" 5 " DEM_bit_state_5" 6 " DEM_bit_state_6" 7 " DEM_bit_state_7" 14 " DEM_Error" 15 " DEM_Not_available_or_not_installed" ;
VAL_ 2565865265 BrakeLightsCommand 0 " DEM_Off" 1 " DEM_On" 2 " DEM_Flash" 14 " DEM_Error" 15 " DEM_Not_available" ;
VAL_ 2565865265 BeaconLightsCommand 0 " DEM_Off" 1 " DEM_On" 2 " DEM_Flash" 14 " DEM_Error" 15 " DEM_Not_available" ;
VAL_ 2565865265 LeftMarkerLightsCommand 0 " DEM_Off" 1 " DEM_On" 2 " DEM_Flash" 14 " DEM_Error" 15 " DEM_Not_available" ;
VAL_ 2565865265 LeftFlasherLightsCommand 0 " DEM_Off" 1 " DEM_On" 2 " DEM_Flash" 14 " DEM_Error" 15 " DEM_Not_available" ;
VAL_ 2565865265 RightFlasherLightsCommand 0 " DEM_Off" 1 " DEM_On" 2 " DEM_Flash" 14 " DEM_Error" 15 " DEM_Not_available" ;
VAL_ 2565865265 FlasherLightsPriority 75 " Marker Lights" 85 " Stubble Lights" 105 " Beacon Lights" 120 " Brakes As Turn Light" 125 " Hazard Lights" 130 " Turn Lights" 135 " Brakes Not As Turn Light" 200 " Rotational Alarm" 254 " Error" 255 " Not available" ;
VAL_ 2565865265 SyncSignal1 0 " En_OnOff2States_Off" 1 " En_OnOff2States_On" 2 " En_OnOff2States_Error" 3 " En_OnOff2States_NotAvailable" ;
VAL_ 2565865265 CANField1VehSpcFrontLight1 0 " RecfgbleLtgOptnAllOFF" 1 " RecfgbleLtgOptnLEFTOnly" 2 " RecfgbleLtgOptnRIGHTOnly" 3 " RecfgbleLtgOptnAllON" 14 " RecfgbleLtgOptnError" 15 " RecfgbleLtgOptnNotAvailable" ;
VAL_ 2565865265 CANField1VehSpcSideLight1 0 " RecfgbleLtgOptnAllOFF" 1 " RecfgbleLtgOptnLEFTOnly" 2 " RecfgbleLtgOptnRIGHTOnly" 3 " RecfgbleLtgOptnAllON" 14 " RecfgbleLtgOptnError" 15 " RecfgbleLtgOptnNotAvailable" ;
VAL_ 2565865265 CANField1VehSpcRearLight1 0 " RecfgbleLtgOptnAllOFF" 1 " RecfgbleLtgOptnLEFTOnly" 2 " RecfgbleLtgOptnRIGHTOnly" 3 " RecfgbleLtgOptnAllON" 14 " RecfgbleLtgOptnError" 15 " RecfgbleLtgOptnNotAvailable" ;
VAL_ 2565865265 CANField2VehSpcFrontLight1 0 " RecfgbleLtgOptnAllOFF" 1 " RecfgbleLtgOptnLEFTOnly" 2 " RecfgbleLtgOptnRIGHTOnly" 3 " RecfgbleLtgOptnAllON" 14 " RecfgbleLtgOptnError" 15 " RecfgbleLtgOptnNotAvailable" ;
VAL_ 2565865265 CANField2VehSpcSideLight1 0 " RecfgbleLtgOptnAllOFF" 1 " RecfgbleLtgOptnLEFTOnly" 2 " RecfgbleLtgOptnRIGHTOnly" 3 " RecfgbleLtgOptnAllON" 14 " RecfgbleLtgOptnError" 15 " RecfgbleLtgOptnNotAvailable" ;
VAL_ 2565865265 CANField2VehSpcRearLight1 0 " RecfgbleLtgOptnAllOFF" 1 " RecfgbleLtgOptnLEFTOnly" 2 " RecfgbleLtgOptnRIGHTOnly" 3 " RecfgbleLtgOptnAllON" 14 " RecfgbleLtgOptnError" 15 " RecfgbleLtgOptnNotAvailable" ;
VAL_ 2565865265 CANEgressVehSpcFrontLight1 0 " RecfgbleLtgOptnAllOFF" 1 " RecfgbleLtgOptnLEFTOnly" 2 " RecfgbleLtgOptnRIGHTOnly" 3 " RecfgbleLtgOptnAllON" 14 " RecfgbleLtgOptnError" 15 " RecfgbleLtgOptnNotAvailable" ;
VAL_ 2565865265 CANEgressVehSpcSideLight1 0 " RecfgbleLtgOptnAllOFF" 1 " RecfgbleLtgOptnLEFTOnly" 2 " RecfgbleLtgOptnRIGHTOnly" 3 " RecfgbleLtgOptnAllON" 14 " RecfgbleLtgOptnError" 15 " RecfgbleLtgOptnNotAvailable" ;
VAL_ 2565865265 CANEgressVehSpcRearLight1 0 " RecfgbleLtgOptnAllOFF" 1 " RecfgbleLtgOptnLEFTOnly" 2 " RecfgbleLtgOptnRIGHTOnly" 3 " RecfgbleLtgOptnAllON" 14 " RecfgbleLtgOptnError" 15 " RecfgbleLtgOptnNotAvailable" ;
