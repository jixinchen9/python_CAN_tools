VERSION ""

NS_ :

BS_ :

BU_ : ATX ECU EIC PBS PDC PDE PTP

BO_ 2566912003 ContDispPoweMana3_PBS: 8 PBS
 SG_ CmdBytePGN65528_PBS M : 0|8@1+ (1,0) [0|0] ""  Vector__XXX

BO_ 2566912191 ContDispPoweMana3_PDE: 8 PDE
 SG_ CmdBytePGN65528_PDE M : 0|8@1+ (1,0) [0|0] ""  Vector__XXX

BO_ 2632974083 Mx_EFFF_P7_0x03: 8 PBS
 SG_ CmdBytePGN61184_PBS M : 0|16@1+ (1,0) [0|0] ""  Vector__XXX

BO_ 2634021567 ControllerHealthInfo_PDE: 8 PDE
 SG_ CmdBytePGN65530_PDE M : 0|16@1+ (1,0) [0|0] ""  Vector__XXX
 SG_ ControllerInfoFrame m11520 : 16|8@1+ (1,0) [0|0] ""  Vector__XXX

BO_ 2649751296 Mx_EFFF_P7_0x00: 8 ECU
 SG_ CmdBytePGN126720_ECU M : 0|8@1+ (1,0) [0|0] ""  Vector__XXX

BO_ 2649751299 Mx_EFFF_P7_0x03: 8 PBS
 SG_ CmdBytePGN126720_PBS M : 0|8@1+ (1,0) [0|0] ""  Vector__XXX

BO_ 2649751538 Mx_EFFF_P7_0xF2: 8 PDC
 SG_ CmdBytePGN126720_PDC M : 0|8@1+ (1,0) [0|0] ""  Vector__XXX

BO_ 2649751487 Mx_EFFF_P7_0xBF: 8 PDE
 SG_ CmdBytePGN126720_PDE M : 0|8@1+ (1,0) [0|0] ""  Vector__XXX

BO_ 2649686784 DTC_Query_Response_TX_ECU_RX_PBS: 8 ECU
 SG_ CmdBytePGN126720_ECU M : 0|8@1+ (1,0) [0|0] ""  Vector__XXX

BO_ 2649747968 DTC_Query_Response_TX_ECU_RX_PDC: 8 ECU
 SG_ CmdBytePGN126720_ECU M : 0|8@1+ (1,0) [0|0] ""  Vector__XXX

BO_ 2649734912 DTC_Query_Response_TX_ECU_RX_PDE: 8 ECU
 SG_ CmdBytePGN126720_ECU M : 0|8@1+ (1,0) [0|0] ""  Vector__XXX

BO_ 2649686019 DTC_Query_Response_TX_PBS_RX_ECU: 8 PBS
 SG_ CmdBytePGN126720_PBS M : 0|8@1+ (1,0) [0|0] ""  Vector__XXX

BO_ 2649747971 DTC_Query_Response_TX_PBS_RX_PDC: 8 PBS
 SG_ CmdBytePGN126720_PBS M : 0|8@1+ (1,0) [0|0] ""  Vector__XXX

BO_ 2649734915 DTC_Query_Response_TX_PBS_RX_PDE: 8 PBS
 SG_ CmdBytePGN126720_PBS M : 0|8@1+ (1,0) [0|0] ""  Vector__XXX

BO_ 2649686258 DTC_Query_Response_TX_PDC_RX_ECU: 8 PDC
 SG_ CmdBytePGN126720_PDC M : 0|8@1+ (1,0) [0|0] ""  Vector__XXX

BO_ 2649687026 DTC_Query_Response_TX_PDC_RX_PBS: 8 PDC
 SG_ CmdBytePGN126720_PDC M : 0|8@1+ (1,0) [0|0] ""  Vector__XXX

BO_ 2649735154 DTC_Query_Response_TX_PDC_RX_PDE: 8 PDC
 SG_ CmdBytePGN126720_PDC M : 0|8@1+ (1,0) [0|0] ""  Vector__XXX

BO_ 2649686207 DTC_Query_Response_TX_PDE_RX_ECU: 8 PDE
 SG_ CmdBytePGN126720_PDE M : 0|8@1+ (1,0) [0|0] ""  Vector__XXX

BO_ 2649686975 DTC_Query_Response_TX_PDE_RX_PBS: 8 PDE
 SG_ CmdBytePGN126720_PDE M : 0|8@1+ (1,0) [0|0] ""  Vector__XXX

BO_ 2649748159 DTC_Query_Response_TX_PDE_RX_PDC: 8 PDE
 SG_ CmdBytePGN126720_PDE M : 0|8@1+ (1,0) [0|0] ""  Vector__XXX

BO_ 2230255622 ElecFlexRequMess_EIC: 8 EIC
 SG_ CmdBytePGN61184_EIC M : 0|16@1+ (1,0) [0|0] ""  ECU
 SG_ FlexpwrCounter m5476 : 16|4@1+ (1,0) [0|15] "Count"  ECU
 SG_ SpeedThrottleControlCommand m5476 : 20|2@1+ (1,0) [0|3] ""  ECU
 SG_ GovCntrlSlct m5476 : 22|2@1+ (1,0) [0|3] ""  ECU
 SG_ GovernorRequest m5476 : 24|4@1+ (1,0) [0|15] ""  ECU
 SG_ TorqCrvReq m5476 : 28|4@1+ (1,0) [0|15] ""  ECU
 SG_ FlexpwrReq m5476 : 32|16@1+ (6.1E-05,0) [0|3.9218] ""  ECU
 SG_ FlexpwrSpeedThrottleRequest m5476 : 48|16@1+ (0.25,0) [0|0] ""  ECU

BO_ 2565865458 Mx_EFFF_P6_0xF2: 8 PDC
 SG_ CmdBytePGN61184_PDC M : 0|16@1+ (1,0) [0|0] ""  ECU,PBS,PTP,PDE
 SG_ PGNRqstProp m219 : 16|24@1+ (1,0) [0|0] ""  ECU,PBS,PDE
 SG_ REQPGNCMDBYTE1 m219 : 40|8@1+ (1,0) [0|0] ""  ECU,PBS,PDE
 SG_ PGNRqstProp m241 : 16|24@1+ (1,0) [0|0] ""  ECU,PBS,PDE
 SG_ REQPGNCMDBYTE1 m241 : 40|8@1+ (1,0) [0|0] ""  ECU,PBS,PDE
 SG_ REQPGNCMDBYTE2 m241 : 48|8@1+ (1,0) [0|0] ""  ECU,PBS,PDE
 SG_ IOExpOutputPinCtrlReq1DutyCycle m1276 : 16|16@1+ (0.1,0) [0|100] ""  ECU
 SG_ IOExpOutputPinCtrlReq1Frequency m1276 : 32|16@1+ (0.1,0) [0|1000] ""  ECU
 SG_ EngExstTempMgmtElevIdleAllow m12786 : 32|2@1+ (1,0) [0|3] ""  ECU
 SG_ EngDPFActRegAllow m12786 : 36|2@1+ (1,0) [0|3] ""  ECU
 SG_ DslPartFltrRegInhbtSwtch m12786 : 40|2@1+ (1,0) [0|3] ""  ECU
 SG_ DslPartFltrRegenFrceSwtch m12786 : 42|2@1+ (1,0) [0|3] ""  ECU
 SG_ ScndryBrakeCtrlVlv m22628 : 16|2@1+ (1,0) [0|3] ""  PBS,PTP
 SG_ KeySwitchStartToDriveTrain m22628 : 24|2@1+ (1,0) [0|3] ""  PBS,PTP
 SG_ KeySwitchRunToDriveTrain m22628 : 26|2@1+ (1,0) [0|3] ""  PBS,PTP
 SG_ HydHndlStateToDriveTrain m22628 : 32|3@1+ (1,0) [0|7] ""  PBS,PTP
 SG_ RoadFieldModeToDriveTrain m22628 : 35|2@1+ (1,0) [0|3] ""  PBS,PTP
 SG_ ScndryBrakeCtrlVlv2 m22628 : 37|2@1+ (1,0) [0|3] ""  PBS,PTP
 SG_ HydroHndlPstnToDriveTrain m22628 : 48|16@1+ (0.0025,0) [0|160.6375] "Perc"  PBS,PTP
 SG_ TireSizeRearOnly m24676 : 16|16@1+ (1,0) [0|64255] "MilliMtr"  PBS,PTP
 SG_ TireSizeFrntOnly m24676 : 32|16@1+ (1,0) [0|64255] "MilliMtr"  PBS,PTP
 SG_ EngineDisplacement m24676 : 48|4@1+ (1,0) [0|15] ""  PBS,PTP

BO_ 2565865216 Mx_EFFF_P6_0x00: 8 ECU
 SG_ CmdBytePGN61184_ECU M : 0|16@1+ (1,0) [0|0] ""  EIC,PBS,PDC,PDE
 SG_ PGNRqstProp m219 : 16|24@1+ (1,0) [0|0] ""  PBS,PDC,PDE
 SG_ REQPGNCMDBYTE1 m219 : 40|8@1+ (1,0) [0|0] ""  PBS,PDC,PDE
 SG_ PGNRqstProp m241 : 16|24@1+ (1,0) [0|0] ""  PBS,PDC,PDE
 SG_ REQPGNCMDBYTE1 m241 : 40|8@1+ (1,0) [0|0] ""  PBS,PDC,PDE
 SG_ REQPGNCMDBYTE2 m241 : 48|8@1+ (1,0) [0|0] ""  PBS,PDC,PDE
 SG_ IOExpInputPinMeas1ResponseA m252 : 16|16@1+ (0.1,0) [0|5000] ""  PDC
 SG_ IOExpInputPinMeas1ResponseB m252 : 32|16@1+ (0.1,0) [0|5000] ""  PDC
 SG_ IOExpInputPinMeas1ResponseC m252 : 48|16@1+ (1,0) [0|64255] ""  PDC
 SG_ CompressionTest m356 : 16|1@1+ (1,0) [0|1] ""  Vector__XXX
 SG_ CylinderDiagnostics m356 : 17|1@1+ (1,0) [0|1] ""  Vector__XXX
 SG_ CylinderCutoutTest m356 : 18|1@1+ (1,0) [0|1] ""  Vector__XXX
 SG_ CylinderDiagnosticsTrigger m356 : 19|1@1+ (1,0) [0|1] ""  Vector__XXX
 SG_ ActuatorDriverTest m356 : 20|1@1+ (1,0) [0|1] ""  Vector__XXX
 SG_ EngiOverShutTestEnab m356 : 22|2@1+ (1,0) [0|3] ""  Vector__XXX
 SG_ CompressionTestState m356 : 24|8@1+ (1,0) [0|255] ""  Vector__XXX
 SG_ CylinderDiagnosticsState m356 : 32|8@1+ (1,0) [0|255] ""  Vector__XXX
 SG_ CylinderCutoutCylinderNumber m356 : 40|8@1+ (1,0) [0|12] ""  Vector__XXX
 SG_ ActuatorTestIndex m356 : 48|5@1+ (1,0) [0|0] ""  Vector__XXX
 SG_ ActuatorTestType m356 : 53|2@1+ (1,0) [0|0] ""  Vector__XXX
 SG_ ActuatorOutputValue m356 : 56|8@1+ (1,0) [0|250] ""  Vector__XXX
 SG_ AftrNmbrSulfDepCleaEven m1015 : 16|16@1+ (1,0) [0|5] ""  Vector__XXX
 SG_ AftrNmbrNOxCnvrEffnRcovEven m1015 : 32|16@1+ (1,0) [0|5] ""  Vector__XXX
 SG_ AftrtrtmntNmbrUreaDepCleanEvent m1015 : 48|16@1+ (1,0) [0|5] ""  Vector__XXX
 SG_ IOExpaOutpPinStatMess1PinStat m1532 : 56|8@1+ (1,0) [0|255] ""  PDC
 SG_ IOExpOutputPinState3DutyCycle m2556 : 16|16@1+ (0.1,0) [0|100] ""  PDC
 SG_ IOExpOutputPinState3Frequency m2556 : 32|16@1+ (0.1,0) [0|1000] ""  PDC
 SG_ IOExpOutputPinState3CurrentFbk m2556 : 48|8@1+ (0.1,0) [0|25] "Ampere"  PDC
 SG_ IOExpOutputPinState3Status m2556 : 56|8@1+ (1,0) [0|255] ""  PDC
 SG_ FlexpowerStatusCounter m3684 : 16|8@1+ (1,0) [0|0] ""  Vector__XXX
 SG_ FlexpowerStatus m3684 : 24|2@1+ (1,0) [0|3] ""  EIC
 SG_ FlexpowerTimeoutErrorIndicator m3684 : 26|1@1+ (1,0) [0|0] ""  EIC
 SG_ FlexpowerWatchdogErrorIndicator m3684 : 27|1@1+ (1,0) [0|0] ""  EIC
 SG_ FlexpowerAuthErrorIndicator m3684 : 28|1@1+ (1,0) [0|0] ""  EIC
 SG_ JDPresEngCtrlMode m4196 : 16|8@1+ (1,0) [0|255] ""  Vector__XXX
 SG_ EngOpStateFromEcu m8696 : 16|4@1+ (1,0) [0|15] ""  EIC,PBS,PDC
 SG_ EngWaitToStartLamp m8696 : 20|2@1+ (1,0) [0|3] ""  Vector__XXX
 SG_ EngProtectSysHasShtdwnEng m8696 : 22|2@1+ (1,0) [0|3] ""  Vector__XXX
 SG_ RemainingStartingAidTime m8696 : 24|16@1+ (1,0) [0|64255] ""  Vector__XXX
 SG_ EngStrCooldwnTimer m8696 : 40|8@1+ (1,0) [0|250] ""  Vector__XXX
 SG_ MngdEngShutdwnCooldwnTimer m8696 : 48|16@1+ (1,0) [0|64255] ""  Vector__XXX
 SG_ EngTorqueDerateSetpnt m9060 : 24|8@1+ (0.4,0) [0|100] ""  Vector__XXX
 SG_ DPFTtlNmbrOfActRegen m10993 : 16|16@1+ (1,0) [0|64255] ""  Vector__XXX
 SG_ DPFTtlNmbrOfAbrtdRegen m10993 : 32|16@1+ (1,0) [0|64255] ""  Vector__XXX
 SG_ DPFPresNmbrAbortRegen m10993 : 48|16@1+ (1,0) [0|64255] ""  Vector__XXX
 SG_ SPRMaxTorque m21860 : 16|16@1+ (0.0625,0) [0|4095] ""  PDC
 SG_ SPRActiveFlag m21860 : 32|2@1+ (1,0) [0|3] ""  Vector__XXX

BO_ 2298477059 Mx_FFFA_P2_0x03: 8 PTP
 SG_ CmdBytePGN65530_PTP M : 0|16@1+ (1,0) [0|0] ""  PDC
 SG_ ParkingBrakeSwitch m8960 : 20|2@1+ (1,0) [0|3] ""  PDC
 SG_ TransmissionEnableCommand m8960 : 16|2@1+ (1,0) [0|3] ""  PDC
 SG_ HydroHandleOutOfNeutral m8960 : 18|2@1+ (1,0) [0|3] ""  PDC
 SG_ PropulsionEngineSpeedRequest m35842 : 16|16@1+ (0.125,0) [0|8031.875] ""  PDC

BO_ 2499803902 Mx_FFFA_P5_0xFE: 8 Vector__XXX
 SG_ CmdBytePGN65530_Vector_XXX M : 0|16@1+ (1,0) [0|0] ""  PTP,PBS
 SG_ HydrCharPresSensStat m8192 : 16|4@1+ (1,0) [0|15] ""  PBS,PTP
 SG_ MaxEngineSpeedRequest m11528 : 16|16@1+ (0.125,0) [0|8031.875] ""  PTP
 SG_ MinEngineSpeedRequest m11528 : 32|16@1+ (0.125,0) [0|8031.875] ""  PTP
 SG_ EngineSpeedManagementActive m11528 : 48|2@1+ (1,0) [0|3] ""  PTP

BO_ 2565865470 Mx_EFFF_P6_0xFE: 8 Vector__XXX
 SG_ CmdBytePGN61184_Vector_XXX M : 0|16@1+ (1,0) [0|0] ""  ECU,EIC,PBS,PTP
 SG_ OpCtrlB2CmdByte4BitQuad14 m2288 : 24|4@1+ (1,0) [0|15] ""  PBS
 SG_ OpCtrlB3CmdByte3BitQuad58 m3312 : 20|4@1+ (1,0) [0|15] ""  PBS,PTP
 SG_ OpCtrlB3CmdByte6BitQuad14 m3312 : 40|4@1+ (1,0) [0|15] ""  PBS,PTP
 SG_ OpCtrlB3CmdByte7BitQuad14 m3312 : 48|4@1+ (1,0) [0|15] ""  PBS,PTP
 SG_ OpCtrlB3CmdByte7BitQuad58 m3312 : 52|4@1+ (1,0) [0|15] ""  PBS,PTP
 SG_ OpCtrlB3CmdByte8BitQuad14 m3312 : 56|4@1+ (1,0) [0|15] ""  PBS,PTP
 SG_ OpCtrlB3CmdByte8BitQuad58 m3312 : 60|4@1+ (1,0) [0|15] ""  PBS,PTP
 SG_ OpCtrlB3CmdByte3BitQuad14 m3312 : 16|4@1+ (1,0) [0|15] ""  PTP
 SG_ SecReq m5732 : 16|40@1+ (1,0) [0|0] ""  EIC
 SG_ EngStartCtrl m9458 : 16|2@1+ (1,0) [0|3] ""  ECU
 SG_ OpCtrlB5CmdByte8BitQuad14 m13300 : 56|4@1+ (1,0) [0|15] ""  PBS

BO_ 2565865222 EngiStarShutRequ_EIC: 8 EIC
 SG_ CmdBytePGN61184_EIC M : 0|16@1+ (1,0) [0|0] ""  ECU
 SG_ EngineDesiredOperatingState m8440 : 16|4@1+ (1,0) [0|15] ""  ECU

BO_ 2565801726 FlexAuthRequ_TX_Vector__XXX_RX_EIC: 8 Vector__XXX
 SG_ CmdBytePGN61184_Vector_XXX M : 0|16@1+ (1,0) [0|0] ""  EIC
 SG_ SecReq m5732 : 16|40@1+ (1,0) [0|0] ""  EIC

BO_ 2565801472 Flexpower_Status_TX_ECU_RX_EIC: 8 ECU
 SG_ CmdBytePGN61184_ECU M : 0|16@1+ (1,0) [0|0] ""  EIC
 SG_ FlexpowerStatusCounter m3684 : 16|8@1+ (1,0) [0|0] ""  Vector__XXX
 SG_ FlexpowerStatus m3684 : 24|2@1+ (1,0) [0|3] ""  EIC
 SG_ FlexpowerTimeoutErrorIndicator m3684 : 26|1@1+ (1,0) [0|0] ""  EIC
 SG_ FlexpowerWatchdogErrorIndicator m3684 : 27|1@1+ (1,0) [0|0] ""  EIC
 SG_ FlexpowerAuthErrorIndicator m3684 : 28|1@1+ (1,0) [0|0] ""  EIC

BO_ 2498756606 Mx_EFFF_P5_0xFE: 8 Vector__XXX
 SG_ CmdBytePGN61184_Vector_XXX M : 0|16@1+ (1,0) [0|0] ""  PTP,ECU,PDC,PBS
 SG_ JDEngineTestMode m2916 : 16|8@1+ (1,0) [0|255] ""  ECU
 SG_ JDEngineTestState m2916 : 24|8@1+ (1,0) [0|255] ""  ECU
 SG_ JDEngineTestActiveType m2916 : 32|8@1+ (1,0) [0|255] ""  ECU
 SG_ JDEngineTestComponentID m2916 : 40|8@1+ (1,0) [0|255] ""  ECU
 SG_ JDEngineTestPercentProgress m2916 : 56|8@1+ (1,0) [0|0] ""  ECU
 SG_ HydrocarbonInjectorPurge m8292 : 16|2@1+ (1,0) [0|3] ""  ECU
 SG_ DiesOxidCataServReplComp m8292 : 24|2@1+ (1,0) [0|3] ""  ECU
 SG_ DiesPartFiltUninHydrDiagClea m8292 : 26|2@1+ (1,0) [0|3] ""  ECU
 SG_ DiesOxidCataOutlTempDiagClea m8292 : 28|2@1+ (1,0) [0|3] ""  ECU
 SG_ DiesOxidCataUninHydrDiagClea m8292 : 30|2@1+ (1,0) [0|3] ""  ECU
 SG_ DiesPartFiltServReplComp m8292 : 32|2@1+ (1,0) [0|3] ""  ECU
 SG_ DiesPartFiltUninHydrDiagClea m8292 : 34|2@1+ (1,0) [0|3] ""  ECU
 SG_ AfteDiesPartFiltRegeCleaFreqFaul m8292 : 36|2@1+ (1,0) [0|3] ""  ECU
 SG_ ServcRegenReq m8292 : 40|2@1+ (1,0) [0|3] ""  ECU,PDC
 SG_ AfteDiesExhaFluiPresContRequ m8292 : 42|2@1+ (1,0) [0|3] ""  ECU
 SG_ AfteSCRReplRese m8292 : 48|2@1+ (1,0) [0|3] ""  ECU
 SG_ AfteDiesPartFiltOutlGasHighTempStatComm m8292 : 50|2@1+ (1,0) [0|3] ""  ECU
 SG_ AfteDiesExhaFluiTankHeatCoolValvTest m8292 : 56|2@1+ (1,0) [0|3] ""  ECU
 SG_ AfteDiesExhaFluiSystShutTest m8292 : 58|2@1+ (1,0) [0|3] ""  ECU
 SG_ AfteDiesExhaFluiInjeDiagTest m8292 : 60|2@1+ (1,0) [0|3] ""  ECU
 SG_ AfteDiesExhaFluiInjeQuanTest m8292 : 62|2@1+ (1,0) [0|3] ""  ECU
 SG_ AirCompEngageState m21348 : 32|2@1+ (1,0) [0|3] ""  PBS,PTP
 SG_ EngRun m21348 : 38|2@1+ (1,0) [0|3] ""  PBS
 SG_ EnginePowerPercent m21348 : 48|8@1+ (1,0) [0|125] ""  PTP
 SG_ HdrType m29284 : 32|8@1+ (1,0) [0|255] ""  PTP

BO_ 2298477566 GSACommand_Vector__XXX: 8 Vector__XXX
 SG_ CmdBytePGN65531_Vector_XXX M : 0|16@1+ (1,0) [0|0] ""  PTP
 SG_ GSACommandStatus m505 : 16|8@1+ (1,0) [0|255] ""  PTP
 SG_ GSACommandSpeed m505 : 24|16@1+ (0.00390625,0) [0|250.996] "KiloMtrPerHr"  PTP

BO_ 2499803907 GSAData_PTP: 8 PTP
 SG_ CmdBytePGN65531_PTP M : 0|16@1+ (1,0) [0|0] ""  Vector__XXX
 SG_ GSAStatus m249 : 16|8@1+ (1,0) [0|255] ""  Vector__XXX
 SG_ GSAOperatorDesiredSpeed m249 : 24|16@1+ (0.00390625,0) [0|250.996] "KiloMtrPerHr"  Vector__XXX
 SG_ GSAMinVehSpdLim m249 : 40|16@1+ (0.00390625,0) [0|250.996] "KiloMtrPerHr"  Vector__XXX

BO_ 2566912771 Mx_FFFB_P6_0x03: 8 PTP
 SG_ CmdBytePGN65531_PTP M : 0|16@1+ (1,0) [0|0] ""  PDC
 SG_ GSAMaxVehSpdLim m3067 : 16|16@1+ (0.00390625,0) [0|250.996] "KiloMtrPerHr"  PDC
 SG_ GSATransmissionPower m3067 : 32|16@1+ (0.1,-3000) [-3000|0] ""  PDC

BO_ 2566911230 GuidSystCommJDExte_Vector__XXX: 8 Vector__XXX
 SG_ CmdBytePGN65524_Vector_XXX M : 0|8@1+ (1,0) [0|0] ""  ATX
 SG_ SteeringResponseRate m100 : 8|5@1+ (5,-50) [-50|100] "gain"  ATX
 SG_ GPSMsgRate m100 : 13|3@1+ (1,0) [0|7] ""  ATX
 SG_ AutoTracWheelbase_GSCJDE m100 : 16|8@1+ (0.05,0) [0|12.5] "m"  ATX
 SG_ InnerLoopGain m100 : 24|16@1+ (1,0) [0|65535] "gain"  ATX
 SG_ AT2ExitCode_GSCJDE m100 : 40|8@1+ (1,0) [0|255] ""  ATX
 SG_ CrvtrCntrlATState_GSCJDE m100 : 48|4@1+ (1,0) [0|15] ""  ATX
 SG_ Heartbeat m100 : 52|4@1+ (1,0) [0|0] ""  ATX

BO_ 2297430014 HarvDomaThreStat_Vector__XXX: 8 Vector__XXX
 SG_ CmdBytePGN61184_Vector_XXX M : 0|16@1+ (1,0) [0|0] ""  PTP
 SG_ SeparatorDrive m3064 : 48|4@1+ (1,0) [0|15] ""  PTP

BO_ 2566913022 Mx_FFFB_P6_0xFE: 8 Vector__XXX
 SG_ CmdBytePGN65531_Vector_XXX M : 0|16@1+ (1,0) [0|0] ""  PBS,PTP,PDE
 SG_ KeySwitchStart m9970 : 20|2@1+ (1,0) [0|3] ""  PBS
 SG_ KeySwitchRun m9970 : 22|2@1+ (1,0) [0|3] ""  PBS,PDE
 SG_ HillmasterSystemMode m60928 : 16|4@1+ (1,0) [0|15] ""  PBS,PTP
 SG_ HillMasterTiltRequest m60928 : 20|2@1+ (1,0) [0|3] ""  PBS,PTP

BO_ 2565865219 Mx_EFFF_P6_0x03: 8 PTP
 SG_ CmdBytePGN61184_PTP M : 0|16@1+ (1,0) [0|0] ""  PDC,ECU,PDE
 SG_ PGNRqstProp m219 : 16|24@1+ (1,0) [0|0] ""  ECU,PDC,PDE
 SG_ REQPGNCMDBYTE1 m219 : 40|8@1+ (1,0) [0|0] ""  ECU,PDC,PDE
 SG_ PGNRqstProp m241 : 16|24@1+ (1,0) [0|0] ""  ECU,PDC,PDE
 SG_ REQPGNCMDBYTE1 m241 : 40|8@1+ (1,0) [0|0] ""  ECU,PDC,PDE
 SG_ REQPGNCMDBYTE2 m241 : 48|8@1+ (1,0) [0|0] ""  ECU,PDC,PDE
 SG_ OpCtrlB2RspByte4BitQuad14 m2544 : 24|4@1+ (1,0) [0|15] ""  Vector__XXX
 SG_ ActVehicleCalPDC m3320 : 16|8@1+ (1,0) [0|0] ""  Vector__XXX
 SG_ CalStepPDC m3320 : 24|8@1+ (1,0) [0|0] ""  Vector__XXX
 SG_ OpCtrlB3RspByte3BitQuad58 m3568 : 20|4@1+ (1,0) [0|15] ""  PDC
 SG_ OpCtrlB3RspByte6BitQuad14 m3568 : 40|4@1+ (1,0) [0|15] ""  PDC
 SG_ OpCtrlB3RspByte7BitQuad14 m3568 : 48|4@1+ (1,0) [0|15] ""  PDC
 SG_ OpCtrlB3RspByte7BitQuad58 m3568 : 52|4@1+ (1,0) [0|15] ""  PDC
 SG_ OpCtrlB3RspByte8BitQuad14 m3568 : 56|4@1+ (1,0) [0|15] ""  PDC
 SG_ OpCtrlB3RspByte8BitQuad58 m3568 : 60|4@1+ (1,0) [0|15] ""  PDC
 SG_ OpCtrlB3RspByte3BitQuad14 m3568 : 16|4@1+ (1,0) [0|15] ""  PDC
 SG_ OpCtrlB3RspByte3BitQuad58 m3568 : 20|4@1+ (1,0) [0|15] ""  PDC
 SG_ OpCtrlB3RspByte6BitQuad14 m3568 : 40|4@1+ (1,0) [0|15] ""  PDC
 SG_ OpCtrlB3RspByte7BitQuad14 m3568 : 48|4@1+ (1,0) [0|15] ""  PDC
 SG_ OpCtrlB3RspByte7BitQuad58 m3568 : 52|4@1+ (1,0) [0|15] ""  PDC
 SG_ OpCtrlB3RspByte8BitQuad14 m3568 : 56|4@1+ (1,0) [0|15] ""  PDC
 SG_ OpCtrlB3RspByte8BitQuad58 m3568 : 60|4@1+ (1,0) [0|15] ""  PDC
 SG_ OpCtrlB5RspByte8BitQuad14 m13556 : 56|4@1+ (1,0) [0|15] ""  Vector__XXX
 SG_ CurrentGearRangeFromDriveTrain m25188 : 48|8@1+ (1,0) [0|255] ""  PDC
 SG_ MaxVehSpdLim m25188 : 16|8@1+ (1,0) [0|250] "KiloMtrPerHr"  PDC
 SG_ ProDriveTransModeFromDriveTrain m25188 : 24|8@1+ (1,0) [0|255] ""  PDC
 SG_ CurrentGearRangeFromDriveTrain m25188 : 48|8@1+ (1,0) [0|255] ""  PDC
 SG_ TransmissionLimOpFaultStatus m26724 : 16|4@1+ (1,0) [0|15] ""  PDC
 SG_ TowModeAvailable m26724 : 20|4@1+ (1,0) [0|15] ""  PDC
 SG_ TransmissionCoolingRequest m26724 : 24|8@1+ (0.5,0) [0|100] ""  PDC
 SG_ FourWDStatusFromDrivetrain m26724 : 32|4@1+ (1,0) [0|15] ""  PDC
 SG_ DiffLockStateFromDrivetrain m26724 : 36|4@1+ (1,0) [0|15] ""  PDC
 SG_ TransmissionLimOpFaultStatus m26724 : 16|4@1+ (1,0) [0|15] ""  PDC
 SG_ TowModeAvailable m26724 : 20|4@1+ (1,0) [0|15] ""  PDC
 SG_ TransmissionCoolingRequest m26724 : 24|8@1+ (0.5,0) [0|100] ""  PDC
 SG_ FourWDStatusFromDrivetrain m26724 : 32|4@1+ (1,0) [0|15] ""  PDC
 SG_ DiffLockStateFromDrivetrain m26724 : 36|4@1+ (1,0) [0|15] ""  PDC

BO_ 2566914046 InteCaliToolECU_Vector__XXX: 8 Vector__XXX
 SG_ CmdBytePGN65535_Vector_XXX M : 0|8@1+ (1,0) [0|0] ""  PTP
 SG_ ReqVehicleCal m246 : 16|8@1+ (1,0) [0|0] ""  PTP
 SG_ CalMode m246 : 24|8@1+ (1,0) [0|0] ""  PTP

BO_ 2498756594 Mx_EFFF_P5_0xF2: 8 PDC
 SG_ CmdBytePGN61184_PDC M : 0|16@1+ (1,0) [0|0] ""  ECU,PTP,PBS
 SG_ IOExpOutputPinCtrlReq3DutyCycle m2300 : 16|16@1+ (0.1,0) [0|100] ""  ECU
 SG_ IOExpOutputPinCtrlReq3Frequency m2300 : 32|16@1+ (0.1,0) [0|1000] ""  ECU
 SG_ TransmissionCmdLimOp m26980 : 16|4@1+ (1,0) [0|15] ""  PTP
 SG_ MachTowModeParkBrakeReq m26980 : 20|2@1+ (1,0) [0|3] ""  PBS,PTP
 SG_ QuickStopSwitchToDriveTrain m26980 : 24|2@1+ (1,0) [0|3] ""  PBS,PTP
 SG_ MachHarvStatToDrivTrai m26980 : 26|2@1+ (1,0) [0|3] ""  PTP
 SG_ HandleSensitivity m26980 : 28|4@1+ (1,0) [0|5] "Count"  PBS,PTP
 SG_ ProDriveMaxSpdSetpnt m26980 : 32|16@1+ (0.003906,0) [0|0] "KiloMtrPerHr"  PTP
 SG_ ProDriveMaxSpdSetpnt2 m26980 : 48|16@1+ (0.003906,0) [0|0] "KiloMtrPerHr"  PTP

BO_ 2565865407 Mx_EFFF_P6_0xBF: 8 PDE
 SG_ CmdBytePGN61184_PDE M : 0|16@1+ (1,0) [0|0] ""  ECU,PBS,PDC
 SG_ PGNRqstProp m219 : 16|24@1+ (1,0) [0|0] ""  ECU,PBS,PDC
 SG_ REQPGNCMDBYTE1 m219 : 40|8@1+ (1,0) [0|0] ""  ECU,PBS,PDC
 SG_ PGNRqstProp m241 : 16|24@1+ (1,0) [0|0] ""  ECU,PBS,PDC
 SG_ REQPGNCMDBYTE1 m241 : 40|8@1+ (1,0) [0|0] ""  ECU,PBS,PDC
 SG_ REQPGNCMDBYTE2 m241 : 48|8@1+ (1,0) [0|0] ""  ECU,PBS,PDC

BO_ 2565800704 Mx_EF03_P6_0x00: 8 ECU
 SG_ CmdBytePGN61184_ECU M : 0|16@1+ (1,0) [0|0] ""  Vector__XXX

BO_ 2565861888 JD_ACKnowledgement_TX_ECU_RX_PDC: 8 ECU
 SG_ CmdBytePGN61184_ECU M : 0|16@1+ (1,0) [0|0] ""  Vector__XXX

BO_ 2565848832 JD_ACKnowledgement_TX_ECU_RX_PDE: 8 ECU
 SG_ CmdBytePGN61184_ECU M : 0|16@1+ (1,0) [0|0] ""  Vector__XXX

BO_ 2565799939 Mx_EF00_P6_0x03: 8 PBS
 SG_ CmdBytePGN61184_PBS M : 0|16@1+ (1,0) [0|0] ""  Vector__XXX

BO_ 2565861891 Mx_EFF2_P6_0x03: 8 PBS
 SG_ CmdBytePGN61184_PBS M : 0|16@1+ (1,0) [0|0] ""  Vector__XXX

BO_ 2565848835 Mx_EFBF_P6_0x03: 8 PBS
 SG_ CmdBytePGN61184_PBS M : 0|16@1+ (1,0) [0|0] ""  Vector__XXX

BO_ 2565800707 Mx_EF03_P6_0x03: 8 PBS
 SG_ CmdBytePGN61184_PBS M : 0|16@1+ (1,0) [0|0] ""  Vector__XXX

BO_ 2565800178 JD_ACKnowledgement_TX_PDC_RX_ECU: 8 PDC
 SG_ CmdBytePGN61184_PDC M : 0|16@1+ (1,0) [0|0] ""  Vector__XXX

BO_ 2565800946 Mx_EF03_P6_0xF2: 8 PDC
 SG_ CmdBytePGN61184_PDC M : 0|16@1+ (1,0) [0|0] ""  Vector__XXX

BO_ 2565849074 JD_ACKnowledgement_TX_PDC_RX_PDE: 8 PDC
 SG_ CmdBytePGN61184_PDC M : 0|16@1+ (1,0) [0|0] ""  Vector__XXX

BO_ 2565800127 JD_ACKnowledgement_TX_PDE_RX_ECU: 8 PDE
 SG_ CmdBytePGN61184_PDE M : 0|16@1+ (1,0) [0|0] ""  Vector__XXX

BO_ 2565800895 Mx_EF03_P6_0xBF: 8 PDE
 SG_ CmdBytePGN61184_PDE M : 0|16@1+ (1,0) [0|0] ""  Vector__XXX

BO_ 2565862079 JD_ACKnowledgement_TX_PDE_RX_PDC: 8 PDE
 SG_ CmdBytePGN61184_PDE M : 0|16@1+ (1,0) [0|0] ""  Vector__XXX

BO_ 2566912000 JDAfteSCRSystStat_ECU: 8 ECU
 SG_ CmdBytePGN65528_ECU M : 0|8@1+ (1,0) [0|0] ""  Vector__XXX
 SG_ TimeRemaPresAftrSCRInduLvl m115 : 16|16@1+ (1,0) [0|64255] ""  Vector__XXX

BO_ 2364538624 JDEngineControlMessage1_ECU: 8 ECU
 SG_ CmdBytePGN61184_ECU M : 0|16@1+ (1,0) [0|0] ""  Vector__XXX
 SG_ EngineBrakeTorque m1636 : 16|16@1+ (1,-32000) [-32000|32255] "Nm"  Vector__XXX

BO_ 2498691326 JDEngiTestMess_TX_Vector__XXX_RX_ECU: 8 Vector__XXX
 SG_ CmdBytePGN61184_Vector_XXX M : 0|16@1+ (1,0) [0|0] ""  ECU
 SG_ JDEngineTestMode m2916 : 16|8@1+ (1,0) [0|255] ""  ECU
 SG_ JDEngineTestState m2916 : 24|8@1+ (1,0) [0|255] ""  ECU
 SG_ JDEngineTestActiveType m2916 : 32|8@1+ (1,0) [0|255] ""  ECU
 SG_ JDEngineTestComponentID m2916 : 40|8@1+ (1,0) [0|255] ""  ECU
 SG_ JDEngineTestPercentProgress m2916 : 56|8@1+ (1,0) [0|0] ""  ECU

BO_ 2566912768 Mx_FFFB_P6_0x00: 8 ECU
 SG_ CmdBytePGN65531_ECU M : 0|16@1+ (1,0) [0|0] ""  Vector__XXX
 SG_ LiftPumpMeasuredSpeed m48 : 16|8@1+ (0.4,0) [0|100] ""  Vector__XXX
 SG_ LiftPumpCommandedSpeed m48 : 24|8@1+ (0.4,0) [0|100] ""  Vector__XXX
 SG_ LiftPumpCurrent m48 : 32|8@1+ (0.144,0) [0|36] ""  Vector__XXX
 SG_ DEFPumpSpeedCommand m48 : 40|8@1+ (0.4,0) [0|1] ""  Vector__XXX
 SG_ DEFSupplyModulePressure m48 : 48|16@1+ (0.03125,0) [0|2000] ""  Vector__XXX

BO_ 2566913790 MachineSetup_Vector__XXX: 8 Vector__XXX
 SG_ CmdBytePGN65534_Vector_XXX M : 0|8@1+ (1,0) [0|0] ""  PTP
 SG_ EngType m236 : 8|8@1+ (1,0) [0|255] ""  PTP

BO_ 2565800958 MachNetwHealDataComm_TX_Vector__XXX_RX_PBS: 8 Vector__XXX
 SG_ CmdBytePGN61184_Vector_XXX M : 0|16@1+ (1,0) [0|0] ""  Vector__XXX

BO_ 2565862142 MachNetwHealDataComm_TX_Vector__XXX_RX_PDC: 8 Vector__XXX
 SG_ CmdBytePGN61184_Vector_XXX M : 0|16@1+ (1,0) [0|0] ""  Vector__XXX

BO_ 2565849086 MachNetwHealDataComm_TX_Vector__XXX_RX_PDE: 8 Vector__XXX
 SG_ CmdBytePGN61184_Vector_XXX M : 0|16@1+ (1,0) [0|0] ""  Vector__XXX

BO_ 2432696318 OperatorSeatData_Vector__XXX: 8 Vector__XXX
 SG_ CmdBytePGN65535_Vector_XXX M : 0|8@1+ (1,0) [0|0] ""  PBS,PTP
 SG_ OperatorSeatSwitch m236 : 40|2@1+ (1,0) [0|3] ""  PBS,PTP

BO_ 2566913010 Mx_FFFB_P6_0xF2: 8 PDC
 SG_ CmdBytePGN65531_PDC M : 0|16@1+ (1,0) [0|0] ""  Vector__XXX

BO_ 2632974334 PoweDomaDrivTraiOpti_Vector__XXX: 8 Vector__XXX
 SG_ CmdBytePGN61184_Vector_XXX M : 0|16@1+ (1,0) [0|0] ""  PTP
 SG_ Opt4WD m22884 : 16|2@1+ (1,0) [0|3] ""  PTP
 SG_ EngSpdInRoadMode m22884 : 22|2@1+ (1,0) [0|3] ""  PTP
 SG_ OptType4WD m22884 : 24|4@1+ (1,0) [0|15] ""  PTP
 SG_ TracksOption m22884 : 32|4@1+ (1,0) [0|15] ""  PTP

BO_ 2499803890 PoweDomaDrivTraiStat3_PDC: 8 PDC
 SG_ CmdBytePGN65530_PDC M : 0|16@1+ (1,0) [0|0] ""  PTP
 SG_ ASRTogCmd m39424 : 16|2@1+ (1,0) [0|3] ""  PTP

BO_ 2565865235 Mx_EFFF_P6_0x13: 8 ATX
 SG_ CmdBytePGN61184_ATX M : 0|16@1+ (1,0) [0|0] ""  Vector__XXX

BO_ 2634021630 TCM_Calibration_Status_Vector__XXX: 8 Vector__XXX
 SG_ CmdBytePGN65530_Vector_XXX M : 0|16@1+ (1,0) [0|0] ""  PTP
 SG_ TCMPitchCal m58 : 16|16@1+ (1,-30000) [-30000|34000] ""  PTP
 SG_ TCMRollCal m58 : 32|16@1+ (1,-30000) [-30000|34000] ""  PTP
 SG_ TCMCalStatus m58 : 60|4@1+ (1,0) [0|15] ""  PTP

BO_ 2499805182 Tractor_Setup_1_Vector__XXX: 8 Vector__XXX
 SG_ CmdBytePGN65535_Vector_XXX M : 0|8@1+ (1,0) [0|0] ""  PDC,PTP
 SG_ AutoClearDTCTime m34 : 24|8@1+ (1,0) [0|0] ""  PDC,PTP

BO_ 2297429763 Mx_EFFF_P2_0x03: 8 PBS
 SG_ CmdBytePGN61184_PBS M : 0|16@1+ (1,0) [0|0] ""  PDC
 SG_ CntlrHeartbeat m24932 : 16|2@1+ (1,0) [0|3] ""  PDC
 SG_ ParkBrakeRelCmd m24932 : 18|2@1+ (1,0) [0|3] ""  PDC
 SG_ ParkBrakStatAutoFromDrivTrai m24932 : 20|2@1+ (1,0) [0|3] ""  PDC
 SG_ WheelBasedDirection m24932 : 22|2@1+ (1,0) [0|3] ""  PDC
 SG_ ParkLockFromDriveTrain m24932 : 36|2@1+ (1,0) [0|3] ""  PDC
 SG_ LimpModeStatus m24932 : 40|4@1+ (1,0) [0|15] ""  PDC
 SG_ TowModeStatus m24932 : 44|4@1+ (1,0) [0|15] ""  PDC
 SG_ CntlrHeartbeat m24932 : 16|2@1+ (1,0) [0|3] ""  PDC
 SG_ ParkBrakeRelCmd m24932 : 18|2@1+ (1,0) [0|3] ""  PDC
 SG_ ParkBrakStatAutoFromDrivTrai m24932 : 20|2@1+ (1,0) [0|3] ""  PDC
 SG_ WheelBasedDirection m24932 : 22|2@1+ (1,0) [0|3] ""  PDC
 SG_ ProDriveSysVlvReq m24932 : 28|4@1+ (1,0) [0|15] ""  PDC
 SG_ ParkLockFromDriveTrain m24932 : 36|2@1+ (1,0) [0|3] ""  PDC
 SG_ BackUpLightandAlarmHornCommand m24932 : 38|2@1+ (1,0) [0|3] ""  PDC
 SG_ LimpModeStatus m24932 : 40|4@1+ (1,0) [0|15] ""  PDC
 SG_ TowModeStatus m24932 : 44|4@1+ (1,0) [0|15] ""  PDC

BO_ 2365586174 Vehicle_Leveling_Roll_Vector__XXX: 8 Vector__XXX
 SG_ CmdBytePGN65530_Vector_XXX M : 0|16@1+ (1,0) [0|0] ""  ATX
 SG_ VehRollAng m8224 : 16|16@1+ (0.0078125,-200) [-200|301.99] "deg"  ATX
 SG_ RollRateExtRange m8224 : 32|16@1+ (0.0078125,-250) [-250|250.992] "deg/sec"  ATX

BO_ 2365587454 Vehicle_RollYaw_Rate_Vector__XXX: 8 Vector__XXX
 SG_ CmdBytePGN65535_Vector_XXX M : 0|8@1+ (1,0) [0|0] ""  ATX
 SG_ VehRollAng m225 : 16|16@1+ (0.0078125,-200) [-200|301.99] "deg"  ATX
 SG_ VehYawRate m225 : 32|16@1+ (0.0078125,-200) [-200|301.99] "deg"  ATX

BO_ 2298475762 Vehicle_State_for_AutoTrac_PDC: 8 PDC
 SG_ CmdBytePGN65524_PDC M : 0|8@1+ (1,0) [0|0] ""  ATX
 SG_ EngineRunningState m94 : 8|2@1+ (1,0) [0|3] ""  ATX
 SG_ OperatorPresenceState m94 : 10|2@1+ (1,0) [0|3] ""  ATX
 SG_ TransportSwitchState m94 : 12|2@1+ (1,0) [0|3] ""  ATX
 SG_ PrimaryResumeRequest m94 : 14|2@1+ (1,0) [0|3] ""  ATX
 SG_ AuxiliaryResumeRequest m94 : 16|2@1+ (1,0) [0|3] ""  ATX
 SG_ WheelBasedVehicleSpeed_VSAT m94 : 24|16@1+ (0.00390625,0) [0|0.9765625] "km/h"  ATX
 SG_ AT2ExitCode_VSAT m94 : 40|8@1+ (1,0) [0|255] ""  ATX
 SG_ TransmissionState_VSAT m94 : 48|4@1+ (1,0) [0|15] ""  ATX
 SG_ VehTreadWidth m94 : 56|8@1+ (0.05,0) [0|12.5] "m"  ATX

BO_ 2566912959 VehiConfManaResp_PDE: 8 PDE
 SG_ CmdBytePGN65531_PDE M : 0|16@1+ (1,0) [0|0] ""  Vector__XXX

CM_ BO_ 2566912003 "ControllerDisplay_Power_Management_3";
CM_ BO_ 2566912191 "ControllerDisplay_Power_Management_3";
CM_ BO_ 2632974083 "Controller_Data_Message; Controller_Data_Message; Controller_Data_Message_0xAD01; Controller_Data_Message_0xAD01; Controller_Data_Message_0xAD02; Controller_Data_Message_0xAD02; Controller_Data_Message_0xAD03; Controller_Data_Message_0xAD03; Controller_Data_Message_0xAD04; Controller_Data_Message_0xAD04; Controller_Data_Message_0xAD05; Controller_Data_Message_0xAD05; Controller_Data_Message_0xAD06; Controller_Data_Message_0xAD06; Controller_Data_Message_0xAD07; Controller_Data_Message_0xAD07; Controller_Data_Message_0xAD08; Controller_Data_Message_0xAD08; Controller_Data_Message_0xAD09; Controller_Data_Message_0xAD09; Controller_Data_Message_0xAD0A; Controller_Data_Message_0xAD0A; Controller_Data_Message_0xAD0B; Controller_Data_Message_0xAD0B; Controller_Data_Message_0xAD0C; Controller_Data_Message_0xAD0C; Controller_Data_Message_0xAD0D; Controller_Data_Message_0xAD0D; Controller_Data_Message_0xAD0E; Controller_Data_Message_0xAD0E; Controller_Data_Message_0xAD0F; Controller_Data_Message_0xAD0F; Controller_Data_Message_0xAD10; Controller_Data_Message_0xAD10; Controller_Data_Message_0xAD11; Controller_Data_Message_0xAD11; Controller_Data_Message_0xAD12; Controller_Data_Message_0xAD12; Controller_Data_Message_0xAD13; Controller_Data_Message_0xAD13; Controller_Data_Message_0xAD14; Controller_Data_Message_0xAD14; Controller_Data_Message_0xAD15; Controller_Data_Message_0xAD15; Controller_Data_Message_0xAD16; Controller_Data_Message_0xAD16; Controller_Data_Message_0xAD17; Controller_Data_Message_0xAD17; Controller_Data_Message_0xAD18; Controller_Data_Message_0xAD18; Controller_Data_Message_0xAD19; Controller_Data_Message_0xAD19; Controller_Data_Message_0xAD1A; Controller_Data_Message_0xAD1A; Controller_Data_Message_0xAD1B; Controller_Data_Message_0xAD1B; Controller_Data_Message_0xAD1C; Controller_Data_Message_0xAD1C; Controller_Data_Message_0xAD1D; Controller_Data_Message_0xAD1D; Controller_Data_Message_0xAD1E; Controller_Data_Message_0xAD1E; Controller_Data_Message_0xAD1F; Controller_Data_Message_0xAD1F; Controller_Data_Message_0xAD20; Controller_Data_Message_0xAD20; Controller_Data_Message_0xAD21; Controller_Data_Message_0xAD21; Controller_Data_Message_0xAD22; Controller_Data_Message_0xAD22; Controller_Data_Message_0xAD23; Controller_Data_Message_0xAD23; Controller_Data_Message_0xAD24; Controller_Data_Message_0xAD24; Controller_Data_Message_0xAD25; Controller_Data_Message_0xAD25; Controller_Data_Message_0xAD26; Controller_Data_Message_0xAD26; Controller_Data_Message_0xAD27; Controller_Data_Message_0xAD27; Controller_Data_Message_0xAD28; Controller_Data_Message_0xAD28; Controller_Data_Message_0xAD29; Controller_Data_Message_0xAD29; Controller_Data_Message_0xAD2A; Controller_Data_Message_0xAD2A; Controller_Data_Message_0xAD2B; Controller_Data_Message_0xAD2B; Controller_Data_Message_0xAD2C; Controller_Data_Message_0xAD2C; Controller_Data_Message_0xAD2D; Controller_Data_Message_0xAD2D; Controller_Data_Message_0xAD2E; Controller_Data_Message_0xAD2E; Data_Request_Message_0xAC01; Data_Request_Message_0xAC01; Data_Request_Message_0xAC02; Data_Request_Message_0xAC02; Data_Request_Message_0xAC03; Data_Request_Message_0xAC03; Data_Request_Message_0xAC04; Data_Request_Message_0xAC04; Data_Request_Message_0xAC05; Data_Request_Message_0xAC05; Data_Request_Message_0xAC06; Data_Request_Message_0xAC06; Data_Request_Message_0xAC07; Data_Request_Message_0xAC07; Data_Request_Message_0xAC08; Data_Request_Message_0xAC08; Data_Request_Message_0xAC09; Data_Request_Message_0xAC09; Data_Request_Message_0xAC0A; Data_Request_Message_0xAC0A; Data_Request_Message_0xAC0B; Data_Request_Message_0xAC0B; Data_Request_Message_0xAC0C; Data_Request_Message_0xAC0C; Data_Request_Message_0xAC0D; Data_Request_Message_0xAC0D; Data_Request_Message_0xAC0E; Data_Request_Message_0xAC0E; Data_Request_Message_0xAC0F; Data_Request_Message_0xAC0F; Data_Request_Message_0xAC10; Data_Request_Message_0xAC10; Data_Request_Message_0xAC11; Data_Request_Message_0xAC11; Data_Request_Message_0xAC12; Data_Request_Message_0xAC12; Data_Request_Message_0xAC13; Data_Request_Message_0xAC13; Data_Request_Message_0xAC14; Data_Request_Message_0xAC14; Data_Request_Message_0xAC15; Data_Request_Message_0xAC15; Data_Request_Message_0xAC16; Data_Request_Message_0xAC16; Data_Request_Message_0xAC17; Data_Request_Message_0xAC17; Data_Request_Message_0xAC18; Data_Request_Message_0xAC18; Data_Request_Message_0xAC19; Data_Request_Message_0xAC19; Data_Request_Message_0xAC1A; Data_Request_Message_0xAC1A; Data_Request_Message_0xAC1B; Data_Request_Message_0xAC1B; Data_Request_Message_0xAC1C; Data_Request_Message_0xAC1C; Data_Request_Message_0xAC1D; Data_Request_Message_0xAC1D; Data_Request_Message_0xAC1E; Data_Request_Message_0xAC1E; Data_Request_Message_0xAC1F; Data_Request_Message_0xAC1F; Data_Request_Message_0xAC20; Data_Request_Message_0xAC20; Data_Request_Message_0xAC21; Data_Request_Message_0xAC21; Data_Request_Message_0xAC22; Data_Request_Message_0xAC22; Data_Request_Message_0xAC23; Data_Request_Message_0xAC23; Data_Request_Message_0xAC24; Data_Request_Message_0xAC24; Data_Request_Message_0xAC25; Data_Request_Message_0xAC25; Data_Request_Message_0xAC26; Data_Request_Message_0xAC26; Data_Request_Message_0xAC27; Data_Request_Message_0xAC27; Data_Request_Message_0xAC28; Data_Request_Message_0xAC28; Data_Request_Message_0xAC29; Data_Request_Message_0xAC29; Data_Request_Message_0xAC2A; Data_Request_Message_0xAC2A; Data_Request_Message; Data_Request_Message";
CM_ BO_ 2634021567 "ControllerHealthInfo";
CM_ BO_ 2649751296 "DTC_Query_Request; DTC_Query_Response";
CM_ BO_ 2649751299 "DTC_Query_Request; DTC_Query_Response";
CM_ BO_ 2649751538 "DTC_Query_Request; DTC_Query_Response";
CM_ BO_ 2649751487 "DTC_Query_Request; DTC_Query_Response";
CM_ BO_ 2649686784 "DTC_Query_Response";
CM_ BO_ 2649747968 "DTC_Query_Response";
CM_ BO_ 2649734912 "DTC_Query_Response";
CM_ BO_ 2649686019 "DTC_Query_Response";
CM_ BO_ 2649747971 "DTC_Query_Response";
CM_ BO_ 2649734915 "DTC_Query_Response";
CM_ BO_ 2649686258 "DTC_Query_Response";
CM_ BO_ 2649687026 "DTC_Query_Response";
CM_ BO_ 2649735154 "DTC_Query_Response";
CM_ BO_ 2649686207 "DTC_Query_Response";
CM_ BO_ 2649686975 "DTC_Query_Response";
CM_ BO_ 2649748159 "DTC_Query_Response";
CM_ BO_ 2230255622 "Electronic_Flexpower_Request_Message";
CM_ BO_ 2565865458 "Engine_DPF_Regeneration_Control_Request; IO_Expander_Output_Pin_Control_Request_Message_1; JD_ACKnowledgement; PowertrainDomaintoDriveTrainCharacteristics; PowertrainDomaintoDriveTrainStatus; Prop_Request_PGN_Dual_Cmd_Byte; Prop_Request_PGN_Single_Cmd_Byte";
CM_ BO_ 2565865216 "EngineDPFRegenerationStatistics; Engine_Derate_Status; EngineSCRCleaningStatistics; Engine_Starting_Shutdown_Status; Flexpower_Status; IO_Expander_Input_Pin_Measurement_Message_1; IO_Expander_Output_Pin_State_Message_1; IOExpanderOutputPinStateMessage3; JD_ACKnowledgement; JDEngineControlMessage16; JDEngineFunctionalTest; Prop_Request_PGN_Dual_Cmd_Byte; Prop_Request_PGN_Single_Cmd_Byte; ScheduledPowerReduction";
CM_ BO_ 2298477059 "EngineManagementSpeedRequest; TransmissionStatusHighPriority3; TransmissionStatusHighPriority3";
CM_ BO_ 2499803902 "EngineManagementSpeedStatus; PowerTrainHydraulics1";
CM_ BO_ 2565865470 "EngineStartControl; Flexpower_Authentication_Request; Machine_Network_Health_Data_Command; OperatorControlsB2Command; OperatorControlsB3Command; OperatorControlsB5Command";
CM_ BO_ 2565865222 "EngineStartingShutdownRequest";
CM_ BO_ 2565801726 "Flexpower_Authentication_Request";
CM_ BO_ 2565801472 "Flexpower_Status";
CM_ BO_ 2498756606 "FrontEndDomainMiscellaneousStatus; JDAftertreatmentServiceInterface; JDEngineTestMessage; PowertrainDomainMiscellaneousHighPriority";
CM_ BO_ 2298477566 "GSACommand";
CM_ BO_ 2499803907 "GSAData";
CM_ BO_ 2566912771 "GSAData2; Vehicle_Configuration_Management_Response";
CM_ BO_ 2566911230 "Guidance_System_Command_JD_Extended";
CM_ BO_ 2297430014 "HarvestingDomainThreshingStatus";
CM_ BO_ 2566913022 "HillmasterSystemInformation; OperatorSwitchControls4";
CM_ BO_ 2565865219 "InteractiveCalibrationECUtoPDC; JD_ACKnowledgement; JD_ACKnowledgement; OperatorControlsB2Response; OperatorControlsB3Response; OperatorControlsB3Response; OperatorControlsB5Response; Prop_Request_PGN_Dual_Cmd_Byte; Prop_Request_PGN_Dual_Cmd_Byte; Prop_Request_PGN_Single_Cmd_Byte; Prop_Request_PGN_Single_Cmd_Byte; TransmissionStatusLowPriority1; TransmissionStatusLowPriority1; TransmissionStatusLowPriority2; TransmissionStatusLowPriority2";
CM_ BO_ 2566914046 "InteractiveCalibrationTooltoECU";
CM_ BO_ 2498756594 "IOExpanderOutputPinControlMessage3; PowertrainDomaintoDriveTrainStatus2";
CM_ BO_ 2565865407 "JD_ACKnowledgement; Prop_Request_PGN_Dual_Cmd_Byte; Prop_Request_PGN_Single_Cmd_Byte";
CM_ BO_ 2565800704 "JD_ACKnowledgement; JD_ACKnowledgement";
CM_ BO_ 2565861888 "JD_ACKnowledgement";
CM_ BO_ 2565848832 "JD_ACKnowledgement";
CM_ BO_ 2565799939 "JD_ACKnowledgement; JD_ACKnowledgement";
CM_ BO_ 2565861891 "JD_ACKnowledgement; JD_ACKnowledgement";
CM_ BO_ 2565848835 "JD_ACKnowledgement; JD_ACKnowledgement";
CM_ BO_ 2565800707 "JD_ACKnowledgement; JD_ACKnowledgement";
CM_ BO_ 2565800178 "JD_ACKnowledgement";
CM_ BO_ 2565800946 "JD_ACKnowledgement; JD_ACKnowledgement";
CM_ BO_ 2565849074 "JD_ACKnowledgement";
CM_ BO_ 2565800127 "JD_ACKnowledgement";
CM_ BO_ 2565800895 "JD_ACKnowledgement; JD_ACKnowledgement";
CM_ BO_ 2565862079 "JD_ACKnowledgement";
CM_ BO_ 2566912000 "JDAftertreatmentSCRSystemState";
CM_ BO_ 2364538624 "JDEngineControlMessage1";
CM_ BO_ 2498691326 "JDEngineTestMessage";
CM_ BO_ 2566912768 "JDMachineHealthFilterMonitoring; Vehicle_Configuration_Management_Response";
CM_ BO_ 2566913790 "MachineSetup";
CM_ BO_ 2565800958 "Machine_Network_Health_Data_Command";
CM_ BO_ 2565862142 "Machine_Network_Health_Data_Command";
CM_ BO_ 2565849086 "Machine_Network_Health_Data_Command";
CM_ BO_ 2432696318 "OperatorSeatData";
CM_ BO_ 2566913010 "PowertrainDomaintoDriveTrainCharacteristics2; Vehicle_Configuration_Management_Response";
CM_ BO_ 2632974334 "PowertrainDomaintoDriveTrainOptions";
CM_ BO_ 2499803890 "PowertrainDomaintoDriveTrainStatus3";
CM_ BO_ 2565865235 "Prop_Request_PGN_Dual_Cmd_Byte; Prop_Request_PGN_Single_Cmd_Byte";
CM_ BO_ 2634021630 "TCM_Calibration_Status";
CM_ BO_ 2499805182 "Tractor_Setup_1";
CM_ BO_ 2297429763 "TransmissionStatusHighPriority1; TransmissionStatusHighPriority1";
CM_ BO_ 2365586174 "Vehicle_Leveling_Roll";
CM_ BO_ 2365587454 "Vehicle_RollYaw_Rate";
CM_ BO_ 2298475762 "Vehicle_State_for_AutoTrac";
CM_ BO_ 2566912959 "Vehicle_Configuration_Management_Response";
BA_DEF_ SG_ "SigType" ENUM "Default", "Range", "RangeSigned", "ASCII", "Discrete", "Control", "ReferencePGN", "DTC", "StringDelimiter", "StringLength", "StringLengthControl", "MessageCounter", "MessageChecksum";
BA_DEF_ SG_ "GenSigSendType" ENUM "Cyclic", "OnWrite", "OnWriteWithRepetition", "OnChange", "OnChangeWithRepetition", "IfActive", "IfActiveWithRepetition", "NoSigSendType";
BA_DEF_ SG_ "GenSigTimeoutTime_ECU" INT 0 3600000;
BA_DEF_ SG_ "GenSigILSupport" ENUM "Yes", "No";
BA_DEF_ SG_ "GenSigEVName" STRING ;
BA_DEF_ BO_ "GenMsgILSupport" ENUM "Yes", "No";
BA_DEF_ BO_ "GenMsgSendType" ENUM "cyclic", "reserved", "cyclicIfActive", "reserved", "reserved", "reserved", "reserved", "reserved", "NoMsgSendType";
BA_DEF_ BO_ "VFrameFormat" ENUM "StandardCAN", "ExtendedCAN", "reserved", "J1939PG";
BA_DEF_ BO_ "SingleFrame" INT 0 1;
BA_DEF_ BO_ "GenMsgCycleTime" INT 0 3600000;
BA_DEF_ BO_ "GenMsgCycleTimeFast" INT 0 3600000;
BA_DEF_DEF_ "SigType" "Default";
BA_DEF_DEF_ "GenSigSendType" "NoSigSendType";
BA_DEF_DEF_ "GenSigTimeoutTime_ECU" 0;
BA_DEF_DEF_ "GenSigILSupport" "Yes";
BA_DEF_DEF_ "GenSigEVName" "Env@Nodename_@Signame";
BA_DEF_DEF_ "GenMsgILSupport" "Yes";
BA_DEF_DEF_ "GenMsgSendType" "NoMsgSendType";
BA_DEF_DEF_ "VFrameFormat" "J1939PG";
BA_DEF_DEF_ "SingleFrame" 0;
BA_DEF_DEF_ "GenMsgCycleTime" 0;
BA_DEF_DEF_ "GenMsgCycleTimeFast" 0;
BA_ "GenSigTimeoutTime_ECU" SG_ 2566912003 CmdBytePGN65528_PBS 60000;
BA_ "GenSigTimeoutTime_ECU" SG_ 2566912191 CmdBytePGN65528_PDE 60000;
BA_ "GenSigTimeoutTime_ECU" SG_ 2632974083 CmdBytePGN61184_PBS 60000;
BA_ "GenSigTimeoutTime_ECU" SG_ 2634021567 CmdBytePGN65530_PDE 5000;
BA_ "GenSigTimeoutTime_ECU" SG_ 2634021567 ControllerInfoFrame 5000;
BA_ "GenSigTimeoutTime_ECU" SG_ 2649751296 CmdBytePGN126720_ECU 60000;
BA_ "GenSigTimeoutTime_ECU" SG_ 2649751299 CmdBytePGN126720_PBS 60000;
BA_ "GenSigTimeoutTime_ECU" SG_ 2649751538 CmdBytePGN126720_PDC 60000;
BA_ "GenSigTimeoutTime_ECU" SG_ 2649751487 CmdBytePGN126720_PDE 60000;
BA_ "GenSigTimeoutTime_ECU" SG_ 2649686784 CmdBytePGN126720_ECU 60000;
BA_ "GenSigTimeoutTime_ECU" SG_ 2649747968 CmdBytePGN126720_ECU 60000;
BA_ "GenSigTimeoutTime_ECU" SG_ 2649734912 CmdBytePGN126720_ECU 60000;
BA_ "GenSigTimeoutTime_ECU" SG_ 2649686019 CmdBytePGN126720_PBS 60000;
BA_ "GenSigTimeoutTime_ECU" SG_ 2649747971 CmdBytePGN126720_PBS 60000;
BA_ "GenSigTimeoutTime_ECU" SG_ 2649734915 CmdBytePGN126720_PBS 60000;
BA_ "GenSigTimeoutTime_ECU" SG_ 2649686258 CmdBytePGN126720_PDC 60000;
BA_ "GenSigTimeoutTime_ECU" SG_ 2649687026 CmdBytePGN126720_PDC 60000;
BA_ "GenSigTimeoutTime_ECU" SG_ 2649735154 CmdBytePGN126720_PDC 60000;
BA_ "GenSigTimeoutTime_ECU" SG_ 2649686207 CmdBytePGN126720_PDE 60000;
BA_ "GenSigTimeoutTime_ECU" SG_ 2649686975 CmdBytePGN126720_PDE 60000;
BA_ "GenSigTimeoutTime_ECU" SG_ 2649748159 CmdBytePGN126720_PDE 60000;
BA_ "GenSigTimeoutTime_ECU" SG_ 2230255622 CmdBytePGN61184_EIC 60000;
BA_ "GenSigTimeoutTime_ECU" SG_ 2230255622 FlexpwrCounter 60000;
BA_ "GenSigSendType" SG_ 2230255622 FlexpwrCounter 0;
BA_ "GenSigTimeoutTime_ECU" SG_ 2230255622 SpeedThrottleControlCommand 60000;
BA_ "GenSigSendType" SG_ 2230255622 SpeedThrottleControlCommand 0;
BA_ "GenSigTimeoutTime_ECU" SG_ 2230255622 GovCntrlSlct 60000;
BA_ "GenSigSendType" SG_ 2230255622 GovCntrlSlct 0;
BA_ "GenSigTimeoutTime_ECU" SG_ 2230255622 GovernorRequest 60000;
BA_ "GenSigSendType" SG_ 2230255622 GovernorRequest 0;
BA_ "GenSigTimeoutTime_ECU" SG_ 2230255622 TorqCrvReq 60000;
BA_ "GenSigSendType" SG_ 2230255622 TorqCrvReq 0;
BA_ "GenSigTimeoutTime_ECU" SG_ 2230255622 FlexpwrReq 60000;
BA_ "GenSigSendType" SG_ 2230255622 FlexpwrReq 0;
BA_ "GenSigTimeoutTime_ECU" SG_ 2230255622 FlexpwrSpeedThrottleRequest 60000;
BA_ "GenSigSendType" SG_ 2230255622 FlexpwrSpeedThrottleRequest 0;
BA_ "GenSigTimeoutTime_ECU" SG_ 2565865458 CmdBytePGN61184_PDC 5000;
BA_ "GenSigTimeoutTime_ECU" SG_ 2565865458 PGNRqstProp 5000;
BA_ "GenSigTimeoutTime_ECU" SG_ 2565865458 REQPGNCMDBYTE1 5000;
BA_ "GenSigTimeoutTime_ECU" SG_ 2565865458 PGNRqstProp 5000;
BA_ "GenSigTimeoutTime_ECU" SG_ 2565865458 REQPGNCMDBYTE1 5000;
BA_ "GenSigTimeoutTime_ECU" SG_ 2565865458 REQPGNCMDBYTE2 5000;
BA_ "GenSigTimeoutTime_ECU" SG_ 2565865458 IOExpOutputPinCtrlReq1DutyCycle 5000;
BA_ "GenSigSendType" SG_ 2565865458 IOExpOutputPinCtrlReq1DutyCycle 0;
BA_ "GenSigTimeoutTime_ECU" SG_ 2565865458 IOExpOutputPinCtrlReq1Frequency 5000;
BA_ "GenSigSendType" SG_ 2565865458 IOExpOutputPinCtrlReq1Frequency 0;
BA_ "GenSigTimeoutTime_ECU" SG_ 2565865458 EngExstTempMgmtElevIdleAllow 5000;
BA_ "GenSigSendType" SG_ 2565865458 EngExstTempMgmtElevIdleAllow 0;
BA_ "GenSigTimeoutTime_ECU" SG_ 2565865458 EngDPFActRegAllow 5000;
BA_ "GenSigSendType" SG_ 2565865458 EngDPFActRegAllow 0;
BA_ "GenSigTimeoutTime_ECU" SG_ 2565865458 DslPartFltrRegInhbtSwtch 5000;
BA_ "GenSigSendType" SG_ 2565865458 DslPartFltrRegInhbtSwtch 0;
BA_ "GenSigTimeoutTime_ECU" SG_ 2565865458 DslPartFltrRegenFrceSwtch 5000;
BA_ "GenSigSendType" SG_ 2565865458 DslPartFltrRegenFrceSwtch 0;
BA_ "GenSigTimeoutTime_ECU" SG_ 2565865458 ScndryBrakeCtrlVlv 5000;
BA_ "GenSigSendType" SG_ 2565865458 ScndryBrakeCtrlVlv 0;
BA_ "GenSigTimeoutTime_ECU" SG_ 2565865458 KeySwitchStartToDriveTrain 5000;
BA_ "GenSigSendType" SG_ 2565865458 KeySwitchStartToDriveTrain 0;
BA_ "GenSigTimeoutTime_ECU" SG_ 2565865458 KeySwitchRunToDriveTrain 5000;
BA_ "GenSigSendType" SG_ 2565865458 KeySwitchRunToDriveTrain 0;
BA_ "GenSigTimeoutTime_ECU" SG_ 2565865458 HydHndlStateToDriveTrain 5000;
BA_ "GenSigSendType" SG_ 2565865458 HydHndlStateToDriveTrain 0;
BA_ "GenSigTimeoutTime_ECU" SG_ 2565865458 RoadFieldModeToDriveTrain 5000;
BA_ "GenSigSendType" SG_ 2565865458 RoadFieldModeToDriveTrain 0;
BA_ "GenSigTimeoutTime_ECU" SG_ 2565865458 ScndryBrakeCtrlVlv2 5000;
BA_ "GenSigSendType" SG_ 2565865458 ScndryBrakeCtrlVlv2 0;
BA_ "GenSigTimeoutTime_ECU" SG_ 2565865458 HydroHndlPstnToDriveTrain 5000;
BA_ "GenSigSendType" SG_ 2565865458 HydroHndlPstnToDriveTrain 0;
BA_ "GenSigTimeoutTime_ECU" SG_ 2565865458 TireSizeRearOnly 5000;
BA_ "GenSigSendType" SG_ 2565865458 TireSizeRearOnly 0;
BA_ "GenSigTimeoutTime_ECU" SG_ 2565865458 TireSizeFrntOnly 5000;
BA_ "GenSigSendType" SG_ 2565865458 TireSizeFrntOnly 0;
BA_ "GenSigTimeoutTime_ECU" SG_ 2565865458 EngineDisplacement 5000;
BA_ "GenSigSendType" SG_ 2565865458 EngineDisplacement 0;
BA_ "GenSigTimeoutTime_ECU" SG_ 2565865216 CmdBytePGN61184_ECU 60000;
BA_ "GenSigTimeoutTime_ECU" SG_ 2565865216 PGNRqstProp 60000;
BA_ "GenSigTimeoutTime_ECU" SG_ 2565865216 REQPGNCMDBYTE1 60000;
BA_ "GenSigTimeoutTime_ECU" SG_ 2565865216 PGNRqstProp 60000;
BA_ "GenSigTimeoutTime_ECU" SG_ 2565865216 REQPGNCMDBYTE1 60000;
BA_ "GenSigTimeoutTime_ECU" SG_ 2565865216 REQPGNCMDBYTE2 60000;
BA_ "GenSigTimeoutTime_ECU" SG_ 2565865216 IOExpInputPinMeas1ResponseA 60000;
BA_ "GenSigSendType" SG_ 2565865216 IOExpInputPinMeas1ResponseA 0;
BA_ "GenSigTimeoutTime_ECU" SG_ 2565865216 IOExpInputPinMeas1ResponseB 60000;
BA_ "GenSigSendType" SG_ 2565865216 IOExpInputPinMeas1ResponseB 0;
BA_ "GenSigTimeoutTime_ECU" SG_ 2565865216 IOExpInputPinMeas1ResponseC 60000;
BA_ "GenSigSendType" SG_ 2565865216 IOExpInputPinMeas1ResponseC 0;
BA_ "GenSigTimeoutTime_ECU" SG_ 2565865216 CompressionTest 60000;
BA_ "GenSigSendType" SG_ 2565865216 CompressionTest 0;
BA_ "GenSigTimeoutTime_ECU" SG_ 2565865216 CylinderDiagnostics 60000;
BA_ "GenSigSendType" SG_ 2565865216 CylinderDiagnostics 0;
BA_ "GenSigTimeoutTime_ECU" SG_ 2565865216 CylinderCutoutTest 60000;
BA_ "GenSigSendType" SG_ 2565865216 CylinderCutoutTest 0;
BA_ "GenSigTimeoutTime_ECU" SG_ 2565865216 CylinderDiagnosticsTrigger 60000;
BA_ "GenSigSendType" SG_ 2565865216 CylinderDiagnosticsTrigger 0;
BA_ "GenSigTimeoutTime_ECU" SG_ 2565865216 ActuatorDriverTest 60000;
BA_ "GenSigSendType" SG_ 2565865216 ActuatorDriverTest 0;
BA_ "GenSigTimeoutTime_ECU" SG_ 2565865216 EngiOverShutTestEnab 60000;
BA_ "GenSigSendType" SG_ 2565865216 EngiOverShutTestEnab 0;
BA_ "GenSigTimeoutTime_ECU" SG_ 2565865216 CompressionTestState 60000;
BA_ "GenSigSendType" SG_ 2565865216 CompressionTestState 0;
BA_ "GenSigTimeoutTime_ECU" SG_ 2565865216 CylinderDiagnosticsState 60000;
BA_ "GenSigSendType" SG_ 2565865216 CylinderDiagnosticsState 0;
BA_ "GenSigTimeoutTime_ECU" SG_ 2565865216 CylinderCutoutCylinderNumber 60000;
BA_ "GenSigSendType" SG_ 2565865216 CylinderCutoutCylinderNumber 0;
BA_ "GenSigTimeoutTime_ECU" SG_ 2565865216 ActuatorTestIndex 60000;
BA_ "GenSigSendType" SG_ 2565865216 ActuatorTestIndex 0;
BA_ "GenSigTimeoutTime_ECU" SG_ 2565865216 ActuatorTestType 60000;
BA_ "GenSigSendType" SG_ 2565865216 ActuatorTestType 0;
BA_ "GenSigTimeoutTime_ECU" SG_ 2565865216 ActuatorOutputValue 60000;
BA_ "GenSigSendType" SG_ 2565865216 ActuatorOutputValue 0;
BA_ "GenSigTimeoutTime_ECU" SG_ 2565865216 AftrNmbrSulfDepCleaEven 60000;
BA_ "GenSigSendType" SG_ 2565865216 AftrNmbrSulfDepCleaEven 0;
BA_ "GenSigTimeoutTime_ECU" SG_ 2565865216 AftrNmbrNOxCnvrEffnRcovEven 60000;
BA_ "GenSigSendType" SG_ 2565865216 AftrNmbrNOxCnvrEffnRcovEven 0;
BA_ "GenSigTimeoutTime_ECU" SG_ 2565865216 AftrtrtmntNmbrUreaDepCleanEvent 60000;
BA_ "GenSigSendType" SG_ 2565865216 AftrtrtmntNmbrUreaDepCleanEvent 0;
BA_ "GenSigTimeoutTime_ECU" SG_ 2565865216 IOExpaOutpPinStatMess1PinStat 60000;
BA_ "GenSigSendType" SG_ 2565865216 IOExpaOutpPinStatMess1PinStat 0;
BA_ "GenSigTimeoutTime_ECU" SG_ 2565865216 IOExpOutputPinState3DutyCycle 60000;
BA_ "GenSigSendType" SG_ 2565865216 IOExpOutputPinState3DutyCycle 0;
BA_ "GenSigTimeoutTime_ECU" SG_ 2565865216 IOExpOutputPinState3Frequency 60000;
BA_ "GenSigSendType" SG_ 2565865216 IOExpOutputPinState3Frequency 0;
BA_ "GenSigTimeoutTime_ECU" SG_ 2565865216 IOExpOutputPinState3CurrentFbk 60000;
BA_ "GenSigSendType" SG_ 2565865216 IOExpOutputPinState3CurrentFbk 0;
BA_ "GenSigTimeoutTime_ECU" SG_ 2565865216 IOExpOutputPinState3Status 60000;
BA_ "GenSigSendType" SG_ 2565865216 IOExpOutputPinState3Status 0;
BA_ "GenSigTimeoutTime_ECU" SG_ 2565865216 FlexpowerStatusCounter 60000;
BA_ "GenSigSendType" SG_ 2565865216 FlexpowerStatusCounter 0;
BA_ "GenSigTimeoutTime_ECU" SG_ 2565865216 FlexpowerStatus 60000;
BA_ "GenSigSendType" SG_ 2565865216 FlexpowerStatus 0;
BA_ "GenSigTimeoutTime_ECU" SG_ 2565865216 FlexpowerTimeoutErrorIndicator 60000;
BA_ "GenSigSendType" SG_ 2565865216 FlexpowerTimeoutErrorIndicator 0;
BA_ "GenSigTimeoutTime_ECU" SG_ 2565865216 FlexpowerWatchdogErrorIndicator 60000;
BA_ "GenSigSendType" SG_ 2565865216 FlexpowerWatchdogErrorIndicator 0;
BA_ "GenSigTimeoutTime_ECU" SG_ 2565865216 FlexpowerAuthErrorIndicator 60000;
BA_ "GenSigSendType" SG_ 2565865216 FlexpowerAuthErrorIndicator 0;
BA_ "GenSigTimeoutTime_ECU" SG_ 2565865216 JDPresEngCtrlMode 60000;
BA_ "GenSigSendType" SG_ 2565865216 JDPresEngCtrlMode 0;
BA_ "GenSigTimeoutTime_ECU" SG_ 2565865216 EngOpStateFromEcu 60000;
BA_ "GenSigSendType" SG_ 2565865216 EngOpStateFromEcu 0;
BA_ "GenSigTimeoutTime_ECU" SG_ 2565865216 EngWaitToStartLamp 60000;
BA_ "GenSigSendType" SG_ 2565865216 EngWaitToStartLamp 0;
BA_ "GenSigTimeoutTime_ECU" SG_ 2565865216 EngProtectSysHasShtdwnEng 60000;
BA_ "GenSigSendType" SG_ 2565865216 EngProtectSysHasShtdwnEng 0;
BA_ "GenSigTimeoutTime_ECU" SG_ 2565865216 RemainingStartingAidTime 60000;
BA_ "GenSigSendType" SG_ 2565865216 RemainingStartingAidTime 0;
BA_ "GenSigTimeoutTime_ECU" SG_ 2565865216 EngStrCooldwnTimer 60000;
BA_ "GenSigSendType" SG_ 2565865216 EngStrCooldwnTimer 0;
BA_ "GenSigTimeoutTime_ECU" SG_ 2565865216 MngdEngShutdwnCooldwnTimer 60000;
BA_ "GenSigSendType" SG_ 2565865216 MngdEngShutdwnCooldwnTimer 0;
BA_ "GenSigTimeoutTime_ECU" SG_ 2565865216 EngTorqueDerateSetpnt 60000;
BA_ "GenSigSendType" SG_ 2565865216 EngTorqueDerateSetpnt 0;
BA_ "GenSigTimeoutTime_ECU" SG_ 2565865216 DPFTtlNmbrOfActRegen 60000;
BA_ "GenSigSendType" SG_ 2565865216 DPFTtlNmbrOfActRegen 0;
BA_ "GenSigTimeoutTime_ECU" SG_ 2565865216 DPFTtlNmbrOfAbrtdRegen 60000;
BA_ "GenSigSendType" SG_ 2565865216 DPFTtlNmbrOfAbrtdRegen 0;
BA_ "GenSigTimeoutTime_ECU" SG_ 2565865216 DPFPresNmbrAbortRegen 60000;
BA_ "GenSigSendType" SG_ 2565865216 DPFPresNmbrAbortRegen 0;
BA_ "GenSigTimeoutTime_ECU" SG_ 2565865216 SPRMaxTorque 60000;
BA_ "GenSigSendType" SG_ 2565865216 SPRMaxTorque 0;
BA_ "GenSigTimeoutTime_ECU" SG_ 2565865216 SPRActiveFlag 60000;
BA_ "GenSigSendType" SG_ 2565865216 SPRActiveFlag 0;
BA_ "GenSigTimeoutTime_ECU" SG_ 2298477059 CmdBytePGN65530_PTP 500;
BA_ "GenSigTimeoutTime_ECU" SG_ 2298477059 ParkingBrakeSwitch 500;
BA_ "GenSigSendType" SG_ 2298477059 ParkingBrakeSwitch 0;
BA_ "GenSigTimeoutTime_ECU" SG_ 2298477059 TransmissionEnableCommand 500;
BA_ "GenSigSendType" SG_ 2298477059 TransmissionEnableCommand 0;
BA_ "GenSigTimeoutTime_ECU" SG_ 2298477059 HydroHandleOutOfNeutral 500;
BA_ "GenSigSendType" SG_ 2298477059 HydroHandleOutOfNeutral 0;
BA_ "GenSigTimeoutTime_ECU" SG_ 2298477059 PropulsionEngineSpeedRequest 500;
BA_ "GenSigSendType" SG_ 2298477059 PropulsionEngineSpeedRequest 0;
BA_ "GenSigTimeoutTime_ECU" SG_ 2499803902 CmdBytePGN65530_Vector_XXX 5000;
BA_ "GenSigTimeoutTime_ECU" SG_ 2499803902 HydrCharPresSensStat 5000;
BA_ "GenSigSendType" SG_ 2499803902 HydrCharPresSensStat 0;
BA_ "GenSigTimeoutTime_ECU" SG_ 2499803902 MaxEngineSpeedRequest 5000;
BA_ "GenSigSendType" SG_ 2499803902 MaxEngineSpeedRequest 0;
BA_ "GenSigTimeoutTime_ECU" SG_ 2499803902 MinEngineSpeedRequest 5000;
BA_ "GenSigSendType" SG_ 2499803902 MinEngineSpeedRequest 0;
BA_ "GenSigTimeoutTime_ECU" SG_ 2499803902 EngineSpeedManagementActive 5000;
BA_ "GenSigSendType" SG_ 2499803902 EngineSpeedManagementActive 0;
BA_ "GenSigTimeoutTime_ECU" SG_ 2565865470 CmdBytePGN61184_Vector_XXX 5000;
BA_ "GenSigTimeoutTime_ECU" SG_ 2565865470 OpCtrlB2CmdByte4BitQuad14 5000;
BA_ "GenSigSendType" SG_ 2565865470 OpCtrlB2CmdByte4BitQuad14 0;
BA_ "GenSigTimeoutTime_ECU" SG_ 2565865470 OpCtrlB3CmdByte3BitQuad58 5000;
BA_ "GenSigSendType" SG_ 2565865470 OpCtrlB3CmdByte3BitQuad58 0;
BA_ "GenSigTimeoutTime_ECU" SG_ 2565865470 OpCtrlB3CmdByte6BitQuad14 5000;
BA_ "GenSigSendType" SG_ 2565865470 OpCtrlB3CmdByte6BitQuad14 0;
BA_ "GenSigTimeoutTime_ECU" SG_ 2565865470 OpCtrlB3CmdByte7BitQuad14 5000;
BA_ "GenSigSendType" SG_ 2565865470 OpCtrlB3CmdByte7BitQuad14 0;
BA_ "GenSigTimeoutTime_ECU" SG_ 2565865470 OpCtrlB3CmdByte7BitQuad58 5000;
BA_ "GenSigSendType" SG_ 2565865470 OpCtrlB3CmdByte7BitQuad58 0;
BA_ "GenSigTimeoutTime_ECU" SG_ 2565865470 OpCtrlB3CmdByte8BitQuad14 5000;
BA_ "GenSigSendType" SG_ 2565865470 OpCtrlB3CmdByte8BitQuad14 0;
BA_ "GenSigTimeoutTime_ECU" SG_ 2565865470 OpCtrlB3CmdByte8BitQuad58 5000;
BA_ "GenSigSendType" SG_ 2565865470 OpCtrlB3CmdByte8BitQuad58 0;
BA_ "GenSigTimeoutTime_ECU" SG_ 2565865470 OpCtrlB3CmdByte3BitQuad14 5000;
BA_ "GenSigSendType" SG_ 2565865470 OpCtrlB3CmdByte3BitQuad14 0;
BA_ "GenSigTimeoutTime_ECU" SG_ 2565865470 SecReq 5000;
BA_ "GenSigSendType" SG_ 2565865470 SecReq 0;
BA_ "GenSigTimeoutTime_ECU" SG_ 2565865470 EngStartCtrl 5000;
BA_ "GenSigSendType" SG_ 2565865470 EngStartCtrl 0;
BA_ "GenSigTimeoutTime_ECU" SG_ 2565865470 OpCtrlB5CmdByte8BitQuad14 5000;
BA_ "GenSigSendType" SG_ 2565865470 OpCtrlB5CmdByte8BitQuad14 0;
BA_ "GenSigTimeoutTime_ECU" SG_ 2565865222 CmdBytePGN61184_EIC 200;
BA_ "GenSigTimeoutTime_ECU" SG_ 2565865222 EngineDesiredOperatingState 200;
BA_ "GenSigSendType" SG_ 2565865222 EngineDesiredOperatingState 0;
BA_ "GenSigTimeoutTime_ECU" SG_ 2565801726 CmdBytePGN61184_Vector_XXX 60000;
BA_ "GenSigTimeoutTime_ECU" SG_ 2565801726 SecReq 60000;
BA_ "GenSigSendType" SG_ 2565801726 SecReq 0;
BA_ "GenSigTimeoutTime_ECU" SG_ 2565801472 CmdBytePGN61184_ECU 500;
BA_ "GenSigTimeoutTime_ECU" SG_ 2565801472 FlexpowerStatusCounter 500;
BA_ "GenSigSendType" SG_ 2565801472 FlexpowerStatusCounter 0;
BA_ "GenSigTimeoutTime_ECU" SG_ 2565801472 FlexpowerStatus 500;
BA_ "GenSigSendType" SG_ 2565801472 FlexpowerStatus 0;
BA_ "GenSigTimeoutTime_ECU" SG_ 2565801472 FlexpowerTimeoutErrorIndicator 500;
BA_ "GenSigSendType" SG_ 2565801472 FlexpowerTimeoutErrorIndicator 0;
BA_ "GenSigTimeoutTime_ECU" SG_ 2565801472 FlexpowerWatchdogErrorIndicator 500;
BA_ "GenSigSendType" SG_ 2565801472 FlexpowerWatchdogErrorIndicator 0;
BA_ "GenSigTimeoutTime_ECU" SG_ 2565801472 FlexpowerAuthErrorIndicator 500;
BA_ "GenSigSendType" SG_ 2565801472 FlexpowerAuthErrorIndicator 0;
BA_ "GenSigTimeoutTime_ECU" SG_ 2498756606 CmdBytePGN61184_Vector_XXX 5000;
BA_ "GenSigTimeoutTime_ECU" SG_ 2498756606 JDEngineTestMode 5000;
BA_ "GenSigSendType" SG_ 2498756606 JDEngineTestMode 0;
BA_ "GenSigTimeoutTime_ECU" SG_ 2498756606 JDEngineTestState 5000;
BA_ "GenSigSendType" SG_ 2498756606 JDEngineTestState 0;
BA_ "GenSigTimeoutTime_ECU" SG_ 2498756606 JDEngineTestActiveType 5000;
BA_ "GenSigSendType" SG_ 2498756606 JDEngineTestActiveType 0;
BA_ "GenSigTimeoutTime_ECU" SG_ 2498756606 JDEngineTestComponentID 5000;
BA_ "GenSigSendType" SG_ 2498756606 JDEngineTestComponentID 0;
BA_ "GenSigTimeoutTime_ECU" SG_ 2498756606 JDEngineTestPercentProgress 5000;
BA_ "GenSigSendType" SG_ 2498756606 JDEngineTestPercentProgress 0;
BA_ "GenSigTimeoutTime_ECU" SG_ 2498756606 HydrocarbonInjectorPurge 5000;
BA_ "GenSigSendType" SG_ 2498756606 HydrocarbonInjectorPurge 0;
BA_ "GenSigTimeoutTime_ECU" SG_ 2498756606 DiesOxidCataServReplComp 5000;
BA_ "GenSigSendType" SG_ 2498756606 DiesOxidCataServReplComp 0;
BA_ "GenSigTimeoutTime_ECU" SG_ 2498756606 DiesPartFiltUninHydrDiagClea 5000;
BA_ "GenSigSendType" SG_ 2498756606 DiesPartFiltUninHydrDiagClea 0;
BA_ "GenSigTimeoutTime_ECU" SG_ 2498756606 DiesOxidCataOutlTempDiagClea 5000;
BA_ "GenSigSendType" SG_ 2498756606 DiesOxidCataOutlTempDiagClea 0;
BA_ "GenSigTimeoutTime_ECU" SG_ 2498756606 DiesOxidCataUninHydrDiagClea 5000;
BA_ "GenSigSendType" SG_ 2498756606 DiesOxidCataUninHydrDiagClea 0;
BA_ "GenSigTimeoutTime_ECU" SG_ 2498756606 DiesPartFiltServReplComp 5000;
BA_ "GenSigSendType" SG_ 2498756606 DiesPartFiltServReplComp 0;
BA_ "GenSigTimeoutTime_ECU" SG_ 2498756606 DiesPartFiltUninHydrDiagClea 5000;
BA_ "GenSigSendType" SG_ 2498756606 DiesPartFiltUninHydrDiagClea 0;
BA_ "GenSigTimeoutTime_ECU" SG_ 2498756606 AfteDiesPartFiltRegeCleaFreqFaul 5000;
BA_ "GenSigSendType" SG_ 2498756606 AfteDiesPartFiltRegeCleaFreqFaul 0;
BA_ "GenSigTimeoutTime_ECU" SG_ 2498756606 ServcRegenReq 5000;
BA_ "GenSigSendType" SG_ 2498756606 ServcRegenReq 0;
BA_ "GenSigTimeoutTime_ECU" SG_ 2498756606 AfteDiesExhaFluiPresContRequ 5000;
BA_ "GenSigSendType" SG_ 2498756606 AfteDiesExhaFluiPresContRequ 0;
BA_ "GenSigTimeoutTime_ECU" SG_ 2498756606 AfteSCRReplRese 5000;
BA_ "GenSigSendType" SG_ 2498756606 AfteSCRReplRese 0;
BA_ "GenSigTimeoutTime_ECU" SG_ 2498756606 AfteDiesPartFiltOutlGasHighTempStatComm 5000;
BA_ "GenSigSendType" SG_ 2498756606 AfteDiesPartFiltOutlGasHighTempStatComm 0;
BA_ "GenSigTimeoutTime_ECU" SG_ 2498756606 AfteDiesExhaFluiTankHeatCoolValvTest 5000;
BA_ "GenSigSendType" SG_ 2498756606 AfteDiesExhaFluiTankHeatCoolValvTest 0;
BA_ "GenSigTimeoutTime_ECU" SG_ 2498756606 AfteDiesExhaFluiSystShutTest 5000;
BA_ "GenSigSendType" SG_ 2498756606 AfteDiesExhaFluiSystShutTest 0;
BA_ "GenSigTimeoutTime_ECU" SG_ 2498756606 AfteDiesExhaFluiInjeDiagTest 5000;
BA_ "GenSigSendType" SG_ 2498756606 AfteDiesExhaFluiInjeDiagTest 0;
BA_ "GenSigTimeoutTime_ECU" SG_ 2498756606 AfteDiesExhaFluiInjeQuanTest 5000;
BA_ "GenSigSendType" SG_ 2498756606 AfteDiesExhaFluiInjeQuanTest 0;
BA_ "GenSigTimeoutTime_ECU" SG_ 2498756606 AirCompEngageState 5000;
BA_ "GenSigSendType" SG_ 2498756606 AirCompEngageState 0;
BA_ "GenSigTimeoutTime_ECU" SG_ 2498756606 EngRun 5000;
BA_ "GenSigSendType" SG_ 2498756606 EngRun 0;
BA_ "GenSigTimeoutTime_ECU" SG_ 2498756606 EnginePowerPercent 5000;
BA_ "GenSigSendType" SG_ 2498756606 EnginePowerPercent 0;
BA_ "GenSigTimeoutTime_ECU" SG_ 2498756606 HdrType 5000;
BA_ "GenSigSendType" SG_ 2498756606 HdrType 0;
BA_ "GenSigTimeoutTime_ECU" SG_ 2298477566 CmdBytePGN65531_Vector_XXX 400;
BA_ "GenSigTimeoutTime_ECU" SG_ 2298477566 GSACommandStatus 400;
BA_ "GenSigSendType" SG_ 2298477566 GSACommandStatus 0;
BA_ "GenSigTimeoutTime_ECU" SG_ 2298477566 GSACommandSpeed 400;
BA_ "GenSigSendType" SG_ 2298477566 GSACommandSpeed 0;
BA_ "GenSigTimeoutTime_ECU" SG_ 2499803907 CmdBytePGN65531_PTP 5000;
BA_ "GenSigTimeoutTime_ECU" SG_ 2499803907 GSAStatus 5000;
BA_ "GenSigSendType" SG_ 2499803907 GSAStatus 0;
BA_ "GenSigTimeoutTime_ECU" SG_ 2499803907 GSAOperatorDesiredSpeed 5000;
BA_ "GenSigSendType" SG_ 2499803907 GSAOperatorDesiredSpeed 0;
BA_ "GenSigTimeoutTime_ECU" SG_ 2499803907 GSAMinVehSpdLim 5000;
BA_ "GenSigSendType" SG_ 2499803907 GSAMinVehSpdLim 0;
BA_ "GenSigTimeoutTime_ECU" SG_ 2566912771 CmdBytePGN65531_PTP 5000;
BA_ "GenSigTimeoutTime_ECU" SG_ 2566912771 GSAMaxVehSpdLim 5000;
BA_ "GenSigSendType" SG_ 2566912771 GSAMaxVehSpdLim 0;
BA_ "GenSigTimeoutTime_ECU" SG_ 2566912771 GSATransmissionPower 5000;
BA_ "GenSigSendType" SG_ 2566912771 GSATransmissionPower 0;
BA_ "GenSigTimeoutTime_ECU" SG_ 2566911230 CmdBytePGN65524_Vector_XXX 1000;
BA_ "GenSigTimeoutTime_ECU" SG_ 2566911230 SteeringResponseRate 1000;
BA_ "GenSigSendType" SG_ 2566911230 SteeringResponseRate 0;
BA_ "GenSigTimeoutTime_ECU" SG_ 2566911230 GPSMsgRate 1000;
BA_ "GenSigSendType" SG_ 2566911230 GPSMsgRate 0;
BA_ "GenSigTimeoutTime_ECU" SG_ 2566911230 AutoTracWheelbase_GSCJDE 1000;
BA_ "GenSigSendType" SG_ 2566911230 AutoTracWheelbase_GSCJDE 0;
BA_ "GenSigTimeoutTime_ECU" SG_ 2566911230 InnerLoopGain 1000;
BA_ "GenSigSendType" SG_ 2566911230 InnerLoopGain 0;
BA_ "GenSigTimeoutTime_ECU" SG_ 2566911230 AT2ExitCode_GSCJDE 1000;
BA_ "GenSigSendType" SG_ 2566911230 AT2ExitCode_GSCJDE 0;
BA_ "GenSigTimeoutTime_ECU" SG_ 2566911230 CrvtrCntrlATState_GSCJDE 1000;
BA_ "GenSigSendType" SG_ 2566911230 CrvtrCntrlATState_GSCJDE 0;
BA_ "GenSigTimeoutTime_ECU" SG_ 2566911230 Heartbeat 1000;
BA_ "GenSigSendType" SG_ 2566911230 Heartbeat 0;
BA_ "GenSigTimeoutTime_ECU" SG_ 2297430014 CmdBytePGN61184_Vector_XXX 500;
BA_ "GenSigTimeoutTime_ECU" SG_ 2297430014 SeparatorDrive 500;
BA_ "GenSigSendType" SG_ 2297430014 SeparatorDrive 0;
BA_ "GenSigTimeoutTime_ECU" SG_ 2566913022 CmdBytePGN65531_Vector_XXX 5000;
BA_ "GenSigTimeoutTime_ECU" SG_ 2566913022 KeySwitchStart 5000;
BA_ "GenSigSendType" SG_ 2566913022 KeySwitchStart 0;
BA_ "GenSigTimeoutTime_ECU" SG_ 2566913022 KeySwitchRun 5000;
BA_ "GenSigSendType" SG_ 2566913022 KeySwitchRun 0;
BA_ "GenSigTimeoutTime_ECU" SG_ 2566913022 HillmasterSystemMode 5000;
BA_ "GenSigSendType" SG_ 2566913022 HillmasterSystemMode 0;
BA_ "GenSigTimeoutTime_ECU" SG_ 2566913022 HillMasterTiltRequest 5000;
BA_ "GenSigSendType" SG_ 2566913022 HillMasterTiltRequest 0;
BA_ "GenSigTimeoutTime_ECU" SG_ 2565865219 CmdBytePGN61184_PTP 5000;
BA_ "GenSigTimeoutTime_ECU" SG_ 2565865219 PGNRqstProp 5000;
BA_ "GenSigTimeoutTime_ECU" SG_ 2565865219 REQPGNCMDBYTE1 5000;
BA_ "GenSigTimeoutTime_ECU" SG_ 2565865219 PGNRqstProp 5000;
BA_ "GenSigTimeoutTime_ECU" SG_ 2565865219 REQPGNCMDBYTE1 5000;
BA_ "GenSigTimeoutTime_ECU" SG_ 2565865219 REQPGNCMDBYTE2 5000;
BA_ "GenSigTimeoutTime_ECU" SG_ 2565865219 OpCtrlB2RspByte4BitQuad14 5000;
BA_ "GenSigSendType" SG_ 2565865219 OpCtrlB2RspByte4BitQuad14 0;
BA_ "GenSigTimeoutTime_ECU" SG_ 2565865219 ActVehicleCalPDC 5000;
BA_ "GenSigSendType" SG_ 2565865219 ActVehicleCalPDC 0;
BA_ "GenSigTimeoutTime_ECU" SG_ 2565865219 CalStepPDC 5000;
BA_ "GenSigSendType" SG_ 2565865219 CalStepPDC 0;
BA_ "GenSigTimeoutTime_ECU" SG_ 2565865219 OpCtrlB3RspByte3BitQuad58 5000;
BA_ "GenSigSendType" SG_ 2565865219 OpCtrlB3RspByte3BitQuad58 0;
BA_ "GenSigTimeoutTime_ECU" SG_ 2565865219 OpCtrlB3RspByte6BitQuad14 5000;
BA_ "GenSigSendType" SG_ 2565865219 OpCtrlB3RspByte6BitQuad14 0;
BA_ "GenSigTimeoutTime_ECU" SG_ 2565865219 OpCtrlB3RspByte7BitQuad14 5000;
BA_ "GenSigSendType" SG_ 2565865219 OpCtrlB3RspByte7BitQuad14 0;
BA_ "GenSigTimeoutTime_ECU" SG_ 2565865219 OpCtrlB3RspByte7BitQuad58 5000;
BA_ "GenSigSendType" SG_ 2565865219 OpCtrlB3RspByte7BitQuad58 0;
BA_ "GenSigTimeoutTime_ECU" SG_ 2565865219 OpCtrlB3RspByte8BitQuad14 5000;
BA_ "GenSigSendType" SG_ 2565865219 OpCtrlB3RspByte8BitQuad14 0;
BA_ "GenSigTimeoutTime_ECU" SG_ 2565865219 OpCtrlB3RspByte8BitQuad58 5000;
BA_ "GenSigSendType" SG_ 2565865219 OpCtrlB3RspByte8BitQuad58 0;
BA_ "GenSigTimeoutTime_ECU" SG_ 2565865219 OpCtrlB3RspByte3BitQuad14 5000;
BA_ "GenSigSendType" SG_ 2565865219 OpCtrlB3RspByte3BitQuad14 0;
BA_ "GenSigTimeoutTime_ECU" SG_ 2565865219 OpCtrlB3RspByte3BitQuad58 5000;
BA_ "GenSigSendType" SG_ 2565865219 OpCtrlB3RspByte3BitQuad58 0;
BA_ "GenSigTimeoutTime_ECU" SG_ 2565865219 OpCtrlB3RspByte6BitQuad14 5000;
BA_ "GenSigSendType" SG_ 2565865219 OpCtrlB3RspByte6BitQuad14 0;
BA_ "GenSigTimeoutTime_ECU" SG_ 2565865219 OpCtrlB3RspByte7BitQuad14 5000;
BA_ "GenSigSendType" SG_ 2565865219 OpCtrlB3RspByte7BitQuad14 0;
BA_ "GenSigTimeoutTime_ECU" SG_ 2565865219 OpCtrlB3RspByte7BitQuad58 5000;
BA_ "GenSigSendType" SG_ 2565865219 OpCtrlB3RspByte7BitQuad58 0;
BA_ "GenSigTimeoutTime_ECU" SG_ 2565865219 OpCtrlB3RspByte8BitQuad14 5000;
BA_ "GenSigSendType" SG_ 2565865219 OpCtrlB3RspByte8BitQuad14 0;
BA_ "GenSigTimeoutTime_ECU" SG_ 2565865219 OpCtrlB3RspByte8BitQuad58 5000;
BA_ "GenSigSendType" SG_ 2565865219 OpCtrlB3RspByte8BitQuad58 0;
BA_ "GenSigTimeoutTime_ECU" SG_ 2565865219 OpCtrlB5RspByte8BitQuad14 5000;
BA_ "GenSigSendType" SG_ 2565865219 OpCtrlB5RspByte8BitQuad14 0;
BA_ "GenSigTimeoutTime_ECU" SG_ 2565865219 CurrentGearRangeFromDriveTrain 5000;
BA_ "GenSigSendType" SG_ 2565865219 CurrentGearRangeFromDriveTrain 0;
BA_ "GenSigTimeoutTime_ECU" SG_ 2565865219 MaxVehSpdLim 5000;
BA_ "GenSigSendType" SG_ 2565865219 MaxVehSpdLim 0;
BA_ "GenSigTimeoutTime_ECU" SG_ 2565865219 ProDriveTransModeFromDriveTrain 5000;
BA_ "GenSigSendType" SG_ 2565865219 ProDriveTransModeFromDriveTrain 0;
BA_ "GenSigTimeoutTime_ECU" SG_ 2565865219 CurrentGearRangeFromDriveTrain 5000;
BA_ "GenSigSendType" SG_ 2565865219 CurrentGearRangeFromDriveTrain 0;
BA_ "GenSigTimeoutTime_ECU" SG_ 2565865219 TransmissionLimOpFaultStatus 5000;
BA_ "GenSigSendType" SG_ 2565865219 TransmissionLimOpFaultStatus 0;
BA_ "GenSigTimeoutTime_ECU" SG_ 2565865219 TowModeAvailable 5000;
BA_ "GenSigSendType" SG_ 2565865219 TowModeAvailable 0;
BA_ "GenSigTimeoutTime_ECU" SG_ 2565865219 TransmissionCoolingRequest 5000;
BA_ "GenSigSendType" SG_ 2565865219 TransmissionCoolingRequest 0;
BA_ "GenSigTimeoutTime_ECU" SG_ 2565865219 FourWDStatusFromDrivetrain 5000;
BA_ "GenSigSendType" SG_ 2565865219 FourWDStatusFromDrivetrain 0;
BA_ "GenSigTimeoutTime_ECU" SG_ 2565865219 DiffLockStateFromDrivetrain 5000;
BA_ "GenSigSendType" SG_ 2565865219 DiffLockStateFromDrivetrain 0;
BA_ "GenSigTimeoutTime_ECU" SG_ 2565865219 TransmissionLimOpFaultStatus 5000;
BA_ "GenSigSendType" SG_ 2565865219 TransmissionLimOpFaultStatus 0;
BA_ "GenSigTimeoutTime_ECU" SG_ 2565865219 TowModeAvailable 5000;
BA_ "GenSigSendType" SG_ 2565865219 TowModeAvailable 0;
BA_ "GenSigTimeoutTime_ECU" SG_ 2565865219 TransmissionCoolingRequest 5000;
BA_ "GenSigSendType" SG_ 2565865219 TransmissionCoolingRequest 0;
BA_ "GenSigTimeoutTime_ECU" SG_ 2565865219 FourWDStatusFromDrivetrain 5000;
BA_ "GenSigSendType" SG_ 2565865219 FourWDStatusFromDrivetrain 0;
BA_ "GenSigTimeoutTime_ECU" SG_ 2565865219 DiffLockStateFromDrivetrain 5000;
BA_ "GenSigSendType" SG_ 2565865219 DiffLockStateFromDrivetrain 0;
BA_ "GenSigTimeoutTime_ECU" SG_ 2566914046 CmdBytePGN65535_Vector_XXX 5000;
BA_ "GenSigTimeoutTime_ECU" SG_ 2566914046 ReqVehicleCal 5000;
BA_ "GenSigSendType" SG_ 2566914046 ReqVehicleCal 0;
BA_ "GenSigTimeoutTime_ECU" SG_ 2566914046 CalMode 5000;
BA_ "GenSigSendType" SG_ 2566914046 CalMode 0;
BA_ "GenSigTimeoutTime_ECU" SG_ 2498756594 CmdBytePGN61184_PDC 5000;
BA_ "GenSigTimeoutTime_ECU" SG_ 2498756594 IOExpOutputPinCtrlReq3DutyCycle 5000;
BA_ "GenSigSendType" SG_ 2498756594 IOExpOutputPinCtrlReq3DutyCycle 0;
BA_ "GenSigTimeoutTime_ECU" SG_ 2498756594 IOExpOutputPinCtrlReq3Frequency 5000;
BA_ "GenSigSendType" SG_ 2498756594 IOExpOutputPinCtrlReq3Frequency 0;
BA_ "GenSigTimeoutTime_ECU" SG_ 2498756594 TransmissionCmdLimOp 5000;
BA_ "GenSigSendType" SG_ 2498756594 TransmissionCmdLimOp 0;
BA_ "GenSigTimeoutTime_ECU" SG_ 2498756594 MachTowModeParkBrakeReq 5000;
BA_ "GenSigSendType" SG_ 2498756594 MachTowModeParkBrakeReq 0;
BA_ "GenSigTimeoutTime_ECU" SG_ 2498756594 QuickStopSwitchToDriveTrain 5000;
BA_ "GenSigSendType" SG_ 2498756594 QuickStopSwitchToDriveTrain 0;
BA_ "GenSigTimeoutTime_ECU" SG_ 2498756594 MachHarvStatToDrivTrai 5000;
BA_ "GenSigSendType" SG_ 2498756594 MachHarvStatToDrivTrai 0;
BA_ "GenSigTimeoutTime_ECU" SG_ 2498756594 HandleSensitivity 5000;
BA_ "GenSigSendType" SG_ 2498756594 HandleSensitivity 0;
BA_ "GenSigTimeoutTime_ECU" SG_ 2498756594 ProDriveMaxSpdSetpnt 5000;
BA_ "GenSigSendType" SG_ 2498756594 ProDriveMaxSpdSetpnt 0;
BA_ "GenSigTimeoutTime_ECU" SG_ 2498756594 ProDriveMaxSpdSetpnt2 5000;
BA_ "GenSigSendType" SG_ 2498756594 ProDriveMaxSpdSetpnt2 0;
BA_ "GenSigTimeoutTime_ECU" SG_ 2565865407 CmdBytePGN61184_PDE 60000;
BA_ "GenSigTimeoutTime_ECU" SG_ 2565865407 PGNRqstProp 60000;
BA_ "GenSigTimeoutTime_ECU" SG_ 2565865407 REQPGNCMDBYTE1 60000;
BA_ "GenSigTimeoutTime_ECU" SG_ 2565865407 PGNRqstProp 60000;
BA_ "GenSigTimeoutTime_ECU" SG_ 2565865407 REQPGNCMDBYTE1 60000;
BA_ "GenSigTimeoutTime_ECU" SG_ 2565865407 REQPGNCMDBYTE2 60000;
BA_ "GenSigTimeoutTime_ECU" SG_ 2565800704 CmdBytePGN61184_ECU 60000;
BA_ "GenSigTimeoutTime_ECU" SG_ 2565861888 CmdBytePGN61184_ECU 60000;
BA_ "GenSigTimeoutTime_ECU" SG_ 2565848832 CmdBytePGN61184_ECU 60000;
BA_ "GenSigTimeoutTime_ECU" SG_ 2565799939 CmdBytePGN61184_PBS 60000;
BA_ "GenSigTimeoutTime_ECU" SG_ 2565861891 CmdBytePGN61184_PBS 60000;
BA_ "GenSigTimeoutTime_ECU" SG_ 2565848835 CmdBytePGN61184_PBS 60000;
BA_ "GenSigTimeoutTime_ECU" SG_ 2565800707 CmdBytePGN61184_PBS 60000;
BA_ "GenSigTimeoutTime_ECU" SG_ 2565800178 CmdBytePGN61184_PDC 60000;
BA_ "GenSigTimeoutTime_ECU" SG_ 2565800946 CmdBytePGN61184_PDC 60000;
BA_ "GenSigTimeoutTime_ECU" SG_ 2565849074 CmdBytePGN61184_PDC 60000;
BA_ "GenSigTimeoutTime_ECU" SG_ 2565800127 CmdBytePGN61184_PDE 60000;
BA_ "GenSigTimeoutTime_ECU" SG_ 2565800895 CmdBytePGN61184_PDE 60000;
BA_ "GenSigTimeoutTime_ECU" SG_ 2565862079 CmdBytePGN61184_PDE 60000;
BA_ "GenSigTimeoutTime_ECU" SG_ 2566912000 CmdBytePGN65528_ECU 5000;
BA_ "GenSigTimeoutTime_ECU" SG_ 2566912000 TimeRemaPresAftrSCRInduLvl 5000;
BA_ "GenSigSendType" SG_ 2566912000 TimeRemaPresAftrSCRInduLvl 0;
BA_ "GenSigTimeoutTime_ECU" SG_ 2364538624 CmdBytePGN61184_ECU 5000;
BA_ "GenSigTimeoutTime_ECU" SG_ 2364538624 EngineBrakeTorque 5000;
BA_ "GenSigSendType" SG_ 2364538624 EngineBrakeTorque 0;
BA_ "GenSigTimeoutTime_ECU" SG_ 2498691326 CmdBytePGN61184_Vector_XXX 5000;
BA_ "GenSigTimeoutTime_ECU" SG_ 2498691326 JDEngineTestMode 5000;
BA_ "GenSigSendType" SG_ 2498691326 JDEngineTestMode 0;
BA_ "GenSigTimeoutTime_ECU" SG_ 2498691326 JDEngineTestState 5000;
BA_ "GenSigSendType" SG_ 2498691326 JDEngineTestState 0;
BA_ "GenSigTimeoutTime_ECU" SG_ 2498691326 JDEngineTestActiveType 5000;
BA_ "GenSigSendType" SG_ 2498691326 JDEngineTestActiveType 0;
BA_ "GenSigTimeoutTime_ECU" SG_ 2498691326 JDEngineTestComponentID 5000;
BA_ "GenSigSendType" SG_ 2498691326 JDEngineTestComponentID 0;
BA_ "GenSigTimeoutTime_ECU" SG_ 2498691326 JDEngineTestPercentProgress 5000;
BA_ "GenSigSendType" SG_ 2498691326 JDEngineTestPercentProgress 0;
BA_ "GenSigTimeoutTime_ECU" SG_ 2566912768 CmdBytePGN65531_ECU 5000;
BA_ "GenSigTimeoutTime_ECU" SG_ 2566912768 LiftPumpMeasuredSpeed 5000;
BA_ "GenSigSendType" SG_ 2566912768 LiftPumpMeasuredSpeed 0;
BA_ "GenSigTimeoutTime_ECU" SG_ 2566912768 LiftPumpCommandedSpeed 5000;
BA_ "GenSigSendType" SG_ 2566912768 LiftPumpCommandedSpeed 0;
BA_ "GenSigTimeoutTime_ECU" SG_ 2566912768 LiftPumpCurrent 5000;
BA_ "GenSigSendType" SG_ 2566912768 LiftPumpCurrent 0;
BA_ "GenSigTimeoutTime_ECU" SG_ 2566912768 DEFPumpSpeedCommand 5000;
BA_ "GenSigSendType" SG_ 2566912768 DEFPumpSpeedCommand 0;
BA_ "GenSigTimeoutTime_ECU" SG_ 2566912768 DEFSupplyModulePressure 5000;
BA_ "GenSigSendType" SG_ 2566912768 DEFSupplyModulePressure 0;
BA_ "GenSigTimeoutTime_ECU" SG_ 2566913790 CmdBytePGN65534_Vector_XXX 25000;
BA_ "GenSigTimeoutTime_ECU" SG_ 2566913790 EngType 25000;
BA_ "GenSigSendType" SG_ 2566913790 EngType 0;
BA_ "GenSigTimeoutTime_ECU" SG_ 2565800958 CmdBytePGN61184_Vector_XXX 60000;
BA_ "GenSigTimeoutTime_ECU" SG_ 2565862142 CmdBytePGN61184_Vector_XXX 60000;
BA_ "GenSigTimeoutTime_ECU" SG_ 2565849086 CmdBytePGN61184_Vector_XXX 60000;
BA_ "GenSigTimeoutTime_ECU" SG_ 2432696318 CmdBytePGN65535_Vector_XXX 1250;
BA_ "GenSigTimeoutTime_ECU" SG_ 2432696318 OperatorSeatSwitch 1250;
BA_ "GenSigSendType" SG_ 2432696318 OperatorSeatSwitch 0;
BA_ "GenSigTimeoutTime_ECU" SG_ 2566913010 CmdBytePGN65531_PDC 25000;
BA_ "GenSigTimeoutTime_ECU" SG_ 2632974334 CmdBytePGN61184_Vector_XXX 25000;
BA_ "GenSigTimeoutTime_ECU" SG_ 2632974334 Opt4WD 25000;
BA_ "GenSigSendType" SG_ 2632974334 Opt4WD 0;
BA_ "GenSigTimeoutTime_ECU" SG_ 2632974334 EngSpdInRoadMode 25000;
BA_ "GenSigSendType" SG_ 2632974334 EngSpdInRoadMode 0;
BA_ "GenSigTimeoutTime_ECU" SG_ 2632974334 OptType4WD 25000;
BA_ "GenSigSendType" SG_ 2632974334 OptType4WD 0;
BA_ "GenSigTimeoutTime_ECU" SG_ 2632974334 TracksOption 25000;
BA_ "GenSigSendType" SG_ 2632974334 TracksOption 0;
BA_ "GenSigTimeoutTime_ECU" SG_ 2499803890 CmdBytePGN65530_PDC 5000;
BA_ "GenSigTimeoutTime_ECU" SG_ 2499803890 ASRTogCmd 5000;
BA_ "GenSigSendType" SG_ 2499803890 ASRTogCmd 0;
BA_ "GenSigTimeoutTime_ECU" SG_ 2634021630 CmdBytePGN65530_Vector_XXX 60000;
BA_ "GenSigTimeoutTime_ECU" SG_ 2634021630 TCMPitchCal 60000;
BA_ "GenSigSendType" SG_ 2634021630 TCMPitchCal 0;
BA_ "GenSigTimeoutTime_ECU" SG_ 2634021630 TCMRollCal 60000;
BA_ "GenSigSendType" SG_ 2634021630 TCMRollCal 0;
BA_ "GenSigTimeoutTime_ECU" SG_ 2634021630 TCMCalStatus 60000;
BA_ "GenSigSendType" SG_ 2634021630 TCMCalStatus 0;
BA_ "GenSigTimeoutTime_ECU" SG_ 2499805182 CmdBytePGN65535_Vector_XXX 5000;
BA_ "GenSigTimeoutTime_ECU" SG_ 2499805182 AutoClearDTCTime 5000;
BA_ "GenSigSendType" SG_ 2499805182 AutoClearDTCTime 0;
BA_ "GenSigTimeoutTime_ECU" SG_ 2297429763 CmdBytePGN61184_PBS 200;
BA_ "GenSigTimeoutTime_ECU" SG_ 2297429763 CntlrHeartbeat 200;
BA_ "GenSigSendType" SG_ 2297429763 CntlrHeartbeat 0;
BA_ "GenSigTimeoutTime_ECU" SG_ 2297429763 ParkBrakeRelCmd 200;
BA_ "GenSigSendType" SG_ 2297429763 ParkBrakeRelCmd 0;
BA_ "GenSigTimeoutTime_ECU" SG_ 2297429763 ParkBrakStatAutoFromDrivTrai 200;
BA_ "GenSigSendType" SG_ 2297429763 ParkBrakStatAutoFromDrivTrai 0;
BA_ "GenSigTimeoutTime_ECU" SG_ 2297429763 WheelBasedDirection 200;
BA_ "GenSigSendType" SG_ 2297429763 WheelBasedDirection 0;
BA_ "GenSigTimeoutTime_ECU" SG_ 2297429763 ParkLockFromDriveTrain 200;
BA_ "GenSigSendType" SG_ 2297429763 ParkLockFromDriveTrain 0;
BA_ "GenSigTimeoutTime_ECU" SG_ 2297429763 LimpModeStatus 200;
BA_ "GenSigSendType" SG_ 2297429763 LimpModeStatus 0;
BA_ "GenSigTimeoutTime_ECU" SG_ 2297429763 TowModeStatus 200;
BA_ "GenSigSendType" SG_ 2297429763 TowModeStatus 0;
BA_ "GenSigTimeoutTime_ECU" SG_ 2297429763 CntlrHeartbeat 200;
BA_ "GenSigSendType" SG_ 2297429763 CntlrHeartbeat 0;
BA_ "GenSigTimeoutTime_ECU" SG_ 2297429763 ParkBrakeRelCmd 200;
BA_ "GenSigSendType" SG_ 2297429763 ParkBrakeRelCmd 0;
BA_ "GenSigTimeoutTime_ECU" SG_ 2297429763 ParkBrakStatAutoFromDrivTrai 200;
BA_ "GenSigSendType" SG_ 2297429763 ParkBrakStatAutoFromDrivTrai 0;
BA_ "GenSigTimeoutTime_ECU" SG_ 2297429763 WheelBasedDirection 200;
BA_ "GenSigSendType" SG_ 2297429763 WheelBasedDirection 0;
BA_ "GenSigTimeoutTime_ECU" SG_ 2297429763 ProDriveSysVlvReq 200;
BA_ "GenSigSendType" SG_ 2297429763 ProDriveSysVlvReq 0;
BA_ "GenSigTimeoutTime_ECU" SG_ 2297429763 ParkLockFromDriveTrain 200;
BA_ "GenSigSendType" SG_ 2297429763 ParkLockFromDriveTrain 0;
BA_ "GenSigTimeoutTime_ECU" SG_ 2297429763 BackUpLightandAlarmHornCommand 200;
BA_ "GenSigSendType" SG_ 2297429763 BackUpLightandAlarmHornCommand 0;
BA_ "GenSigTimeoutTime_ECU" SG_ 2297429763 LimpModeStatus 200;
BA_ "GenSigSendType" SG_ 2297429763 LimpModeStatus 0;
BA_ "GenSigTimeoutTime_ECU" SG_ 2297429763 TowModeStatus 200;
BA_ "GenSigSendType" SG_ 2297429763 TowModeStatus 0;
BA_ "GenSigTimeoutTime_ECU" SG_ 2365586174 CmdBytePGN65530_Vector_XXX 200;
BA_ "GenSigTimeoutTime_ECU" SG_ 2365586174 VehRollAng 200;
BA_ "GenSigSendType" SG_ 2365586174 VehRollAng 0;
BA_ "GenSigTimeoutTime_ECU" SG_ 2365586174 RollRateExtRange 200;
BA_ "GenSigSendType" SG_ 2365586174 RollRateExtRange 0;
BA_ "GenSigTimeoutTime_ECU" SG_ 2365587454 CmdBytePGN65535_Vector_XXX 1000;
BA_ "GenSigTimeoutTime_ECU" SG_ 2365587454 VehRollAng 1000;
BA_ "GenSigSendType" SG_ 2365587454 VehRollAng 0;
BA_ "GenSigTimeoutTime_ECU" SG_ 2365587454 VehYawRate 1000;
BA_ "GenSigSendType" SG_ 2365587454 VehYawRate 0;
BA_ "GenSigTimeoutTime_ECU" SG_ 2298475762 CmdBytePGN65524_PDC 500;
BA_ "GenSigTimeoutTime_ECU" SG_ 2298475762 EngineRunningState 500;
BA_ "GenSigSendType" SG_ 2298475762 EngineRunningState 0;
BA_ "GenSigTimeoutTime_ECU" SG_ 2298475762 OperatorPresenceState 500;
BA_ "GenSigSendType" SG_ 2298475762 OperatorPresenceState 0;
BA_ "GenSigTimeoutTime_ECU" SG_ 2298475762 TransportSwitchState 500;
BA_ "GenSigSendType" SG_ 2298475762 TransportSwitchState 0;
BA_ "GenSigTimeoutTime_ECU" SG_ 2298475762 PrimaryResumeRequest 500;
BA_ "GenSigSendType" SG_ 2298475762 PrimaryResumeRequest 0;
BA_ "GenSigTimeoutTime_ECU" SG_ 2298475762 AuxiliaryResumeRequest 500;
BA_ "GenSigSendType" SG_ 2298475762 AuxiliaryResumeRequest 0;
BA_ "GenSigTimeoutTime_ECU" SG_ 2298475762 WheelBasedVehicleSpeed_VSAT 500;
BA_ "GenSigSendType" SG_ 2298475762 WheelBasedVehicleSpeed_VSAT 0;
BA_ "GenSigTimeoutTime_ECU" SG_ 2298475762 AT2ExitCode_VSAT 500;
BA_ "GenSigSendType" SG_ 2298475762 AT2ExitCode_VSAT 0;
BA_ "GenSigTimeoutTime_ECU" SG_ 2298475762 TransmissionState_VSAT 500;
BA_ "GenSigSendType" SG_ 2298475762 TransmissionState_VSAT 0;
BA_ "GenSigTimeoutTime_ECU" SG_ 2298475762 VehTreadWidth 500;
BA_ "GenSigSendType" SG_ 2298475762 VehTreadWidth 0;
BA_ "GenSigTimeoutTime_ECU" SG_ 2566912959 CmdBytePGN65531_PDE 60000;
BA_ "GenMsgCycleTime" BO_ 2566912003 60000;
BA_ "SingleFrame" BO_ 2566912003 1;
BA_ "GenMsgCycleTime" BO_ 2566912191 60000;
BA_ "SingleFrame" BO_ 2566912191 1;
BA_ "GenMsgCycleTime" BO_ 2632974083 60000;
BA_ "SingleFrame" BO_ 2632974083 1;
BA_ "GenMsgCycleTime" BO_ 2634021567 1000;
BA_ "SingleFrame" BO_ 2634021567 1;
BA_ "GenMsgCycleTime" BO_ 2649751296 60000;
BA_ "SingleFrame" BO_ 2649751296 1;
BA_ "GenMsgCycleTime" BO_ 2649751299 60000;
BA_ "SingleFrame" BO_ 2649751299 1;
BA_ "GenMsgCycleTime" BO_ 2649751538 60000;
BA_ "SingleFrame" BO_ 2649751538 1;
BA_ "GenMsgCycleTime" BO_ 2649751487 60000;
BA_ "SingleFrame" BO_ 2649751487 1;
BA_ "GenMsgCycleTime" BO_ 2649686784 60000;
BA_ "SingleFrame" BO_ 2649686784 1;
BA_ "GenMsgCycleTime" BO_ 2649747968 60000;
BA_ "SingleFrame" BO_ 2649747968 1;
BA_ "GenMsgCycleTime" BO_ 2649734912 60000;
BA_ "SingleFrame" BO_ 2649734912 1;
BA_ "GenMsgCycleTime" BO_ 2649686019 60000;
BA_ "SingleFrame" BO_ 2649686019 1;
BA_ "GenMsgCycleTime" BO_ 2649747971 60000;
BA_ "SingleFrame" BO_ 2649747971 1;
BA_ "GenMsgCycleTime" BO_ 2649734915 60000;
BA_ "SingleFrame" BO_ 2649734915 1;
BA_ "GenMsgCycleTime" BO_ 2649686258 60000;
BA_ "SingleFrame" BO_ 2649686258 1;
BA_ "GenMsgCycleTime" BO_ 2649687026 60000;
BA_ "SingleFrame" BO_ 2649687026 1;
BA_ "GenMsgCycleTime" BO_ 2649735154 60000;
BA_ "SingleFrame" BO_ 2649735154 1;
BA_ "GenMsgCycleTime" BO_ 2649686207 60000;
BA_ "SingleFrame" BO_ 2649686207 1;
BA_ "GenMsgCycleTime" BO_ 2649686975 60000;
BA_ "SingleFrame" BO_ 2649686975 1;
BA_ "GenMsgCycleTime" BO_ 2649748159 60000;
BA_ "SingleFrame" BO_ 2649748159 1;
BA_ "GenMsgCycleTime" BO_ 2230255622 60000;
BA_ "GenMsgSendType" BO_ 2230255622 0;
BA_ "GenMsgCycleTimeFast" BO_ 2230255622 60000;
BA_ "SingleFrame" BO_ 2230255622 1;
BA_ "GenMsgCycleTime" BO_ 2565865458 1000;
BA_ "GenMsgSendType" BO_ 2565865458 0;
BA_ "GenMsgCycleTimeFast" BO_ 2565865458 1000;
BA_ "SingleFrame" BO_ 2565865458 1;
BA_ "GenMsgCycleTime" BO_ 2565865216 60000;
BA_ "GenMsgSendType" BO_ 2565865216 0;
BA_ "GenMsgCycleTimeFast" BO_ 2565865216 60000;
BA_ "SingleFrame" BO_ 2565865216 1;
BA_ "GenMsgCycleTime" BO_ 2298477059 100;
BA_ "GenMsgSendType" BO_ 2298477059 0;
BA_ "GenMsgCycleTimeFast" BO_ 2298477059 100;
BA_ "SingleFrame" BO_ 2298477059 1;
BA_ "GenMsgCycleTime" BO_ 2499803902 1000;
BA_ "GenMsgSendType" BO_ 2499803902 0;
BA_ "GenMsgCycleTimeFast" BO_ 2499803902 100;
BA_ "SingleFrame" BO_ 2499803902 1;
BA_ "GenMsgCycleTime" BO_ 2565865470 1000;
BA_ "GenMsgSendType" BO_ 2565865470 0;
BA_ "GenMsgCycleTimeFast" BO_ 2565865470 100;
BA_ "SingleFrame" BO_ 2565865470 1;
BA_ "GenMsgCycleTime" BO_ 2565865222 40;
BA_ "GenMsgSendType" BO_ 2565865222 0;
BA_ "GenMsgCycleTimeFast" BO_ 2565865222 40;
BA_ "SingleFrame" BO_ 2565865222 1;
BA_ "GenMsgCycleTime" BO_ 2565801726 60000;
BA_ "GenMsgSendType" BO_ 2565801726 0;
BA_ "GenMsgCycleTimeFast" BO_ 2565801726 60000;
BA_ "SingleFrame" BO_ 2565801726 1;
BA_ "GenMsgCycleTime" BO_ 2565801472 100;
BA_ "GenMsgSendType" BO_ 2565801472 0;
BA_ "GenMsgCycleTimeFast" BO_ 2565801472 100;
BA_ "SingleFrame" BO_ 2565801472 1;
BA_ "GenMsgCycleTime" BO_ 2498756606 1000;
BA_ "GenMsgSendType" BO_ 2498756606 0;
BA_ "GenMsgCycleTimeFast" BO_ 2498756606 240;
BA_ "SingleFrame" BO_ 2498756606 1;
BA_ "GenMsgCycleTime" BO_ 2298477566 80;
BA_ "GenMsgSendType" BO_ 2298477566 0;
BA_ "GenMsgCycleTimeFast" BO_ 2298477566 80;
BA_ "SingleFrame" BO_ 2298477566 1;
BA_ "GenMsgCycleTime" BO_ 2499803907 1000;
BA_ "GenMsgSendType" BO_ 2499803907 0;
BA_ "GenMsgCycleTimeFast" BO_ 2499803907 240;
BA_ "SingleFrame" BO_ 2499803907 1;
BA_ "GenMsgCycleTime" BO_ 2566912771 1000;
BA_ "GenMsgSendType" BO_ 2566912771 0;
BA_ "GenMsgCycleTimeFast" BO_ 2566912771 240;
BA_ "SingleFrame" BO_ 2566912771 1;
BA_ "GenMsgCycleTime" BO_ 2566911230 200;
BA_ "GenMsgSendType" BO_ 2566911230 0;
BA_ "GenMsgCycleTimeFast" BO_ 2566911230 200;
BA_ "SingleFrame" BO_ 2566911230 1;
BA_ "GenMsgCycleTime" BO_ 2297430014 100;
BA_ "GenMsgSendType" BO_ 2297430014 0;
BA_ "GenMsgCycleTimeFast" BO_ 2297430014 125;
BA_ "SingleFrame" BO_ 2297430014 1;
BA_ "GenMsgCycleTime" BO_ 2566913022 1000;
BA_ "GenMsgSendType" BO_ 2566913022 0;
BA_ "GenMsgCycleTimeFast" BO_ 2566913022 1000;
BA_ "SingleFrame" BO_ 2566913022 1;
BA_ "GenMsgCycleTime" BO_ 2565865219 1000;
BA_ "GenMsgSendType" BO_ 2565865219 0;
BA_ "GenMsgCycleTimeFast" BO_ 2565865219 100;
BA_ "SingleFrame" BO_ 2565865219 1;
BA_ "GenMsgCycleTime" BO_ 2566914046 1000;
BA_ "GenMsgSendType" BO_ 2566914046 0;
BA_ "GenMsgCycleTimeFast" BO_ 2566914046 1000;
BA_ "SingleFrame" BO_ 2566914046 1;
BA_ "GenMsgCycleTime" BO_ 2498756594 1000;
BA_ "GenMsgSendType" BO_ 2498756594 0;
BA_ "GenMsgCycleTimeFast" BO_ 2498756594 1000;
BA_ "SingleFrame" BO_ 2498756594 1;
BA_ "GenMsgCycleTime" BO_ 2565865407 60000;
BA_ "SingleFrame" BO_ 2565865407 1;
BA_ "GenMsgCycleTime" BO_ 2565800704 60000;
BA_ "SingleFrame" BO_ 2565800704 1;
BA_ "GenMsgCycleTime" BO_ 2565861888 60000;
BA_ "SingleFrame" BO_ 2565861888 1;
BA_ "GenMsgCycleTime" BO_ 2565848832 60000;
BA_ "SingleFrame" BO_ 2565848832 1;
BA_ "GenMsgCycleTime" BO_ 2565799939 60000;
BA_ "SingleFrame" BO_ 2565799939 1;
BA_ "GenMsgCycleTime" BO_ 2565861891 60000;
BA_ "SingleFrame" BO_ 2565861891 1;
BA_ "GenMsgCycleTime" BO_ 2565848835 60000;
BA_ "SingleFrame" BO_ 2565848835 1;
BA_ "GenMsgCycleTime" BO_ 2565800707 60000;
BA_ "SingleFrame" BO_ 2565800707 1;
BA_ "GenMsgCycleTime" BO_ 2565800178 60000;
BA_ "SingleFrame" BO_ 2565800178 1;
BA_ "GenMsgCycleTime" BO_ 2565800946 60000;
BA_ "SingleFrame" BO_ 2565800946 1;
BA_ "GenMsgCycleTime" BO_ 2565849074 60000;
BA_ "SingleFrame" BO_ 2565849074 1;
BA_ "GenMsgCycleTime" BO_ 2565800127 60000;
BA_ "SingleFrame" BO_ 2565800127 1;
BA_ "GenMsgCycleTime" BO_ 2565800895 60000;
BA_ "SingleFrame" BO_ 2565800895 1;
BA_ "GenMsgCycleTime" BO_ 2565862079 60000;
BA_ "SingleFrame" BO_ 2565862079 1;
BA_ "GenMsgCycleTime" BO_ 2566912000 1000;
BA_ "GenMsgSendType" BO_ 2566912000 0;
BA_ "GenMsgCycleTimeFast" BO_ 2566912000 1000;
BA_ "SingleFrame" BO_ 2566912000 1;
BA_ "GenMsgCycleTime" BO_ 2364538624 1000;
BA_ "GenMsgSendType" BO_ 2364538624 0;
BA_ "GenMsgCycleTimeFast" BO_ 2364538624 20;
BA_ "SingleFrame" BO_ 2364538624 1;
BA_ "GenMsgCycleTime" BO_ 2498691326 1000;
BA_ "GenMsgSendType" BO_ 2498691326 0;
BA_ "GenMsgCycleTimeFast" BO_ 2498691326 1000;
BA_ "SingleFrame" BO_ 2498691326 1;
BA_ "GenMsgCycleTime" BO_ 2566912768 1000;
BA_ "GenMsgSendType" BO_ 2566912768 0;
BA_ "GenMsgCycleTimeFast" BO_ 2566912768 1000;
BA_ "SingleFrame" BO_ 2566912768 1;
BA_ "GenMsgCycleTime" BO_ 2566913790 5000;
BA_ "GenMsgSendType" BO_ 2566913790 0;
BA_ "GenMsgCycleTimeFast" BO_ 2566913790 125;
BA_ "SingleFrame" BO_ 2566913790 1;
BA_ "GenMsgCycleTime" BO_ 2565800958 60000;
BA_ "GenMsgSendType" BO_ 2565800958 0;
BA_ "GenMsgCycleTimeFast" BO_ 2565800958 60000;
BA_ "SingleFrame" BO_ 2565800958 1;
BA_ "GenMsgCycleTime" BO_ 2565862142 60000;
BA_ "GenMsgSendType" BO_ 2565862142 0;
BA_ "GenMsgCycleTimeFast" BO_ 2565862142 60000;
BA_ "SingleFrame" BO_ 2565862142 1;
BA_ "GenMsgCycleTime" BO_ 2565849086 60000;
BA_ "GenMsgSendType" BO_ 2565849086 0;
BA_ "GenMsgCycleTimeFast" BO_ 2565849086 60000;
BA_ "SingleFrame" BO_ 2565849086 1;
BA_ "GenMsgCycleTime" BO_ 2432696318 250;
BA_ "GenMsgSendType" BO_ 2432696318 0;
BA_ "GenMsgCycleTimeFast" BO_ 2432696318 250;
BA_ "SingleFrame" BO_ 2432696318 1;
BA_ "GenMsgCycleTime" BO_ 2566913010 5000;
BA_ "GenMsgSendType" BO_ 2566913010 0;
BA_ "GenMsgCycleTimeFast" BO_ 2566913010 5000;
BA_ "SingleFrame" BO_ 2566913010 1;
BA_ "GenMsgCycleTime" BO_ 2632974334 5000;
BA_ "GenMsgSendType" BO_ 2632974334 0;
BA_ "GenMsgCycleTimeFast" BO_ 2632974334 500;
BA_ "SingleFrame" BO_ 2632974334 1;
BA_ "GenMsgCycleTime" BO_ 2499803890 1000;
BA_ "GenMsgSendType" BO_ 2499803890 0;
BA_ "GenMsgCycleTimeFast" BO_ 2499803890 240;
BA_ "SingleFrame" BO_ 2499803890 1;
BA_ "GenMsgCycleTime" BO_ 2565865235 60000;
BA_ "SingleFrame" BO_ 2565865235 1;
BA_ "GenMsgCycleTime" BO_ 2634021630 60000;
BA_ "GenMsgSendType" BO_ 2634021630 0;
BA_ "GenMsgCycleTimeFast" BO_ 2634021630 60000;
BA_ "SingleFrame" BO_ 2634021630 1;
BA_ "GenMsgCycleTime" BO_ 2499805182 1000;
BA_ "GenMsgSendType" BO_ 2499805182 0;
BA_ "GenMsgCycleTimeFast" BO_ 2499805182 100;
BA_ "SingleFrame" BO_ 2499805182 1;
BA_ "GenMsgCycleTime" BO_ 2297429763 40;
BA_ "GenMsgSendType" BO_ 2297429763 0;
BA_ "GenMsgCycleTimeFast" BO_ 2297429763 40;
BA_ "SingleFrame" BO_ 2297429763 1;
BA_ "GenMsgCycleTime" BO_ 2365586174 40;
BA_ "GenMsgSendType" BO_ 2365586174 0;
BA_ "GenMsgCycleTimeFast" BO_ 2365586174 40;
BA_ "SingleFrame" BO_ 2365586174 1;
BA_ "GenMsgCycleTime" BO_ 2365587454 200;
BA_ "GenMsgSendType" BO_ 2365587454 0;
BA_ "GenMsgCycleTimeFast" BO_ 2365587454 200;
BA_ "SingleFrame" BO_ 2365587454 1;
BA_ "GenMsgCycleTime" BO_ 2298475762 100;
BA_ "GenMsgSendType" BO_ 2298475762 0;
BA_ "GenMsgCycleTimeFast" BO_ 2298475762 20;
BA_ "SingleFrame" BO_ 2298475762 1;
BA_ "GenMsgCycleTime" BO_ 2566912959 60000;
BA_ "SingleFrame" BO_ 2566912959 1;
VAL_ 2566912003 CmdBytePGN65528_PBS 83 "Controller/Display_Power_Management_#3 " ;
VAL_ 2566912191 CmdBytePGN65528_PDE 83 "Controller/Display_Power_Management_#3 " ;
VAL_ 2632974083 CmdBytePGN61184_PBS 173 "Controller_Data_Message " 173 "Controller_Data_Message " 429 "Controller_Data_Message_0xAD01 " 429 "Controller_Data_Message_0xAD01 " 685 "Controller_Data_Message_0xAD02 " 685 "Controller_Data_Message_0xAD02 " 941 "Controller_Data_Message_0xAD03 " 941 "Controller_Data_Message_0xAD03 " 1197 "Controller_Data_Message_0xAD04 " 1197 "Controller_Data_Message_0xAD04 " 1453 "Controller_Data_Message_0xAD05 " 1453 "Controller_Data_Message_0xAD05 " 1709 "Controller_Data_Message_0xAD06 " 1709 "Controller_Data_Message_0xAD06 " 1965 "Controller_Data_Message_0xAD07 " 1965 "Controller_Data_Message_0xAD07 " 2221 "Controller_Data_Message_0xAD08 " 2221 "Controller_Data_Message_0xAD08 " 2477 "Controller_Data_Message_0xAD09 " 2477 "Controller_Data_Message_0xAD09 " 2733 "Controller_Data_Message_0xAD0A " 2733 "Controller_Data_Message_0xAD0A " 2989 "Controller_Data_Message_0xAD0B " 2989 "Controller_Data_Message_0xAD0B " 3245 "Controller_Data_Message_0xAD0C " 3245 "Controller_Data_Message_0xAD0C " 3501 "Controller_Data_Message_0xAD0D " 3501 "Controller_Data_Message_0xAD0D " 3757 "Controller_Data_Message_0xAD0E " 3757 "Controller_Data_Message_0xAD0E " 4013 "Controller_Data_Message_0xAD0F " 4013 "Controller_Data_Message_0xAD0F " 4269 "Controller_Data_Message_0xAD10 " 4269 "Controller_Data_Message_0xAD10 " 4525 "Controller_Data_Message_0xAD11 " 4525 "Controller_Data_Message_0xAD11 " 4781 "Controller_Data_Message_0xAD12 " 4781 "Controller_Data_Message_0xAD12 " 5037 "Controller_Data_Message_0xAD13 " 5037 "Controller_Data_Message_0xAD13 " 5293 "Controller_Data_Message_0xAD14 " 5293 "Controller_Data_Message_0xAD14 " 5549 "Controller_Data_Message_0xAD15 " 5549 "Controller_Data_Message_0xAD15 " 5805 "Controller_Data_Message_0xAD16 " 5805 "Controller_Data_Message_0xAD16 " 6061 "Controller_Data_Message_0xAD17 " 6061 "Controller_Data_Message_0xAD17 " 6317 "Controller_Data_Message_0xAD18 " 6317 "Controller_Data_Message_0xAD18 " 6573 "Controller_Data_Message_0xAD19 " 6573 "Controller_Data_Message_0xAD19 " 6829 "Controller_Data_Message_0xAD1A " 6829 "Controller_Data_Message_0xAD1A " 7085 "Controller_Data_Message_0xAD1B " 7085 "Controller_Data_Message_0xAD1B " 7341 "Controller_Data_Message_0xAD1C " 7341 "Controller_Data_Message_0xAD1C " 7597 "Controller_Data_Message_0xAD1D " 7597 "Controller_Data_Message_0xAD1D " 7853 "Controller_Data_Message_0xAD1E " 7853 "Controller_Data_Message_0xAD1E " 8109 "Controller_Data_Message_0xAD1F " 8109 "Controller_Data_Message_0xAD1F " 8365 "Controller_Data_Message_0xAD20 " 8365 "Controller_Data_Message_0xAD20 " 8621 "Controller_Data_Message_0xAD21 " 8621 "Controller_Data_Message_0xAD21 " 8877 "Controller_Data_Message_0xAD22 " 8877 "Controller_Data_Message_0xAD22 " 9133 "Controller_Data_Message_0xAD23 " 9133 "Controller_Data_Message_0xAD23 " 9389 "Controller_Data_Message_0xAD24 " 9389 "Controller_Data_Message_0xAD24 " 9645 "Controller_Data_Message_0xAD25 " 9645 "Controller_Data_Message_0xAD25 " 9901 "Controller_Data_Message_0xAD26 " 9901 "Controller_Data_Message_0xAD26 " 10157 "Controller_Data_Message_0xAD27 " 10157 "Controller_Data_Message_0xAD27 " 10413 "Controller_Data_Message_0xAD28 " 10413 "Controller_Data_Message_0xAD28 " 10669 "Controller_Data_Message_0xAD29 " 10669 "Controller_Data_Message_0xAD29 " 10925 "Controller_Data_Message_0xAD2A " 10925 "Controller_Data_Message_0xAD2A " 11181 "Controller_Data_Message_0xAD2B " 11181 "Controller_Data_Message_0xAD2B " 11437 "Controller_Data_Message_0xAD2C " 11437 "Controller_Data_Message_0xAD2C " 11693 "Controller_Data_Message_0xAD2D " 11693 "Controller_Data_Message_0xAD2D " 11949 "Controller_Data_Message_0xAD2E " 11949 "Controller_Data_Message_0xAD2E " 428 "Data_Request_Message_0xAC01 " 428 "Data_Request_Message_0xAC01 " 684 "Data_Request_Message_0xAC02 " 684 "Data_Request_Message_0xAC02 " 940 "Data_Request_Message_0xAC03 " 940 "Data_Request_Message_0xAC03 " 1196 "Data_Request_Message_0xAC04 " 1196 "Data_Request_Message_0xAC04 " 1452 "Data_Request_Message_0xAC05 " 1452 "Data_Request_Message_0xAC05 " 1708 "Data_Request_Message_0xAC06 " 1708 "Data_Request_Message_0xAC06 " 1964 "Data_Request_Message_0xAC07 " 1964 "Data_Request_Message_0xAC07 " 2220 "Data_Request_Message_0xAC08 " 2220 "Data_Request_Message_0xAC08 " 2476 "Data_Request_Message_0xAC09 " 2476 "Data_Request_Message_0xAC09 " 2732 "Data_Request_Message_0xAC0A " 2732 "Data_Request_Message_0xAC0A " 2988 "Data_Request_Message_0xAC0B " 2988 "Data_Request_Message_0xAC0B " 3244 "Data_Request_Message_0xAC0C " 3244 "Data_Request_Message_0xAC0C " 3500 "Data_Request_Message_0xAC0D " 3500 "Data_Request_Message_0xAC0D " 3756 "Data_Request_Message_0xAC0E " 3756 "Data_Request_Message_0xAC0E " 4012 "Data_Request_Message_0xAC0F " 4012 "Data_Request_Message_0xAC0F " 4268 "Data_Request_Message_0xAC10 " 4268 "Data_Request_Message_0xAC10 " 4524 "Data_Request_Message_0xAC11 " 4524 "Data_Request_Message_0xAC11 " 4780 "Data_Request_Message_0xAC12 " 4780 "Data_Request_Message_0xAC12 " 5036 "Data_Request_Message_0xAC13 " 5036 "Data_Request_Message_0xAC13 " 5292 "Data_Request_Message_0xAC14 " 5292 "Data_Request_Message_0xAC14 " 5548 "Data_Request_Message_0xAC15 " 5548 "Data_Request_Message_0xAC15 " 5804 "Data_Request_Message_0xAC16 " 5804 "Data_Request_Message_0xAC16 " 6060 "Data_Request_Message_0xAC17 " 6060 "Data_Request_Message_0xAC17 " 6316 "Data_Request_Message_0xAC18 " 6316 "Data_Request_Message_0xAC18 " 6572 "Data_Request_Message_0xAC19 " 6572 "Data_Request_Message_0xAC19 " 6828 "Data_Request_Message_0xAC1A " 6828 "Data_Request_Message_0xAC1A " 7084 "Data_Request_Message_0xAC1B " 7084 "Data_Request_Message_0xAC1B " 7340 "Data_Request_Message_0xAC1C " 7340 "Data_Request_Message_0xAC1C " 7596 "Data_Request_Message_0xAC1D " 7596 "Data_Request_Message_0xAC1D " 7852 "Data_Request_Message_0xAC1E " 7852 "Data_Request_Message_0xAC1E " 8108 "Data_Request_Message_0xAC1F " 8108 "Data_Request_Message_0xAC1F " 8364 "Data_Request_Message_0xAC20 " 8364 "Data_Request_Message_0xAC20 " 8620 "Data_Request_Message_0xAC21 " 8620 "Data_Request_Message_0xAC21 " 8876 "Data_Request_Message_0xAC22 " 8876 "Data_Request_Message_0xAC22 " 9132 "Data_Request_Message_0xAC23 " 9132 "Data_Request_Message_0xAC23 " 9388 "Data_Request_Message_0xAC24 " 9388 "Data_Request_Message_0xAC24 " 9644 "Data_Request_Message_0xAC25 " 9644 "Data_Request_Message_0xAC25 " 9900 "Data_Request_Message_0xAC26 " 9900 "Data_Request_Message_0xAC26 " 10156 "Data_Request_Message_0xAC27 " 10156 "Data_Request_Message_0xAC27 " 10412 "Data_Request_Message_0xAC28 " 10412 "Data_Request_Message_0xAC28 " 10668 "Data_Request_Message_0xAC29 " 10668 "Data_Request_Message_0xAC29 " 10924 "Data_Request_Message_0xAC2A " 10924 "Data_Request_Message_0xAC2A " 172 "Data_Request_Message " 172 "Data_Request_Message " ;
VAL_ 2634021567 CmdBytePGN65530_PDE 11520 "ControllerHealthInfo " ;
VAL_ 2649751296 CmdBytePGN126720_ECU 5 "DTC_Query_Request " 4 "DTC_Query_Response " ;
VAL_ 2649751299 CmdBytePGN126720_PBS 5 "DTC_Query_Request " 4 "DTC_Query_Response " ;
VAL_ 2649751538 CmdBytePGN126720_PDC 5 "DTC_Query_Request " 4 "DTC_Query_Response " ;
VAL_ 2649751487 CmdBytePGN126720_PDE 5 "DTC_Query_Request " 4 "DTC_Query_Response " ;
VAL_ 2649686784 CmdBytePGN126720_ECU 4 "DTC_Query_Response " ;
VAL_ 2649747968 CmdBytePGN126720_ECU 4 "DTC_Query_Response " ;
VAL_ 2649734912 CmdBytePGN126720_ECU 4 "DTC_Query_Response " ;
VAL_ 2649686019 CmdBytePGN126720_PBS 4 "DTC_Query_Response " ;
VAL_ 2649747971 CmdBytePGN126720_PBS 4 "DTC_Query_Response " ;
VAL_ 2649734915 CmdBytePGN126720_PBS 4 "DTC_Query_Response " ;
VAL_ 2649686258 CmdBytePGN126720_PDC 4 "DTC_Query_Response " ;
VAL_ 2649687026 CmdBytePGN126720_PDC 4 "DTC_Query_Response " ;
VAL_ 2649735154 CmdBytePGN126720_PDC 4 "DTC_Query_Response " ;
VAL_ 2649686207 CmdBytePGN126720_PDE 4 "DTC_Query_Response " ;
VAL_ 2649686975 CmdBytePGN126720_PDE 4 "DTC_Query_Response " ;
VAL_ 2649748159 CmdBytePGN126720_PDE 4 "DTC_Query_Response " ;
VAL_ 2230255622 CmdBytePGN61184_EIC 5476 "Electronic_Flexpower_Request_Message " ;
VAL_ 2230255622 SpeedThrottleControlCommand 0 " FlexpowerSpeedRequestPercentThrottle" 1 " FlexpowerSpeedRequestEngineSpeed" 2 " Reserved" 3 " TakeNoAction" ;
VAL_ 2230255622 GovCntrlSlct 0 " GovernorControlSelect1" 1 " GovernorControlSelect2" 2 " Reserved" 3 " TakeNoAction" ;
VAL_ 2230255622 GovernorRequest 0 " GovernorRequest0" 1 " GovernorRequest1" 2 " GovernorRequest2" 3 " GovernorRequest3" 4 " GovernorRequest4" 5 " GovernorRequest5" 6 " GovernorRequest6" 7 " GovernorRequest7" 8 " GovernorRequest8" 9 " GovernorRequest9" 10 " GovernorRequest10" 11 " GovernorRequest11" 12 " GovernorRequest12" 13 " GovernorRequest13" 14 " Reserved" 15 " TakeNoAction" ;
VAL_ 2230255622 TorqCrvReq 0 " TorqueCurveRequest0" 1 " TorqueCurveRequest1" 2 " TorqueCurveRequest2" 3 " TorqueCurveRequest3" 4 " TorqueCurveRequest4" 5 " TorqueCurveRequest5" 6 " TorqueCurveRequest6" 7 " TorqueCurveRequest7" 8 " TorqueCurveRequest8" 9 " TorqueCurveRequest9" 10 " TorqueCurveRequest10" 11 " TorqueCurveRequest11" 12 " TorqueCurveRequest12" 13 " TorqueCurveRequest13" 14 " Reserved" 15 " TakeNoAction" ;
VAL_ 2565865458 CmdBytePGN61184_PDC 12786 "Engine_DPF_Regeneration_Control_Request " 1276 "IO_Expander_Output_Pin_Control_Request_Message_#1 " 7922 "JD_ACKnowledgement " 24676 "PowertrainDomaintoDriveTrainCharacteristics " 22628 "PowertrainDomaintoDriveTrainStatus " 241 "Prop_Request_PGN_Dual_Cmd_Byte " 219 "Prop_Request_PGN_Single_Cmd_Byte " ;
VAL_ 2565865458 EngExstTempMgmtElevIdleAllow 0 " NotAllowed" 1 " Allowed" 2 " RsrvdStds" 3 " DonTCareTakeNoAction" ;
VAL_ 2565865458 EngDPFActRegAllow 0 " En_OnOff2States_Off" 1 " En_OnOff2States_On" 2 " En_OnOff2States_Error" 3 " En_OnOff2States_NotAvailable" ;
VAL_ 2565865458 DslPartFltrRegInhbtSwtch 0 " Not Active" 1 " Active" 2 " Error" 3 " NotAvailable" ;
VAL_ 2565865458 DslPartFltrRegenFrceSwtch 0 " Not Active" 1 " Active" 2 " Error" 3 " NotAvailable" ;
VAL_ 2565865458 ScndryBrakeCtrlVlv 0 " DEM_Off" 1 " DEM_On" 2 " DEM_Error" 3 " DEM_Not_available_or_not_installed" ;
VAL_ 2565865458 KeySwitchStartToDriveTrain 0 " Off" 1 " On" 2 " Error" 3 " NotAvailable" ;
VAL_ 2565865458 KeySwitchRunToDriveTrain 0 " DEM_Off" 1 " DEM_On" 2 " DEM_Error" 3 " DEM_Not_available_or_not_installed" ;
VAL_ 2565865458 HydHndlStateToDriveTrain 0 " Neutral_Zero_Position" 1 " Forward_Position" 2 " Reverse_Position" 3 " Center_Position" 6 " RsrvdStds" 7 " NotAvailable" ;
VAL_ 2565865458 RoadFieldModeToDriveTrain 0 " FieldMode" 1 " RoadMode" 2 " Error" 3 " NotAvailable" ;
VAL_ 2565865458 ScndryBrakeCtrlVlv2 0 " DEM_Off" 1 " DEM_On" 2 " DEM_Error" 3 " DEM_Not_available_or_not_installed" ;
VAL_ 2565865458 EngineDisplacement 0 " DEM_Liter_6_8" 1 " DEM_Liter_9_0" 2 " DEM_Liter_13_5" 3 " DEM_Liter_13_6" 14 " DEM_Error" 15 " DEM_NotAvailable" ;
VAL_ 2565865216 CmdBytePGN61184_ECU 10993 "EngineDPFRegenerationStatistics " 9060 "Engine_Derate_Status " 1015 "EngineSCRCleaningStatistics " 8696 "Engine_Starting_Shutdown_Status " 3684 "Flexpower_Status " 252 "IO_Expander_Input_Pin_Measurement_Message_#1 " 1532 "IO_Expander_Output_Pin_State_Message_#1 " 2556 "IOExpanderOutputPinStateMessage3 " 7922 "JD_ACKnowledgement " 4196 "JDEngineControlMessage16 " 356 "JDEngineFunctionalTest " 241 "Prop_Request_PGN_Dual_Cmd_Byte " 219 "Prop_Request_PGN_Single_Cmd_Byte " 21860 "ScheduledPowerReduction " ;
VAL_ 2565865216 CompressionTest 0 " Enabled" 1 " Disabled" ;
VAL_ 2565865216 CylinderDiagnostics 0 " Enabled" 1 " Disabled" ;
VAL_ 2565865216 CylinderCutoutTest 0 " Enabled" 1 " Disabled" ;
VAL_ 2565865216 CylinderDiagnosticsTrigger 0 " Enabled" 1 " Disabled" ;
VAL_ 2565865216 ActuatorDriverTest 0 " Enabled" 1 " Disabled" ;
VAL_ 2565865216 EngiOverShutTestEnab 0 " Inactive" 1 " Active" 2 " Reserved" 3 " TakeNoAction" ;
VAL_ 2565865216 CompressionTestState 0 " Disabled" 1 " Possible" 2 " Active" 3 " TemperatureError" 4 " EngineModeError" 5 " EngineSpeedError" 6 " CamCrankError" 7 " TooMuchTime" 8 " Cancelled" 9 " Successful" 254 " Error" 255 " NotAvailable" ;
VAL_ 2565865216 CylinderDiagnosticsState 0 " NeverActive" 1 " InProgress" 2 " TemperatureError" 3 " CamOrCrankFailure" 4 " ImproperEngineMode" 5 " Overspeed" 6 " ThrottleError" 7 " Timeout" 8 " Cancelled" 9 " SuccessfulCompletion" 10 " WaitingForTrigger" 254 " Error" 255 " NotAvailable" ;
VAL_ 2565865216 IOExpaOutpPinStatMess1PinStat 0 " En_IOExpanderOutputPinStatus_NoFault" 1 " En_IOExpanderOutputPinStatus_OpenCircuit" 2 " En_IOExpanderOutputPinStatus_Overload" 3 " En_IOExpanderOutputPinStatus_NoCommandReceived" 254 " En_IOExpanderOutputPinStatus_Error" 255 " En_IOExpanderOutputPinStatus_NotAvailable" ;
VAL_ 2565865216 IOExpOutputPinState3Status 0 " DEM_NoFault" 1 " DEM_OpenCircuit" 2 " DEM_Overload" 3 " DEM_NoCommandReceived" ;
VAL_ 2565865216 FlexpowerStatus 0 " FlexpowerActive" 2 " Error" 3 " NotAvailable" ;
VAL_ 2565865216 JDPresEngCtrlMode 0 " Control Mode 0" 1 " Control Mode 1" 2 " Control Mode 2" 3 " Control Mode Data equals the number" 249 " Control Mode 249" 250 " Control Mode 250" 254 " Rsrvd_Stds" 255 " Dont care take no action" ;
VAL_ 2565865216 EngOpStateFromEcu 0 " DEM_Engine_Stopped" 1 " DEM_PreStart" 2 " DEM_Starting" 3 " DEM_WarmUp" 4 " DEM_Running" 5 " DEM_Cooldown" 6 " DEM_Engine_Stopping" 7 " DEM_PostRun" 14 " DEM_RsrvdStds" 15 " DEM_Dont_caretake_no_action" ;
VAL_ 2565865216 EngWaitToStartLamp 0 " Off" 1 " On" 2 " Error" 3 " Not Available" ;
VAL_ 2565865216 EngProtectSysHasShtdwnEng 0 " EnBooleanFalse" 1 " EnBooleanTrue" 2 " EnBooleanError" 3 " EnBooleanNotAvailable" ;
VAL_ 2565865216 SPRActiveFlag 0 " Active" 1 " Not Active" 2 " Error" 3 " Not Available" ;
VAL_ 2298477059 CmdBytePGN65530_PTP 35842 "EngineManagementSpeedRequest " 8960 "TransmissionStatusHighPriority3 " 8960 "TransmissionStatusHighPriority3 " ;
VAL_ 2298477059 ParkingBrakeSwitch 0 " Parking_brake_not_set" 1 " Parking_brake_set" 2 " Error" 3 " Not_available" ;
VAL_ 2298477059 TransmissionEnableCommand 0 " Off" 1 " On" 2 " Error" 3 " Not Available" ;
VAL_ 2298477059 HydroHandleOutOfNeutral 0 " Off" 1 " On" 2 " Error" 3 " Not Available" ;
VAL_ 2499803902 CmdBytePGN65530_Vector_XXX 11528 "EngineManagementSpeedStatus " 8192 "PowerTrainHydraulics1 " ;
VAL_ 2499803902 HydrCharPresSensStat 0 " Normal_Pressure" 1 " Low_Pressure_Warning" 2 " Very_Low_Pressure_Warning" 3 " High_Pressure_Warning" 8 " No_Fault" 9 " Out_Of_Range_Low" 10 " Out_Of_Range_High" 11 " Sensor_Failed" 12 " Supply_Reference_Failed" 13 " Not_Ready" 14 " Error" 15 " Not_Available" ;
VAL_ 2499803902 EngineSpeedManagementActive 0 " DEM_Off" 1 " DEM_On" 2 " DEM_Reserved__Stds" 3 " DEM_Dont_caretake_no_action" ;
VAL_ 2565865470 CmdBytePGN61184_Vector_XXX 9458 "EngineStartControl " 5732 "Flexpower_Authentication_Request " 11250 "Machine_Network_Health_Data_Command " 2288 "OperatorControlsB2Command " 3312 "OperatorControlsB3Command " 13300 "OperatorControlsB5Command " ;
VAL_ 2565865470 OpCtrlB2CmdByte4BitQuad14 0 " DEM_bit_state_0" 1 " DEM_bit_state_1" 2 " DEM_bit_state_2" 3 " DEM_bit_state_3" 4 " DEM_bit_state_4" 5 " DEM_bit_state_5" 6 " DEM_bit_state_6" 7 " DEM_bit_state_7" 14 " DEM_Error" 15 " DEM_Not_available_or_not_installed" ;
VAL_ 2565865470 OpCtrlB3CmdByte3BitQuad58 0 " bit_state_0" 1 " bit_state_1" 2 " bit_state_2" 3 " bit_state_3" 4 " bit_state_4" 5 " bit_state_5" 6 " bit_state_6" 7 " bit_state_7" 8 " bit_state_8" 14 " Error" 15 " Not_available_or_not_installed" ;
VAL_ 2565865470 OpCtrlB3CmdByte6BitQuad14 0 " bit_state_0" 1 " bit_state_1" 2 " bit_state_2" 3 " bit_state_3" 4 " bit_state_4" 5 " bit_state_5" 6 " bit_state_6" 7 " bit_state_7" 8 " bit_state_8" 14 " Error" 15 " Not_available_or_not_installed" ;
VAL_ 2565865470 OpCtrlB3CmdByte7BitQuad14 0 " bit_state_0" 1 " bit_state_1" 2 " bit_state_2" 3 " bit_state_3" 4 " bit_state_4" 5 " bit_state_5" 6 " bit_state_6" 7 " bit_state_7" 8 " bit_state_8" 14 " Error" 15 " Not_available_or_not_installed" ;
VAL_ 2565865470 OpCtrlB3CmdByte7BitQuad58 0 " bit_state_0" 1 " bit_state_1" 2 " bit_state_2" 3 " bit_state_3" 4 " bit_state_4" 5 " bit_state_5" 6 " bit_state_6" 7 " bit_state_7" 8 " bit_state_8" 14 " Error" 15 " Not_available_or_not_installed" ;
VAL_ 2565865470 OpCtrlB3CmdByte8BitQuad14 0 " bit_state_0" 1 " bit_state_1" 2 " bit_state_2" 3 " bit_state_3" 4 " bit_state_4" 5 " bit_state_5" 6 " bit_state_6" 7 " bit_state_7" 8 " bit_state_8" 14 " Error" 15 " Not_available_or_not_installed" ;
VAL_ 2565865470 OpCtrlB3CmdByte8BitQuad58 0 " bit_state_0" 1 " bit_state_1" 2 " bit_state_2" 3 " bit_state_3" 4 " bit_state_4" 5 " bit_state_5" 6 " bit_state_6" 7 " bit_state_7" 8 " bit_state_8" 14 " Error" 15 " Not_available_or_not_installed" ;
VAL_ 2565865470 OpCtrlB3CmdByte3BitQuad14 0 " bit_state_0" 1 " bit_state_1" 2 " bit_state_2" 3 " bit_state_3" 4 " bit_state_4" 5 " bit_state_5" 6 " bit_state_6" 7 " bit_state_7" 8 " bit_state_8" 14 " Error" 15 " Not_available_or_not_installed" ;
VAL_ 2565865470 EngStartCtrl 0 " DEM_Off" 1 " DEM_On" 2 " DEM_Reserved__Stds" 3 " DEM_Dont_caretake_no_action" ;
VAL_ 2565865470 OpCtrlB5CmdByte8BitQuad14 0 " DEM_bit_state_0" 1 " DEM_bit_state_1" 2 " DEM_bit_state_2" 3 " DEM_bit_state_3" 4 " DEM_bit_state_4" 5 " DEM_bit_state_5" 6 " DEM_bit_state_6" 7 " DEM_bit_state_7" 14 " DEM_Error" 15 " DEM_Not_available_or_not_installed" ;
VAL_ 2565865222 CmdBytePGN61184_EIC 8440 "EngineStartingShutdownRequest " ;
VAL_ 2565865222 EngineDesiredOperatingState 0 " StopEngine" 1 " StartEngine" 2 " RunEngine" 3 " VehicleAutoStartStop" 4 " StarterTestMode" 14 " Reserved" 15 " NotAvailable" ;
VAL_ 2565801726 CmdBytePGN61184_Vector_XXX 5732 "Flexpower_Authentication_Request " ;
VAL_ 2565801472 CmdBytePGN61184_ECU 3684 "Flexpower_Status " ;
VAL_ 2565801472 FlexpowerStatus 0 " FlexpowerActive" 2 " Error" 3 " NotAvailable" ;
VAL_ 2498756606 CmdBytePGN61184_Vector_XXX 29284 "FrontEndDomainMiscellaneousStatus " 8292 "JDAftertreatmentServiceInterface " 2916 "JDEngineTestMessage " 21348 "PowertrainDomainMiscellaneousHighPriority " ;
VAL_ 2498756606 JDEngineTestMode 0 " No_Test_Enabled" 1 " Harness_Diagnostics" 255 " NotAvailable" ;
VAL_ 2498756606 JDEngineTestState 0 " Off" 1 " Active" 2 " Aborted" 3 " Complete" 254 " Error" 255 " NotAvailable" ;
VAL_ 2498756606 JDEngineTestActiveType 0 " Off" 1 " Factory" 2 " Application" 3 " Hold" 254 " Error" 255 " NotAvailable" ;
VAL_ 2498756606 JDEngineTestComponentID 0 " Engine_Position_and_Timing_Sensors" 1 " Oil_Control_Valve" 2 " Exhaust_Brake_1" 3 " Exhaust_Brake_2" 32 " Engine_Electric_Lift_Pump" 33 " Fuel_Injectors" 48 " High_Pressure_Fuel_Pump_Control_Valve" 49 " High_Pressure_Common_Rail_Fuel_Pressure_Relief_Valve" 64 " EGR_Valve" 65 " Air_Throttle" 66 " Exhaust_Throttle" 67 " Turbocharger_Actuator" 68 " Exhaust_Throttle_Power" 69 " Turbocharger_Compressor_Inlet_Sensor_Power" 70 " Turbocharger_Speed_Sensor" 80 " DEF_Supply_Module_Pump" 81 " DEF_Supply_Module_Reverting_Valve" 82 " DEF_Tank_Coolant_Control_Valve" 83 " DEF_Suction_Line_Heater" 84 " DEF_Pressure_Line_Heater" 85 " DEF_Return_Line_Heater" 86 " DEF_Module_Heater" 87 " DEF_Header_Power" 88 " NOx_Sensor_Power" 96 " Starter_Relay" 97 " Starter_Relay_Low_Side" 98 " Alternator_1_L_Terminal" 99 " Alternator_2_L_Terminal" 100 " Cold_Start" 101 " AC_Compressor" 102 " Air_Brake_Compressor" 103 " Fan_Reverse" 104 " Fan_Forward" 105 " Fan_Speed_Sensor" 106 " Vehicle_or_Other_Speed_Sensor" 107 " Spare_Sensor_Power" 108 " OEM_Spare_High_Side_Driver" 109 " OEM_Spare_1_High_Side_Driver" 110 " OEM_Spare_2_High_Side_Driver" 254 " Error" 255 " Not_available" ;
VAL_ 2498756606 HydrocarbonInjectorPurge 0 " Disable" 1 " Enable" 2 " Rsrvd_Stds" 3 " Dont care take no action" ;
VAL_ 2498756606 DiesOxidCataServReplComp 0 " Not Active" 1 " Active" 2 " Rsrvd_Stds" 3 " Dont care take no action" ;
VAL_ 2498756606 DiesPartFiltUninHydrDiagClea 0 " Not Active" 1 " Active" 2 " Rsrvd_Stds" 3 " Dont care take no action" ;
VAL_ 2498756606 DiesOxidCataOutlTempDiagClea 0 " Not Active" 1 " Active" 2 " Rsrvd_Stds" 3 " Dont care take no action" ;
VAL_ 2498756606 DiesOxidCataUninHydrDiagClea 0 " Not Active" 1 " Active" 2 " Rsrvd_Stds" 3 " Dont care take no action" ;
VAL_ 2498756606 DiesPartFiltServReplComp 0 " Not Active" 1 " Active" 2 " Rsrvd_Stds" 3 " Dont care take no action" ;
VAL_ 2498756606 AfteDiesPartFiltRegeCleaFreqFaul 0 " Take no action" 1 " Reset" 2 " Rsrvd_Stds" 3 " Not applicable" ;
VAL_ 2498756606 ServcRegenReq 0 " Not Active" 1 " Active" 2 " Rsrvd_Stds" 3 " Dont care take no action" ;
VAL_ 2498756606 AfteDiesExhaFluiPresContRequ 0 " False" 1 " True" 2 " Rsrvd_Stds" 3 " Dont care take no action" ;
VAL_ 2498756606 AfteSCRReplRese 0 " Not Active" 1 " Active" 2 " Rsrvd_Stds" 3 " Dont care take no action" ;
VAL_ 2498756606 AfteDiesPartFiltOutlGasHighTempStatComm 0 " Not Active" 1 " Active" 2 " Rsrvd_Stds" 3 " Dont care take no action" ;
VAL_ 2498756606 AfteDiesExhaFluiTankHeatCoolValvTest 0 " Not Active" 1 " Active" 2 " Rsrvd_Stds" 3 " Dont care take no action" ;
VAL_ 2498756606 AfteDiesExhaFluiSystShutTest 0 " Not Active" 1 " Active" 2 " Rsrvd_Stds" 3 " Dont care take no action" ;
VAL_ 2498756606 AfteDiesExhaFluiInjeDiagTest 0 " Not Active" 1 " Active" 2 " Rsrvd_Stds" 3 " Dont care take no action" ;
VAL_ 2498756606 AfteDiesExhaFluiInjeQuanTest 0 " Not Active" 1 " Active" 2 " Rsrvd_Stds" 3 " Dont care take no action" ;
VAL_ 2498756606 AirCompEngageState 0 " DEM_Off" 1 " DEM_On" 2 " DEM_Error" 3 " DEM_Not_available_or_not_installed" ;
VAL_ 2498756606 EngRun 0 " Not Running" 1 " Running" 2 " Error" 3 " NotAvailable" ;
VAL_ 2498756606 HdrType 0 " En_HeaderTypes_NoHeaderConnected" 1 " En_HeaderTypes_CornHeadChopping" 2 " En_HeaderTypes_RowCropWithCenterPot" 3 " En_HeaderTypes_Oxbo" 4 " En_HeaderTypes_CornHead" 5 " En_HeaderTypes_BeltPickupWith2Pots" 6 " En_HeaderTypes_BeltPickupWithPot" 7 " En_HeaderTypes_JDFoldingCornHead" 8 " En_HeaderTypes_Rigid" 9 " En_HeaderTypes_FlexibleDraper" 10 " En_HeaderTypes_Draper" 11 " En_HeaderTypes_DraperAdvanced" 12 " En_HeaderTypes_FlexWithPot" 13 " En_HeaderTypes_EuroDraper" 14 " En_HeaderTypes_Hydraflex" 15 " En_HeaderTypes_Vario" 16 " En_HeaderTypes_FlexWingDraper" 17 " En_HeaderTypes_NumHeads" 254 " En_HeaderTypes_Error" 255 " En_HeaderTypes_NotAvailable" ;
VAL_ 2298477566 CmdBytePGN65531_Vector_XXX 505 "GSACommand " ;
VAL_ 2298477566 GSACommandStatus 0 " DISABLED" 1 " STANDBY" 2 " CONTROLLING" 254 " Error" 255 " NotAvailable" ;
VAL_ 2499803907 CmdBytePGN65531_PTP 249 "GSAData " ;
VAL_ 2499803907 GSAStatus 0 " DISABLED" 1 " READY" 2 " CONTROLLING" 3 " REJECTED" 4 " CONTROLLING_BUT_OVERRIDING" 5 " FAULTED" 6 " WAIT_FOR_ACK" 254 " Error" 255 " NotAvailable" ;
VAL_ 2566912771 CmdBytePGN65531_PTP 3067 "GSAData2 " 12288 "Vehicle_Configuration_Management_Response " ;
VAL_ 2566911230 CmdBytePGN65524_Vector_XXX 100 "Guidance_System_Command_JD_Extended " ;
VAL_ 2566911230 GPSMsgRate 0 " EnGPSMsgRateNoGPS" 1 " EnGPSMsgRate5Hz" 2 " EnGPSMsgRate10Hz" 3 " EnGPSMsgRate20Hz" 4 " EnGPSMsgRate50Hz" 5 " EnGPSMsgRate100Hz" 6 " EnGPSMsgRateErr" 7 " EnGPSMsgRateUkwn" ;
VAL_ 2566911230 AT2ExitCode_GSCJDE 0 " ATECNoCode" 1 " ATECTransmissionInPark" 2 " ATECFICAFault" 3 " ATECWhlSpdSlow" 4 " ATECAltGuidanceActive" 5 " ATECIncorrectGear" 13 " ATECCmdMsdTimeout" 250 " ATECLastTransitionOk" 16 " ATECAuthDenied" 21 " ATECWhlSpdFast" 22 " ATECOilTempTooLow" 23 " ATECDiagMode" 24 " ATECCtrlState" 25 " ATECResumeNotPressed" 26 " ATECCurvatureNotMatched" 50 " ATECInvalidCommand" 51 " ATECNoOperatorPresence" 52 " ATECImpReleasedControl" 53 " ATECGlobalStop" 54 " ATECOperatorOverride" 62 " ATECECError" 63 " ATECECNotAvailable" 64 " ATECStartUp" 65 " ATECShutDown" 66 " ATECAutoTracShutdown" 67 " ATECEngineOff" 68 " ATECNotCalibrated" 69 " ATECVoltagenotStable" 70 " ATECOperatorPresenceDataBad" 71 " ATECResumeSwitchDataBad" 72 " ATECVehStateMsgMissing" 73 " ATECVehStateMsgBadData" 74 " ATECAdvGuidanceStatusMsgMissing" 75 " ATECAdvGuidanceStatusMsgBadData" 76 " ATECActiveInReverseTimeout" 77 " ATECGPSWheelSpeedMismatch" 78 " ATECNoValidTrack" 79 " ATECInvalidGPS" 80 " ATECShutdownStateFaulted" 81 " ATECGSDDataFaulted" 82 " ATECExtGuidanceStatusMsgFaulted" 83 " ATECExtGuidanceStatusExtendedMsgFaulted" 84 " ATECVehDirSpeedMsgFaulted" 85 " ATECVehRollYawMsgFaulted" 86 " ATECTCMMsgFaulted" 87 " ATECLateralError" 88 " ATECHeadingError" 89 " ATECTrackNumChanged" 90 " ATECTCMInactive" 91 " ATECRSGPSTransitionTooLarge" 92 " ATECRSOutOfRow" 93 " ATECRSGreenstarTrackingFault" 94 " ATECRSSensorFault" 95 " ATECRSGPSFault" 100 " ATECTransportMode" 101 " ATECAuxPumpOn" 102 " ATECBoomsFolded" 103 " ATECHeaderNotEngaged" 104 " ATECFourWheelSteerTimeout" 105 " ATECCrabSteering" 254 " ATECEC8BitError" 255 " ATECEC8BitNotAvailable" ;
VAL_ 2566911230 CrvtrCntrlATState_GSCJDE 5 " AutoTracSysSt_Actv" 1 " AutoTracSysSt_Disad" 3 " AutoTracSysSt_Enad" 14 " AutoTracSysSt_Err" 0 " AutoTracSysSt_None" 2 " AutoTracSysSt_RdyToEna" 8 " AutoTracSysSt_SrvModActv" 7 " AutoTracSysSt_SrvModEnad" 6 " AutoTracSysSt_SrvModReqd" 4 " AutoTracSysSt_TranToActv" 15 " AutoTracSysSt_Ukwn" ;
VAL_ 2297430014 CmdBytePGN61184_Vector_XXX 3064 "HarvestingDomainThreshingStatus " ;
VAL_ 2297430014 SeparatorDrive 0 " DEM_Disengaged" 1 " DEM_Engaged" 2 " DEM_EngagedReverse" 3 " DEM_Overridden" 14 " DEM_Error" 15 " DEM_Not_available" ;
VAL_ 2566913022 CmdBytePGN65531_Vector_XXX 60928 "HillmasterSystemInformation " 9970 "OperatorSwitchControls4 " ;
VAL_ 2566913022 KeySwitchStart 0 " DEM_Off" 1 " DEM_On" 2 " DEM_Error" 3 " DEM_Not_available_or_not_installed" ;
VAL_ 2566913022 KeySwitchRun 0 " DEM_Off" 1 " DEM_On" 2 " DEM_Error" 3 " DEM_Not_available_or_not_installed" ;
VAL_ 2566913022 HillmasterSystemMode 0 " Disabled" 1 " Manual" 2 " Auto" 3 " Lowering" 14 " Error" 15 " Not available_not installed" ;
VAL_ 2566913022 HillMasterTiltRequest 0 " DEM_Off" 1 " DEM_On" 2 " DEM_Error" 3 " DEM_Not_available_or_not_installed" ;
VAL_ 2565865219 CmdBytePGN61184_PTP 3320 "InteractiveCalibrationECUtoPDC " 7922 "JD_ACKnowledgement " 7922 "JD_ACKnowledgement " 2544 "OperatorControlsB2Response " 3568 "OperatorControlsB3Response " 3568 "OperatorControlsB3Response " 13556 "OperatorControlsB5Response " 241 "Prop_Request_PGN_Dual_Cmd_Byte " 241 "Prop_Request_PGN_Dual_Cmd_Byte " 219 "Prop_Request_PGN_Single_Cmd_Byte " 219 "Prop_Request_PGN_Single_Cmd_Byte " 25188 "TransmissionStatusLowPriority1 " 25188 "TransmissionStatusLowPriority1 " 26724 "TransmissionStatusLowPriority2 " 26724 "TransmissionStatusLowPriority2 " ;
VAL_ 2565865219 OpCtrlB2RspByte4BitQuad14 0 " DEM_bit_state_0" 1 " DEM_bit_state_1" 2 " DEM_bit_state_2" 3 " DEM_bit_state_3" 4 " DEM_bit_state_4" 5 " DEM_bit_state_5" 6 " DEM_bit_state_6" 7 " DEM_bit_state_7" 14 " DEM_Error" 15 " DEM_Not_available_or_not_installed" ;
VAL_ 2565865219 OpCtrlB3RspByte3BitQuad58 0 " bit_state_0" 1 " bit_state_1" 2 " bit_state_2" 3 " bit_state_3" 4 " bit_state_4" 5 " bit_state_5" 6 " bit_state_6" 7 " bit_state_7" 8 " bit_state_8" 14 " Error" 15 " Not_available_or_not_installed" ;
VAL_ 2565865219 OpCtrlB3RspByte6BitQuad14 0 " bit_state_0" 1 " bit_state_1" 2 " bit_state_2" 3 " bit_state_3" 4 " bit_state_4" 5 " bit_state_5" 6 " bit_state_6" 7 " bit_state_7" 8 " bit_state_8" 14 " Error" 15 " Not_available_or_not_installed" ;
VAL_ 2565865219 OpCtrlB3RspByte7BitQuad14 0 " bit_state_0" 1 " bit_state_1" 2 " bit_state_2" 3 " bit_state_3" 4 " bit_state_4" 5 " bit_state_5" 6 " bit_state_6" 7 " bit_state_7" 8 " bit_state_8" 14 " Error" 15 " Not_available_or_not_installed" ;
VAL_ 2565865219 OpCtrlB3RspByte7BitQuad58 0 " bit_state_0" 1 " bit_state_1" 2 " bit_state_2" 3 " bit_state_3" 4 " bit_state_4" 5 " bit_state_5" 6 " bit_state_6" 7 " bit_state_7" 8 " bit_state_8" 14 " Error" 15 " Not_available_or_not_installed" ;
VAL_ 2565865219 OpCtrlB3RspByte8BitQuad14 0 " bit_state_0" 1 " bit_state_1" 2 " bit_state_2" 3 " bit_state_3" 4 " bit_state_4" 5 " bit_state_5" 6 " bit_state_6" 7 " bit_state_7" 8 " bit_state_8" 14 " Error" 15 " Not_available_or_not_installed" ;
VAL_ 2565865219 OpCtrlB3RspByte8BitQuad58 0 " bit_state_0" 1 " bit_state_1" 2 " bit_state_2" 3 " bit_state_3" 4 " bit_state_4" 5 " bit_state_5" 6 " bit_state_6" 7 " bit_state_7" 8 " bit_state_8" 14 " Error" 15 " Not_available_or_not_installed" ;
VAL_ 2565865219 OpCtrlB3RspByte3BitQuad14 0 " bit_state_0" 1 " bit_state_1" 2 " bit_state_2" 3 " bit_state_3" 4 " bit_state_4" 5 " bit_state_5" 6 " bit_state_6" 7 " bit_state_7" 8 " bit_state_8" 14 " Error" 15 " Not_available_or_not_installed" ;
VAL_ 2565865219 OpCtrlB5RspByte8BitQuad14 0 " DEM_bit_state_0" 1 " DEM_bit_state_1" 2 " DEM_bit_state_2" 3 " DEM_bit_state_3" 4 " DEM_bit_state_4" 5 " DEM_bit_state_5" 6 " DEM_bit_state_6" 7 " DEM_bit_state_7" 14 " DEM_Error" 15 " DEM_Not_available_or_not_installed" ;
VAL_ 2565865219 CurrentGearRangeFromDriveTrain 123 " DEM_Reverse2" 124 " DEM_Reverse1" 125 " DEM_Neutral" 126 " DEM_First" 127 " DEM_Second" 128 " DEM_Third" 251 " DEM_Park" 254 " DEM_Error" 255 " DEM_Not_Available" ;
VAL_ 2565865219 ProDriveTransModeFromDriveTrain 121 " ReverseRoadMode2" 122 " ReverseRoadMode1" 123 " ReverseMode2" 124 " ReverseMode1" 125 " Neutral" 126 " ForwardMode1" 127 " ForawardMode2" 128 " ForwardRoadMode1" 129 " ForwardRoadMode2" 254 " Error" 255 " NotAvailable" ;
VAL_ 2565865219 TransmissionLimOpFaultStatus 0 " DEM_Off" 1 " DEM_On" 2 " DEM_Error" 3 " DEM_NotAvailable" ;
VAL_ 2565865219 TowModeAvailable 0 " DEM_Off" 1 " DEM_On" 2 " DEM_Error" 3 " DEM_NotAvailable" ;
VAL_ 2565865219 FourWDStatusFromDrivetrain 0 " Off" 1 " Low Active" 2 " High Active" 14 " Error" 15 " NotAvailable" ;
VAL_ 2565865219 DiffLockStateFromDrivetrain 0 " Diff lock disengaged in manual mode" 1 " Diff lock engaged in manual mode" 2 " Diff lock disengaged in auto mode" 3 " Diff lock engaged in auto mode" 4 " Diff lock engagement prevented due to speed" 14 " Error" 15 " Not Available" ;
VAL_ 2566914046 CmdBytePGN65535_Vector_XXX 246 "InteractiveCalibrationTooltoECU " ;
VAL_ 2498756594 CmdBytePGN61184_PDC 2300 "IOExpanderOutputPinControlMessage3 " 26980 "PowertrainDomaintoDriveTrainStatus2 " ;
VAL_ 2498756594 TransmissionCmdLimOp 0 " Off" 1 " On" 2 " Error" 3 " NotAvailable" ;
VAL_ 2498756594 MachTowModeParkBrakeReq 0 " DEM_Off" 1 " DEM_On" 2 " DEM_Error" 3 " DEM_NotAvailable" ;
VAL_ 2498756594 QuickStopSwitchToDriveTrain 0 " Off" 1 " On" 2 " Error" 3 " NotAvailable" ;
VAL_ 2498756594 MachHarvStatToDrivTrai 0 " Off" 1 " On" 2 " Error" 3 " NotAvailable" ;
VAL_ 2565865407 CmdBytePGN61184_PDE 7922 "JD_ACKnowledgement " 241 "Prop_Request_PGN_Dual_Cmd_Byte " 219 "Prop_Request_PGN_Single_Cmd_Byte " ;
VAL_ 2565800704 CmdBytePGN61184_ECU 7922 "JD_ACKnowledgement " 7922 "JD_ACKnowledgement " ;
VAL_ 2565861888 CmdBytePGN61184_ECU 7922 "JD_ACKnowledgement " ;
VAL_ 2565848832 CmdBytePGN61184_ECU 7922 "JD_ACKnowledgement " ;
VAL_ 2565799939 CmdBytePGN61184_PBS 7922 "JD_ACKnowledgement " 7922 "JD_ACKnowledgement " ;
VAL_ 2565861891 CmdBytePGN61184_PBS 7922 "JD_ACKnowledgement " 7922 "JD_ACKnowledgement " ;
VAL_ 2565848835 CmdBytePGN61184_PBS 7922 "JD_ACKnowledgement " 7922 "JD_ACKnowledgement " ;
VAL_ 2565800707 CmdBytePGN61184_PBS 7922 "JD_ACKnowledgement " 7922 "JD_ACKnowledgement " ;
VAL_ 2565800178 CmdBytePGN61184_PDC 7922 "JD_ACKnowledgement " ;
VAL_ 2565800946 CmdBytePGN61184_PDC 7922 "JD_ACKnowledgement " 7922 "JD_ACKnowledgement " ;
VAL_ 2565849074 CmdBytePGN61184_PDC 7922 "JD_ACKnowledgement " ;
VAL_ 2565800127 CmdBytePGN61184_PDE 7922 "JD_ACKnowledgement " ;
VAL_ 2565800895 CmdBytePGN61184_PDE 7922 "JD_ACKnowledgement " 7922 "JD_ACKnowledgement " ;
VAL_ 2565862079 CmdBytePGN61184_PDE 7922 "JD_ACKnowledgement " ;
VAL_ 2566912000 CmdBytePGN65528_ECU 115 "JDAftertreatmentSCRSystemState " ;
VAL_ 2364538624 CmdBytePGN61184_ECU 1636 "JDEngineControlMessage1 " ;
VAL_ 2498691326 CmdBytePGN61184_Vector_XXX 2916 "JDEngineTestMessage " ;
VAL_ 2498691326 JDEngineTestMode 0 " No_Test_Enabled" 1 " Harness_Diagnostics" 255 " NotAvailable" ;
VAL_ 2498691326 JDEngineTestState 0 " Off" 1 " Active" 2 " Aborted" 3 " Complete" 254 " Error" 255 " NotAvailable" ;
VAL_ 2498691326 JDEngineTestActiveType 0 " Off" 1 " Factory" 2 " Application" 3 " Hold" 254 " Error" 255 " NotAvailable" ;
VAL_ 2498691326 JDEngineTestComponentID 0 " Engine_Position_and_Timing_Sensors" 1 " Oil_Control_Valve" 2 " Exhaust_Brake_1" 3 " Exhaust_Brake_2" 32 " Engine_Electric_Lift_Pump" 33 " Fuel_Injectors" 48 " High_Pressure_Fuel_Pump_Control_Valve" 49 " High_Pressure_Common_Rail_Fuel_Pressure_Relief_Valve" 64 " EGR_Valve" 65 " Air_Throttle" 66 " Exhaust_Throttle" 67 " Turbocharger_Actuator" 68 " Exhaust_Throttle_Power" 69 " Turbocharger_Compressor_Inlet_Sensor_Power" 70 " Turbocharger_Speed_Sensor" 80 " DEF_Supply_Module_Pump" 81 " DEF_Supply_Module_Reverting_Valve" 82 " DEF_Tank_Coolant_Control_Valve" 83 " DEF_Suction_Line_Heater" 84 " DEF_Pressure_Line_Heater" 85 " DEF_Return_Line_Heater" 86 " DEF_Module_Heater" 87 " DEF_Header_Power" 88 " NOx_Sensor_Power" 96 " Starter_Relay" 97 " Starter_Relay_Low_Side" 98 " Alternator_1_L_Terminal" 99 " Alternator_2_L_Terminal" 100 " Cold_Start" 101 " AC_Compressor" 102 " Air_Brake_Compressor" 103 " Fan_Reverse" 104 " Fan_Forward" 105 " Fan_Speed_Sensor" 106 " Vehicle_or_Other_Speed_Sensor" 107 " Spare_Sensor_Power" 108 " OEM_Spare_High_Side_Driver" 109 " OEM_Spare_1_High_Side_Driver" 110 " OEM_Spare_2_High_Side_Driver" 254 " Error" 255 " Not_available" ;
VAL_ 2566912768 CmdBytePGN65531_ECU 48 "JDMachineHealthFilterMonitoring " 12288 "Vehicle_Configuration_Management_Response " ;
VAL_ 2566913790 CmdBytePGN65534_Vector_XXX 236 "MachineSetup " ;
VAL_ 2566913790 EngType 0 " DEM_NotInstalled" 1 " DEM_NineLiT4" 2 " DEM_NineLFT4" 3 " DEM_ThirteenPointFiveLFT4" ;
VAL_ 2565800958 CmdBytePGN61184_Vector_XXX 11250 "Machine_Network_Health_Data_Command " ;
VAL_ 2565862142 CmdBytePGN61184_Vector_XXX 11250 "Machine_Network_Health_Data_Command " ;
VAL_ 2565849086 CmdBytePGN61184_Vector_XXX 11250 "Machine_Network_Health_Data_Command " ;
VAL_ 2432696318 CmdBytePGN65535_Vector_XXX 236 "OperatorSeatData " ;
VAL_ 2432696318 OperatorSeatSwitch 0 " DEM_Operator_Not_Present" 1 " DEM_Operator_Present" 2 " DEM_Error" 3 " DEM_Not_Available" ;
VAL_ 2566913010 CmdBytePGN65531_PDC 11003 "PowertrainDomaintoDriveTrainCharacteristics2 " 12288 "Vehicle_Configuration_Management_Response " ;
VAL_ 2632974334 CmdBytePGN61184_Vector_XXX 22884 "PowertrainDomaintoDriveTrainOptions " ;
VAL_ 2632974334 Opt4WD 0 " Off" 1 " On" 2 " Error" 3 " NotAvailable" ;
VAL_ 2632974334 EngSpdInRoadMode 0 " Off" 1 " On" 2 " Error" 3 " NotAvailable" ;
VAL_ 2632974334 OptType4WD 0 " NotInstalled" 1 " FixedDisplacement_4WD" 2 " VariableDisplacement_4WD" 14 " Error" 15 " NotAvailable" ;
VAL_ 2632974334 TracksOption 0 " NotInstalled" 1 " Region2HarainTracks" 2 " Region4ATITracks" 3 " GlobalTracks" 14 " Error" 15 " NotAvailable" ;
VAL_ 2499803890 CmdBytePGN65530_PDC 39424 "PowertrainDomaintoDriveTrainStatus3 " ;
VAL_ 2499803890 ASRTogCmd 0 " Active" 1 " Not Active" 2 " Error" 3 " Not available or not installed" ;
VAL_ 2565865235 CmdBytePGN61184_ATX 241 "Prop_Request_PGN_Dual_Cmd_Byte " 219 "Prop_Request_PGN_Single_Cmd_Byte " ;
VAL_ 2634021630 CmdBytePGN65530_Vector_XXX 58 "TCM_Calibration_Status " ;
VAL_ 2634021630 TCMCalStatus 0 " En_TCMCalibrationStatus_ Pending" 1 " En_TCMCalibrationStatus_ CalibrationValid" 2 " En_TCMCalibrationStatus_ CalibrationInvalid" 14 " En_TCMCalibrationStatus_ Error" 15 " En_TCMCalibrationStatus_ Not Available" ;
VAL_ 2499805182 CmdBytePGN65535_Vector_XXX 34 "Tractor_Setup_#1 " ;
VAL_ 2297429763 CmdBytePGN61184_PBS 24932 "TransmissionStatusHighPriority1 " 24932 "TransmissionStatusHighPriority1 " ;
VAL_ 2297429763 CntlrHeartbeat 0 " DEM_Not_active" 1 " DEM_Active" 2 " DEM_Error" 3 " DEM_Not_availablenot_installed" ;
VAL_ 2297429763 ParkBrakeRelCmd 0 " DEM_Off" 1 " DEM_On" 2 " DEM_Reserved__Stds" 3 " DEM_Dont_caretake_no_action" ;
VAL_ 2297429763 ParkBrakStatAutoFromDrivTrai 0 " Off" 1 " On" 2 " Error" 3 " NotAvailable" ;
VAL_ 2297429763 WheelBasedDirection 0 " Reverse" 1 " Forward" 2 " Error" 3 " NotAvailable" ;
VAL_ 2297429763 ParkLockFromDriveTrain 0 " Disengaged" 1 " Engaged" 2 " Error" 3 " NotAvailable" ;
VAL_ 2297429763 LimpModeStatus 0 " DEM_Limp_Home_Mode_Off" 1 " DEM_Limp_Home_Mode_On" 14 " DEM_Error" 15 " DEM_Not_availablenot_installed" ;
VAL_ 2297429763 TowModeStatus 0 " DEM_Tow_Mode_Off" 1 " DEM_Tow_Mode_On" 14 " DEM_Error" 15 " DEM_Not_availablenot_installed" ;
VAL_ 2297429763 ProDriveSysVlvReq 0 " Off" 1 " On" 2 " NoCommand" 14 " Error" 15 " NotAvailable" ;
VAL_ 2297429763 BackUpLightandAlarmHornCommand 0 " Deactivate" 1 " Activate" 2 " Reserved" 3 " Dont_caretake_no_action" ;
VAL_ 2365586174 CmdBytePGN65530_Vector_XXX 8224 "Vehicle_Leveling_Roll " ;
VAL_ 2365587454 CmdBytePGN65535_Vector_XXX 225 "Vehicle_Roll/Yaw_Rate " ;
VAL_ 2298475762 CmdBytePGN65524_PDC 94 "Vehicle_State_for_AutoTrac " ;
VAL_ 2298475762 EngineRunningState 0 " EnTwoStNo" 1 " EnTwoStYes" 2 " EnTwoStErr" 3 " EnTwoStNotAvl" ;
VAL_ 2298475762 OperatorPresenceState 0 " EnTwoStNo" 1 " EnTwoStYes" 2 " EnTwoStErr" 3 " EnTwoStNotAvl" ;
VAL_ 2298475762 TransportSwitchState 0 " EnTwoStNo" 1 " EnTwoStYes" 2 " EnTwoStErr" 3 " EnTwoStNotAvl" ;
VAL_ 2298475762 PrimaryResumeRequest 0 " EnTwoStNo" 1 " EnTwoStYes" 2 " EnTwoStErr" 3 " EnTwoStNotAvl" ;
VAL_ 2298475762 AuxiliaryResumeRequest 0 " EnTwoStNo" 1 " EnTwoStYes" 2 " EnTwoStErr" 3 " EnTwoStNotAvl" ;
VAL_ 2298475762 AT2ExitCode_VSAT 0 " ATECNoCode" 1 " ATECTransmissionInPark" 2 " ATECFICAFault" 3 " ATECWhlSpdSlow" 4 " ATECAltGuidanceActive" 5 " ATECIncorrectGear" 13 " ATECCmdMsdTimeout" 250 " ATECLastTransitionOk" 16 " ATECAuthDenied" 21 " ATECWhlSpdFast" 22 " ATECOilTempTooLow" 23 " ATECDiagMode" 24 " ATECCtrlState" 25 " ATECResumeNotPressed" 26 " ATECCurvatureNotMatched" 50 " ATECInvalidCommand" 51 " ATECNoOperatorPresence" 52 " ATECImpReleasedControl" 53 " ATECGlobalStop" 54 " ATECOperatorOverride" 62 " ATECECError" 63 " ATECECNotAvailable" 64 " ATECStartUp" 65 " ATECShutDown" 66 " ATECAutoTracShutdown" 67 " ATECEngineOff" 68 " ATECNotCalibrated" 69 " ATECVoltagenotStable" 70 " ATECOperatorPresenceDataBad" 71 " ATECResumeSwitchDataBad" 72 " ATECVehStateMsgMissing" 73 " ATECVehStateMsgBadData" 74 " ATECAdvGuidanceStatusMsgMissing" 75 " ATECAdvGuidanceStatusMsgBadData" 76 " ATECActiveInReverseTimeout" 77 " ATECGPSWheelSpeedMismatch" 78 " ATECNoValidTrack" 79 " ATECInvalidGPS" 80 " ATECShutdownStateFaulted" 81 " ATECGSDDataFaulted" 82 " ATECExtGuidanceStatusMsgFaulted" 83 " ATECExtGuidanceStatusExtendedMsgFaulted" 84 " ATECVehDirSpeedMsgFaulted" 85 " ATECVehRollYawMsgFaulted" 86 " ATECTCMMsgFaulted" 87 " ATECLateralError" 88 " ATECHeadingError" 89 " ATECTrackNumChanged" 90 " ATECTCMInactive" 91 " ATECRSGPSTransitionTooLarge" 92 " ATECRSOutOfRow" 93 " ATECRSGreenstarTrackingFault" 94 " ATECRSSensorFault" 95 " ATECRSGPSFault" 100 " ATECTransportMode" 101 " ATECAuxPumpOn" 102 " ATECBoomsFolded" 103 " ATECHeaderNotEngaged" 104 " ATECFourWheelSteerTimeout" 105 " ATECCrabSteering" 254 " ATECEC8BitError" 255 " ATECEC8BitNotAvailable" ;
VAL_ 2298475762 TransmissionState_VSAT 0 " TrsmStPark" 1 " TrsmStRvs" 2 " TrsmStNeut" 3 " TrsmStFwd" 14 " TrsmStErr" 15 " TrsmStUkwn" ;
VAL_ 2566912959 CmdBytePGN65531_PDE 12288 "Vehicle_Configuration_Management_Response " ;
